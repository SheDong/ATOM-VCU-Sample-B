AUTOSAR XML (schema 00046)
package /PortInterfaces
  353 x sender receiver interface:
    IF_BswM_BSWWrkMod_Enum
      data tec_BswM_BSWWrkMod_Enum: type=uint8
    IF_BswM_CANWakeUp_Flg
      data tec_BswM_CANWakeUp_Flg: type=boolean
    IF_BswM_DcWakeUp_Flg
      data tec_BswM_DcWakeUp_Flg: type=boolean
    IF_BswM_KeyWakeUp_Flg
      data tec_BswM_KeyWakeUp_Flg: type=boolean
    IF_BswM_LinWakeUp_Flg
      data tec_BswM_LinWakeUp_Flg: type=boolean
    IF_ChassisMgmt_AccrPedlDrvTq_Nm
      data tec_ChassisMgmt_AccrPedlDrvTq_Nm: type=float32
    IF_ChassisMgmt_AccrPedlFltSts_Enum
      data tec_ChassisMgmt_AccrPedlFltSts_Enum: type=uint8
    IF_ChassisMgmt_AccrPedlPosn_pct
      data tec_ChassisMgmt_AccrPedlPosn_pct: type=float32
    IF_ChassisMgmt_AccrPedlPosnRaw_pct
      data tec_ChassisMgmt_AccrPedlPosnRaw_pct: type=float32
    IF_ChassisMgmt_AccrPedlVld_Flg
      data tec_ChassisMgmt_AccrPedlVld_Flg: type=boolean
    IF_ChassisMgmt_BrkCmpSts_Enum
      data tec_ChassisMgmt_BrkCmpSts_Enum: type=uint8
    IF_ChassisMgmt_BrkCtrlSts_Flg
      data tec_ChassisMgmt_BrkCtrlSts_Flg: type=boolean
    IF_ChassisMgmt_BrkFltSts_Flg
      data tec_ChassisMgmt_BrkFltSts_Flg: type=boolean
    IF_ChassisMgmt_BrkPedlPosn_pct
      data tec_ChassisMgmt_BrkPedlPosn_pct: type=float32
    IF_ChassisMgmt_BrkRgnActv_Flg
      data tec_ChassisMgmt_BrkRgnActv_Flg: type=boolean
    IF_ChassisMgmt_BrkRgnTq_Nm
      data tec_ChassisMgmt_BrkRgnTq_Nm: type=float32
    IF_ChassisMgmt_BrkSts_Flg
      data tec_ChassisMgmt_BrkSts_Flg: type=boolean
    IF_ChassisMgmt_BrkStsVld_Flg
      data tec_ChassisMgmt_BrkStsVld_Flg: type=boolean
    IF_ChassisMgmt_CoastCtrlActv_Flg
      data tec_ChassisMgmt_CoastCtrlActv_Flg: type=boolean
    IF_ChassisMgmt_CoastCtrlMCUReqSts_Enum
      data tec_ChassisMgmt_CoastCtrlMCUReqSts_Enum: type=uint8
    IF_ChassisMgmt_CoastCtrlTq_Nm
      data tec_ChassisMgmt_CoastCtrlTq_Nm: type=float32
    IF_ChassisMgmt_CrpCtrlDesTq_Nm
      data tec_ChassisMgmt_CrpCtrlDesTq_Nm: type=float32
    IF_ChassisMgmt_DrvAsscCtrlActv_Flg
      data tec_ChassisMgmt_DrvAsscCtrlActv_Flg: type=boolean
    IF_ChassisMgmt_DrvAsscCtrlOvrdSts_Flg
      data tec_ChassisMgmt_DrvAsscCtrlOvrdSts_Flg: type=boolean
    IF_ChassisMgmt_DrvAsscCtrlTq_Nm
      data tec_ChassisMgmt_DrvAsscCtrlTq_Nm: type=float32
    IF_ChassisMgmt_DrvCoorDesTq_Nm
      data tec_ChassisMgmt_DrvCoorDesTq_Nm: type=float32
    IF_ChassisMgmt_DrvDmdHiPrio_Flg
      data tec_ChassisMgmt_DrvDmdHiPrio_Flg: type=boolean
    IF_ChassisMgmt_DrvrDesTq_Nm
      data tec_ChassisMgmt_DrvrDesTq_Nm: type=float32
    IF_ChassisMgmt_IBSDesIncTq_Nm
      data tec_ChassisMgmt_IBSDesIncTq_Nm: type=float32
    IF_ChassisMgmt_IBSDesRednTq_Nm
      data tec_ChassisMgmt_IBSDesRednTq_Nm: type=float32
    IF_ChassisMgmt_IBSIntvIncTq_Nm
      data tec_ChassisMgmt_IBSIntvIncTq_Nm: type=float32
    IF_ChassisMgmt_IBSIntvIncTqActv_Flg
      data tec_ChassisMgmt_IBSIntvIncTqActv_Flg: type=boolean
    IF_ChassisMgmt_IBSIntvRednTq_Nm
      data tec_ChassisMgmt_IBSIntvRednTq_Nm: type=float32
    IF_ChassisMgmt_IBSIntvRednTqActv_Flg
      data tec_ChassisMgmt_IBSIntvRednTqActv_Flg: type=boolean
    IF_ChassisMgmt_IBSVlcReqTqAvl_Flg
      data tec_ChassisMgmt_IBSVlcReqTqAvl_Flg: type=boolean
    IF_ChassisMgmt_OnePedlActv_Flg
      data tec_ChassisMgmt_OnePedlActv_Flg: type=boolean
    IF_ChassisMgmt_OnePedlDesDecelSpd_mps2q
      data tec_ChassisMgmt_OnePedlDesDecelSpd_mps2q: type=float32
    IF_ChassisMgmt_OnePedlDesSpd_rpm
      data tec_ChassisMgmt_OnePedlDesSpd_rpm: type=float32
    IF_ChassisMgmt_OnePedlDesTq_Nm
      data tec_ChassisMgmt_OnePedlDesTq_Nm: type=float32
    IF_ChassisMgmt_OnePedlFltSts_Flg
      data tec_ChassisMgmt_OnePedlFltSts_Flg: type=boolean
    IF_ChassisMgmt_PedlAlysDTC_16bit
      data tec_ChassisMgmt_PedlAlysDTC_16bit: type=uint16
    IF_ChassisMgmt_SpdLmtSts_Flg
      data tec_ChassisMgmt_SpdLmtSts_Flg: type=boolean
    IF_ChassisMgmt_VehDesDecel_mps2q
      data tec_ChassisMgmt_BrkCmpDesDecel_mps2q: type=float32
    IF_ChgMgmt_ChrgIndcnSts_Enum
      data tec_ChgMgmt_ChrgIndcnSts_Enum: type=uint8
    IF_ChgMgmt_DchaAbortRsn_Enum
      data tec_ChgMgmt_DchaAbortRsn_Enum: type=uint8
    IF_ChrgMgmt_ChrgnRemnTim_min
      data tec_ChrgMgmt_ChrgnRemnTim_min: type=uint16
    IF_ChrMgmt_AcChrgCmplSts_Enum
      data tec_ChrMgmt_AcChrgCmplSts_Enum: type=uint8
    IF_ChrMgmt_BattSideSngChrgEgy_kWh
      data tec_ChrMgmt_BattSideSngChrgEgy_kWh: type=float32
    IF_ChrMgmt_ChrgPwr_kW
      data tec_ChrMgmt_ChrgPwr_kW: type=float32
    IF_ChrMgmt_ChrgSts_Enum
      data tec_ChrMgmt_ChrgSts_Enum: type=uint8
    IF_ChrMgmt_ChrgStsErrDTC_8bit
      data tec_ChrMgmt_ChrgStsErrDTC_8bit: type=uint8
    IF_ChrMgmt_ChrgTim_min
      data tec_ChrMgmt_ChrgTim_min: type=uint16
    IF_ChrMgmt_DcChrgAllwd_Flg
      data tec_ChrMgmt_DcChrgAllwd_Flg: type=boolean
    IF_ChrMgmt_DcChrgCmplSts_Enum
      data tec_ChrMgmt_DcChrgCmplSts_Enum: type=uint8
    IF_ChrMgmt_DcChrgrSideSngChrgEgy_kWh
      data tec_ChrMgmt_DcChrgrSideSngChrgEgy_kWh: type=float32
    IF_ChrMgmt_KeepWrm_Flg
      data tec_ChrMgmt_KeepWrm_Flg: type=boolean
    IF_ChrMgmt_NegRlyOpenReq_Flg
      data tec_ChrMgmt_NegRlyOpenReq_Flg: type=boolean
    IF_ChrMgmt_OBCCtrlMdlSts_Enum
      data tec_ChrMgmt_OBCCtrlMdlSts_Enum: type=uint8
    IF_ChrMgmt_OBCEnaAllwd_Flg
      data tec_ChrMgmt_OBCEnaAllwd_Flg: type=boolean
    IF_ChrMgmt_OBCSideSngChrgEgy_kWh
      data tec_ChrMgmt_OBCSideSngChrgEgy_kWh: type=float32
    IF_ChrMgmt_OBCSideSngDchaEgy_kWh
      data tec_ChrMgmt_OBCSideSngDchaEgy_kWh: type=float32
    IF_ChrMgmt_PlugSts_Enum
      data tec_ChrMgmt_PlugSts_Enum: type=uint8
    IF_ChrMgmt_PODSideSngChrgEgy_kWh
      data tec_ChrMgmt_PODSideSngChrgEgy_kWh: type=float32
    IF_ChrMgmt_PreheatPODDiReq_Flg
      data tec_ChrMgmt_PreheatPODDiReq_Flg: type=boolean
    IF_ChrMgmt_PreheatSts_Enum
      data tec_ChrMgmt_PreheatSts_Enum: type=uint8
    IF_ChrMgmt_ReqHvRdy_Flg
      data tec_ChrMgmt_ReqHvRdy_Flg: type=boolean
    IF_ChrMgmt_VCUCalcdPODIDc_A
      data tec_ChrMgmt_VCUCalcdPODIDc_A: type=float32
    IF_ChrMgmt_VCUDispChrgI_A
      data tec_ChrMgmt_VCUDispChrgI_A: type=float32
    IF_ChrMgmt_VCUDispChrgU_V
      data tec_ChrMgmt_VCUDispChrgU_V: type=float32
    IF_ComM_AcChrgPha_Enum
      data tec_ComM_AcChrgPha_Enum: type=uint8
    IF_ComM_ACUDrvSeatBltSts_Flg
      data tec_ComM_ACUDrvSeatBltSts_Flg: type=boolean
    IF_ComM_ACUDrvSeatBltStsVld_Flg
      data tec_ComM_ACUDrvSeatBltStsVld_Flg: type=boolean
    IF_ComM_ADCUDMSDrvExist_Flg
      data tec_ComM_ADCUDMSDrvrExist_Flg: type=boolean
    IF_ComM_ApptChrgMdlSts_Enum
      data tec_ComM_ApptChrgMdlSts_Enum: type=uint8
    IF_ComM_APTCPwrCns_Kw
      data tec_ComM_APTCPwrCns_Kw: type=float32
    IF_ComM_BattMaxTemp_C
      data tec_ComM_BMSBattMaxTemp_C: type=sint8
    IF_ComM_BattMinTemp_C
      data tec_ComM_BMSBattMinTemp_C: type=sint8
    IF_ComM_BCMAntithftSts_Enum
      data tec_ComM_BCMAntithftSts_Enum: type=uint8
    IF_ComM_BCMImmoSts_Enum
      data tec_ComM_BCMImmoSts_Enum: type=uint8
    IF_ComM_BMSBattAllowChrgIDc_A
      data tec_ComM_BMSBattAllowChrgIDc_A: type=float32
    IF_ComM_BMSBattDchaIDc_A
      data tec_ComM_BMSBattDchaIDc_A: type=float32
    IF_ComM_BMSBattDispSOC_pct
      data tec_ComM_BMSBattDispSOC_pct: type=float32
    IF_ComM_BMSBattHeatIDc_A
      data tec_ComM_BMSBattHeatIDc_A: type=float32
    IF_ComM_BMSBattIDc_A
      data tec_ComM_BMSBattIDc_A: type=float32
    IF_ComM_BMSBattLnkUDc_V
      data tec_ComM_BMSBattLnkUDc_V: type=float32
    IF_ComM_BMSBattLongChrgIDc_A
      data tec_ComM_BMSBattLongChrgIDc_A: type=float32
    IF_ComM_BMSBattLongDchaIDc_A
      data tec_ComM_BMSBattLongDchaIDc_A: type=float32
    IF_ComM_BMSBattPckUDc_V
      data tec_ComM_BMSBattPckUDc_V: type=float32
    IF_ComM_BMSBattRateCp_Ah
      data tec_ComM_BMSBattRateCp_Ah: type=float32
    IF_ComM_BMSBattShoChrgIDc_A
      data tec_ComM_BMSBattShoChrgIDc_A: type=float32
    IF_ComM_BMSBattShoDchaIDc_A
      data tec_ComM_BMSBattShoDchaIDc_A: type=float32
    IF_ComM_BMSBattSOCLow_Flg
      data tec_ComM_BMSBattSOCLow_Flg: type=boolean
    IF_ComM_BMSBattUDc_V
      data tec_ComM_BMSBattUDc_V: type=float32
    IF_ComM_BMSChrgCmplSts_Enum
      data tec_ComM_BMSChrgCmplSts_Enum: type=uint8
    IF_ComM_BMSChrgReqSts_Enum
      data tec_ComM_BMSChrgReqSts_Enum: type=uint8
    IF_ComM_BMSChrgSts_Enum
      data tec_ComM_BMSChrgSts_Enum: type=uint8
    IF_ComM_BMSKeepWrmReq_Enum
      data tec_ComM_BMSKeepWrmReq_Enum: type=uint8
    IF_ComM_BMSNegRlySts_Enum
      data tec_ComM_BMSNegRlySts_Enum: type=uint8
    IF_ComM_BMSPosRlySts_Enum
      data tec_ComM_BMSPosRlySts_Enum: type=uint8
    IF_ComM_BMSRemnChrgTim_min
      data tec_ComM_BMSRemnChrgTim_min: type=uint16
    IF_ComM_BMSRTCReq_Flg
      data tec_ComM_BMSRTCReq_Flg: type=boolean
    IF_ComM_BMSSts_Enum
      data tec_ComM_BMSSts_Enum: type=uint8
    IF_ComM_BMSWrkMod_Enum
      data tec_ComM_BMSWrkMod_Enum: type=uint8
    IF_ComM_CCSOutpIDc_A
      data tec_ComM_CCSOutpIDc_A: type=float32
    IF_ComM_CCSOutpUDc_V
      data tec_ComM_CCSOutpUDc_V: type=float32
    IF_ComM_CMLMaxOutpIDc_A
      data tec_ComM_CMLMaxOutpIDc_A: type=float32
    IF_ComM_CustSetVehSpd_kph
      data tec_ComM_IVISetFwdVehSpd_kph: type=float32
    IF_ComM_DCDCActLvUDc_V
      data tec_ComM_DCDCActLvUDc_V: type=float32
    IF_ComM_DCDCHvInpIDc_A
      data tec_ComM_DCDCHvInpIDc_A: type=float32
    IF_ComM_DCDCHvInpUDc_V
      data tec_ComM_DCDCHvInpUDc_V: type=float32
    IF_ComM_DCDCWrkMod_Enum
      data tec_ComM_DCDCWrkMod_Enum: type=uint8
    IF_ComM_DchaSwtSts_Enum
      data tec_ComM_DchaSwtSts_Enum: type=uint8
    IF_ComM_DCMFLDoorSts_Flg
      data tec_ComM_DCMFLDoorSts_Flg: type=boolean
    IF_ComM_ElectcLockSts_Enum
      data tec_ComM_ElectcLockSts_Enum: type=uint8
    IF_ComM_EPBWrkSts_Enum
      data tec_ComM_EPBWrkSts_Enum: type=uint8
    IF_ComM_EVCOMActPwrCns_Kw
      data tec_ComM_EVCOMActPwrCns_Kw: type=float32
    IF_ComM_GearPBtn_Enum
      data tec_ComM_GearPBtn_Enum: type=uint8
    IF_ComM_GearPBtnFltSts_Flg
      data tec_ComM_GearPBtnFltSts_Flg: type=boolean
    IF_ComM_GearRNDBtn_Enum
      data tec_ComM_GearRNDBtn_Enum: type=uint8
    IF_ComM_GearRNDBtnFltSts_Flg
      data tec_ComM_GearRNDBtnFltSts_Flg: type=boolean
    IF_ComM_HVCHIDc_A
      data tec_ComM_HVCHIDc_A: type=float32
    IF_ComM_HVCHUDc_V
      data tec_ComM_HVCHUDc_V: type=float32
    IF_ComM_IBSAbpActv_Flg
      data tec_ComM_IBSAbpActv_Flg: type=boolean
    IF_ComM_IBSAbsActv_Flg
      data tec_ComM_IBSAbsActv_Flg: type=boolean
    IF_ComM_IBSAebActv_Flg
      data tec_ComM_IBSAebActv_Flg: type=boolean
    IF_ComM_IBSApaModSts_Enum
      data tec_ComM_IBSApaModSts_Enum: type=uint8
    IF_ComM_IBSApaReqTq_Nm
      data tec_ComM_IBSApaReqTq_Nm: type=float32
    IF_ComM_IBSApaReqTqVld_Flg
      data tec_ComM_IBSApaReqTqVld_Flg: type=boolean
    IF_ComM_IBSBattChrgWakeUp_Flg
      data tec_ComM_IBSBattChrgWakeUp_Flg: type=boolean
    IF_ComM_IBSBattDchaWakeUp_Flg
      data tec_ComM_IBSBattDchaWakeUp_Flg: type=boolean
    IF_ComM_IBSBattIDc_A
      data tec_ComM_IBSBattIDc_A: type=float32
    IF_ComM_IBSBattSOC_pct
      data tec_ComM_IBSBattSOC_pct: type=float32
    IF_ComM_IBSBattSOCWakeUp_Flg
      data tec_ComM_IBSBattSOCWakeUp_Flg: type=boolean
    IF_ComM_IBSBattTemp_C
      data tec_ComM_IBSBattTemp_C: type=float32
    IF_ComM_IBSBattUDc_V
      data tec_ComM_IBSBattUDc_V: type=float32
    IF_ComM_IBSBrkMstCylPrs_pct
      data tec_ComM_IBSBrkMstCylPrs_pct: type=float32
    IF_ComM_IBSBrkPlgrPrs_pct
      data tec_ComM_IBSBrkPlgrPrs_pct: type=float32
    IF_ComM_IBSBrkSts_Enum
      data tec_ComM_IBSBrkSts_Enum: type=uint8
    IF_ComM_IBSDtcActv_Flg
      data tec_ComM_IBSDtcActv_Flg: type=boolean
    IF_ComM_IBSDtcFlt_Flg
      data tec_ComM_IBSDtcFlt_Flg: type=boolean
    IF_ComM_IBSFLMovgDir_Enum
      data tec_ComM_IBSFLMovgDir_Enum: type=uint8
    IF_ComM_IBSFRMovgDir_Enum
      data tec_ComM_IBSFRMovgDir_Enum: type=uint8
    IF_ComM_IBSHdcSts_Enum
      data tec_ComM_IBSHdcSts_Enum: type=uint8
    IF_ComM_IBSRbsReqTq_Nm
      data tec_ComM_IBSRbsReqTq_Nm: type=float32
    IF_ComM_IBSRbsReqTqVld_Flg
      data tec_ComM_IBSRbsReqTqVld_Flg: type=boolean
    IF_ComM_IBSRbsSts_Enum
      data tec_ComM_IBSRbsSts_Enum: type=uint8
    IF_ComM_IBSReqIncTq_Nm
      data tec_ComM_IBSReqIncTq_Nm: type=float32
    IF_ComM_IBSReqIncTqVld_Flg
      data tec_ComM_IBSReqIncTqVld_Flg: type=boolean
    IF_ComM_IBSReqRednTq_Nm
      data tec_ComM_IBSReqRednTq_Nm: type=float32
    IF_ComM_IBSReqRednTqVld_Flg
      data tec_ComM_IBSReqRednTqVld_Flg: type=boolean
    IF_ComM_IBSRLMovgDir_Enum
      data tec_ComM_IBSRLMovgDir_Enum: type=uint8
    IF_ComM_IBSRLSpd_kph
      data tec_ComM_IBSRLSpd_kph: type=float32
    IF_ComM_IBSRLSpdVld_Flg
      data tec_ComM_IBSRLSpdVld_Flg: type=boolean
    IF_ComM_IBSRRMovgDir_Enum
      data tec_ComM_IBSRRMovgDir_Enum: type=uint8
    IF_ComM_IBSRrSpd_kph
      data tec_ComM_IBSRRSpd_kph: type=float32
    IF_ComM_IBSRRSpdVld_Flg
      data tec_ComM_IBSRRSpdVld_Flg: type=boolean
    IF_ComM_IBSRwuActv_Flg
      data tec_ComM_IBSRwuActv_Flg: type=boolean
    IF_ComM_IBSTarGearReq_Enum
      data tec_ComM_IBSTarGearReq_Enum: type=uint8
    IF_ComM_IBSTcsActv_Flg
      data tec_ComM_IBSTcsActv_Flg: type=boolean
    IF_ComM_IBSTcsFlt_Flg
      data tec_ComM_IBSTcsFlt_Flg: type=boolean
    IF_ComM_IBSVdcActv_Flg
      data tec_ComM_IBSVdcActv_Flg: type=boolean
    IF_ComM_IBSVdcFlt_Flg
      data tec_ComM_IBSVdcFlt_Flg: type=boolean
    IF_ComM_IBSVehSpd_kph
      data tec_ComM_IBSVehSpd_kph: type=float32
    IF_ComM_IBSVehSpdVld_Flg
      data tec_ComM_IBSVehSpdVld_Flg: type=boolean
    IF_ComM_IBSVlcActv_Flg
      data tec_ComM_IBSVlcActv_Flg: type=boolean
    IF_ComM_IBSVlcReqTq_Nm
      data tec_ComM_IBSVlcReqTq_Nm: type=float32
    IF_ComM_IBSVlcReqTqVld_Flg
      data tec_ComM_IBSVlcReqTqVld_Flg: type=boolean
    IF_ComM_IVIAcclrLvlSts_Enum
      data tec_ComM_IVIAcclrLvlSts_Enum: type=uint8
    IF_ComM_IVIChrgCmd_Enum
      data tec_ComM_IVIChrgCmd_Enum: type=uint8
    IF_ComM_IVIDrvModSet_Enum
      data tec_ComM_IVIDrvModSet_Enum: type=uint8
    IF_ComM_IVIEnaBrkCmpMod_Enum
      data tec_ComM_IVIEnaBrkCmpMod_Enum: type=uint8
    IF_ComM_IVIEnaOnePedlMod_Enum
      data tec_ComM_IVIEnaOnePedlMod_Enum: type=uint8
    IF_ComM_IVIFwdMaxVehSpdLmtSwt_Enum
      data tec_ComM_IVIFwdMaxVehSpdLmtSwt_Enum: type=uint8
    IF_ComM_IVIGearReq_Enum
      data tec_ComM_IVIGearReq_Enum: type=uint8
    IF_ComM_IVIPrecReq_Flg
      data tec_ComM_IVIPrecReq_Flg: type=boolean
    IF_ComM_IVIPreheatReq_Flg
      data tec_ComM_IVIPreheatReq_Flg: type=boolean
    IF_ComM_IVIReqElectcLock_Enum
      data tec_ComM_IVIReqElectcLock_Enum: type=uint8
    IF_ComM_MaxChrgSOCSet_Enum
      data tec_ComM_MaxChrgSOCSet_Enum: type=uint8
    IF_ComM_MCUIDc_A
      data tec_ComM_MCUIDc_A: type=float32
    IF_ComM_MCUUDc_V
      data tec_ComM_MCUUDc_V: type=float32
    IF_ComM_MCUWrkMod_Enum
      data tec_ComM_MCUWrkMod_Enum: type=uint8
    IF_ComM_MinDchaSOCSet_Enum
      data tec_ComM_MinDchaSOCSet_Enum: type=uint8
    IF_ComM_MotActSpd_rpm
      data tec_ComM_MotActSpd_rpm: type=sint16
    IF_ComM_MotActSpdVld_Flg
      data tec_ComM_MotActSpdVld_Flg: type=boolean
    IF_ComM_MotActTq_Nm
      data tec_ComM_MotActTq_Nm: type=float32
    IF_ComM_MotMaxTq_Nm
      data tec_ComM_MotMaxTq_Nm: type=float32
    IF_ComM_MotMinTq_Nm
      data tec_ComM_MotMinTq_Nm: type=float32
    IF_ComM_OBCCCIDcLmt_A
      data tec_ComM_OBCCCIDcLmt_A: type=float32
    IF_ComM_OBCCCSts_Enum
      data tec_ComM_OBCCCSts_Enum: type=uint8
    IF_ComM_OBCChrgOutpPwrAvl_Kw
      data tec_ComM_OBCChrgOutpPwrAvl_Kw: type=float32
    IF_ComM_OBCChrgSts_Enum
      data tec_ComM_OBCChrgSts_Enum: type=uint8
    IF_ComM_OBCCPIDcLmt_A
      data tec_ComM_OBCCPIDcLmt_A: type=float32
    IF_ComM_OBCCPPwmDuty_pct
      data tec_ComM_OBCCPPwmDuty_pct: type=uint8
    IF_ComM_OBCCPSts_Enum
      data tec_ComM_OBCCPSts_Enum: type=uint8
    IF_ComM_OBCDCOutpIDc_A
      data tec_ComM_OBCDCOutpIDc_A: type=float32
    IF_ComM_OBCInpIAc_A
      data tec_ComM_OBCInpIAc_A: type=float32
    IF_ComM_OBCInpUAc_V
      data tec_ComM_OBCInpUAc_V: type=float32
    IF_ComM_OBCMaxAllwdIDc_A
      data tec_ComM_OBCMaxAllwdIDc_A: type=float32
    IF_ComM_OBCOutpIDc_A
      data tec_ComM_OBCOutpIDc_A: type=float32
    IF_ComM_OBCOutpUDc_V
      data tec_ComM_OBCOutpUDc_V: type=float32
    IF_ComM_PEPSPwrMod_Enum
      data tec_ComM_PEPSPwrMod_Enum: type=uint8
    IF_ComM_PODDCFCUDc_V
      data tec_ComM_PODDCFCUDc_V: type=float32
    IF_ComM_PODDcNegRlySts_Enum
      data tec_ComM_PODDcNegRlySts_Enum: type=uint8
    IF_ComM_PODDcPosRlySts_Enum
      data tec_ComM_PODDcPosRlySts_Enum: type=uint8
    IF_ComM_S2SwtSts_Enum
      data tec_ComM_S2SwtSts_Enum: type=uint8
    IF_ComM_SGWAcReq_Flg
      data tec_ComM_SGWAcReq_Flg: type=boolean
    IF_ComM_SGWChrgCmd_Enum
      data tec_ComM_SGWChrgCmd_Enum: type=uint8
    IF_ComM_SGWRemHvCtrlReq_Enum
      data tec_ComM_SGWRemHvCtrlReq_Enum: type=uint8
    IF_ComM_SGWSysRdyReq_Flg
      data tec_ComM_SGWSysRdyReq_Flg: type=boolean
    IF_ComM_SGWWakeUpReq_Flg
      data tec_ComM_SGWWakeUpReq_Flg: type=boolean
    IF_ComM_SysIRVal_kOhm
      data tec_ComM_SysIRVal_kOhm: type=uint16
    IF_ComM_TMSTotPwrCns_Kw
      data tec_ComM_TMSTotPwrCns_Kw: type=float32
    IF_ComM_TMSTotPwrReq_Kw
      data tec_ComM_TMSTotPwrReq_Kw: type=float32
    IF_ComM_YRSAx_mps2q
      data tec_ComM_YRSAx_mps2q: type=float32
    IF_ComM_YRSAxSts_Flg
      data tec_ComM_YRSAxSts_Flg: type=boolean
    IF_DCChrg_DCFCClsReq_Flg
      data tec_DCChrg_DCFCClsReq_Flg: type=boolean
    IF_DCChrMgmt_DcChrgnMod_Enum
      data tec_DCChrMgmt_DcChrgnMod_Enum: type=uint8
    IF_DCChrMgmt_DcChrgnSts_Enum
      data tec_DCChrMgmt_DcChrgnSts_Enum: type=uint8
    IF_EgyMgmt_BattChrgIDcLmt_A
      data tec_EgyMgmt_BattChrgIDcLmt_A: type=float32
    IF_EgyMgmt_BMSBattChrgIDcLmt_A
      data tec_EgyMgmt_BMSBattChrgIDcLmt_A: type=float32
    IF_EgyMgmt_DCDCPwrCnsCalcn_Kw
      data tec_EgyMgmt_DCDCPwrCnsCalcn_Kw: type=float32
    IF_EgyMgmt_DCDCPwrLmt_Kw
      data tec_EgyMgmt_DCDCPwrLmt_Kw: type=float32
    IF_EgyMgmt_KeepWrmIDcLmt_A
      data tec_EgyMgmt_KeepWrmIDcLmt_A: type=float32
    IF_EgyMgmt_MCULongChrgPwrLmt_Kw
      data tec_EgyMgmt_MCULongChrgPwrLmt_Kw: type=float32
    IF_EgyMgmt_MCULongDchaPwrLmt_Kw
      data tec_EgyMgmt_MCULongDchaPwrLmt_Kw: type=float32
    IF_EgyMgmt_MCUPwrCnsCalcn_Kw
      data tec_EgyMgmt_MCUPwrCnsCalcn_Kw: type=float32
    IF_EgyMgmt_MCUShoChrgPwrLmt_Kw
      data tec_EgyMgmt_MCUShoChrgPwrLmt_Kw: type=float32
    IF_EgyMgmt_MCUShoDchaPwrLmt_Kw
      data tec_EgyMgmt_MCUShoDchaPwrLmt_Kw: type=float32
    IF_EgyMgmt_OBCDchaPwrLmt_Kw
      data tec_EgyMgmt_OBCDchaPwrLmt_Kw: type=float32
    IF_EgyMgmt_PackPTCPwrCnsCalcn_Kw
      data tec_EgyMgmt_PackPTCPwrCnsCalcn_Kw: type=float32
    IF_EgyMgmt_PermtPckPTC_Flg
      data tec_EgyMgmt_PermtPckPTC_Flg: type=boolean
    IF_EgyMgmt_PreheatIDcLmt_A
      data tec_EgyMgmt_PreheatIDcLmt_A: type=float32
    IF_EgyMgmt_TCUPwrAllwd_Kw
      data tec_EgyMgmt_TCUPwrAllwd_Kw: type=float32
    IF_EgyMgmt_TCUPwrCnsCalcn_Kw
      data tec_EgyMgmt_TCUPwrCnsCalcn_Kw: type=float32
    IF_EgyMgmt_V2LPwrCnsCalcn_Kw
      data IF_EgyMgmt_V2LPwrCnsCalcn_Kw: type=float32
    IF_ErrMgmt_ChassisCtrl_8bit
      data tec_ErrMgmt_ChassisCtrl_8bit: type=uint8
    IF_ErrMgmt_ChrgCtrl_8bit
      data tec_ErrMgmt_ChrgCtrl_8bit: type=uint8
    IF_ErrMgmt_ComFailDTC_16bit
      data tec_ErrMgmt_ComFailDTC_16bit: type=uint16
    IF_ErrMgmt_HvCtrl_8bit
      data tec_ErrMgmt_HvCtrl_8bit: type=uint8
    IF_ErrMgmt_OBCMesgLoss_Flg
      data tec_ErrMgmt_OBCMesgLoss_Flg: type=boolean
    IF_ErrMgmt_TqCtrl_8bit
      data tec_ErrMgmt_TqCtrl_8bit: type=uint8
    IF_ErrMgmt_VehSpdLmt_8bit
      data tec_ErrMgmt_VehSpdLmt_8bit: type=uint8
    IF_ErrMgmt_VehSpdLmt_kph
      data tec_ErrMgmt_VehSpdLmt_kph: type=float32
    IF_GearMgmt_ActGear_Enum
      data tec_GearMgmt_ActGear_Enum: type=uint8
    IF_GearMgmt_AllowGearShift_Enum
      data tec_GearMgmt_AllowGearShift_Enum: type=uint8
    IF_GearMgmt_AllowGearShift2P_Flg
      data tec_GearMgmt_AllowGearShift2P_Flg: type=boolean
    IF_GearMgmt_AllowGearShiftWait_Enum
      data tec_GearMgmt_AllowGearShiftWait_Enum: type=uint8
    IF_GearMgmt_AutoNReq_Flg
      data tec_GearMgmt_AutoNReq_Flg: type=boolean
    IF_GearMgmt_AutoPNSts_Flg
      data tec_GearMgmt_AutoPNSts_Flg: type=boolean
    IF_GearMgmt_AutoPReq_Flg
      data tec_GearMgmt_AutoPReq_Flg: type=boolean
    IF_GearMgmt_EPBPrkReq_Flg
      data tec_GearMgmt_EPBPrkReq_Flg: type=boolean
    IF_GearMgmt_EPBPrkReqCmpl_Flg
      data tec_GearMgmt_EPBPrkReqCmpl_Flg: type=boolean
    IF_GearMgmt_EPBPrkReqFail_Flg
      data tec_GearMgmt_EPBPrkReqFail_Flg: type=boolean
    IF_GearMgmt_EPBPrkType_Enum
      data tec_GearMgmt_EPBPrkType_Enum: type=uint8
    IF_GearMgmt_EPBRelsReq_Flg
      data tec_GearMgmt_EPBRelsReq_Flg: type=boolean
    IF_GearMgmt_EPBRelsReqCmpl_Flg
      data tec_GearMgmt_EPBRelsReqCmpl_Flg: type=boolean
    IF_GearMgmt_EPBRelsReqFail_Flg
      data tec_GearMgmt_EPBRelsReqFail_Flg: type=boolean
    IF_GearMgmt_InPlugDetd_Flg
      data tec_GearMgmt_InPlugDetd_Flg: type=boolean
    IF_GearMgmt_InvldGearSel_Enum
      data tec_GearMgmt_InvldGearSel_Enum: type=uint8
    IF_GearMgmt_NotP2PReq_Flg
      data tec_GearMgmt_NotP2PReq_Flg: type=boolean
    IF_GearMgmt_P2NReq_Flg
      data tec_GearMgmt_P2NReq_Flg: type=boolean
    IF_GearMgmt_TarGear_Enum
      data tec_GearMgmt_TarGear_Enum: type=uint8
    IF_GearMgmt_TarGearPInhbTq_Flg
      data tec_GearMgmt_TarGearPInhbTq_Flg: type=boolean
    IF_GearMgmt_TarGearShift_Enum
      data tec_GearMgmt_TarGearShift_Enum: type=uint8
    IF_GearMgmt_WakeUpEPBReq_Flg
      data tec_GearMgmt_WakeUpEPBReq_Flg: type=boolean
    IF_GearMgmt_WakeUpFinish_Flg
      data tec_GearMgmt_WakeUpFinish_Flg: type=boolean
    IF_HvMgmt_BMSDTC_8bit
      data tec_HvMgmt_BMSDTC_8bit: type=uint8
    IF_HvMgmt_BMSNegRlyActSts_Enum
      data tec_HvMgmt_BMSNegRlyActSts_Enum: type=uint8
    IF_HvMgmt_BMSNegRlyCtrlReq_Flg
      data tec_HvMgmt_BMSNegRlyCtrlReq_Flg: type=boolean
    IF_HvMgmt_BMSNormHvDwnReq_Flg
      data tec_HvMgmt_BMSNormHvDwnReq_Flg: type=boolean
    IF_HvMgmt_BMSPosRlyActSts_Enum
      data tec_HvMgmt_BMSPosRlyActSts_Enum: type=uint8
    IF_HvMgmt_BMSWrkModActSts_Enum
      data tec_HvMgmt_BMSWrkModActSts_Enum: type=uint8
    IF_HvMgmt_DCDCDmdLvUDc_V
      data tec_HvMgmt_DCDCDmdLvUDc_V: type=float32
    IF_HvMgmt_DCDCDTC_8bit
      data tec_HvMgmt_DCDCDTC_8bit: type=uint8
    IF_HvMgmt_DCDCWrkModActSts_Enum
      data tec_HvMgmt_DCDCWrkModActSts_Enum: type=uint8
    IF_HvMgmt_DCFCDTC_8bit
      data tec_HvMgmt_DCFCDTC_8bit: type=uint8
    IF_HvMgmt_DCFCReqSts_Flg
      data tec_HvMgmt_DCFCReqSts_Flg: type=boolean
    IF_HvMgmt_DCFCWrkModActSts_Enum
      data tec_HvMgmt_DCFCWrkModActSts_Enum: type=uint8
    IF_HvMgmt_MCUDTC_8bit
      data tec_HvMgmt_MCUDTC_8bit: type=uint8
    IF_HvMgmt_MCUReqSts_Enum
      data tec_HvMgmt_MCUReqSts_Enum: type=uint8
    IF_HvMgmt_MCUWrkModActSts_Enum
      data tec_HvMgmt_MCUWrkModActSts_Enum: type=uint8
    IF_HvMgmt_ReqDCDCMod_Enum
      data tec_HvMgmt_ReqDCDCMod_Enum: type=uint8
    IF_HvMgmt_ReqModBMS_Flg
      data tec_HvMgmt_ReqModBMS_Flg: type=boolean
    IF_HvMgmt_ReqTCUMod_Enum
      data tec_HvMgmt_ReqTCUMod_Enum: type=uint8
    IF_HvMgmt_TCUDTC_8bit
      data tec_HvMgmt_TCUDTC_8bit: type=uint8
    IF_HvMgmt_TCUWrkModActSts_Enum
      data tec_HvMgmt_TCUWrkModActSts_Enum: type=uint8
    IF_IOAbs_AccrPedlMaiRaw_mV
      data tec_IOAbs_AccrPedlMaiRaw_mV: type=uint16
    IF_IOAbs_AccrPedlRdnRaw_mV
      data tec_IOAbs_AccrPedlRdnRaw_mV: type=uint16
    IF_IOAbs_BrkMaiRaw_Flg
      data tec_IOAbs_BrkMaiRaw_Flg: type=boolean
    IF_IOAbs_BrkRdnRaw_Flg
      data tec_IOAbs_BrkRdnRaw_Flg: type=boolean
    IF_IOAbs_CC2SigUDc_mV
      data tec_IOAbs_CC2SigUDc_mV: type=uint16
    IF_IOAbs_KL15Fb_Flg
      data tec_IOAbs_KL15Fb_Flg: type=boolean
    IF_LvMgmt_EISSDiagDTC_8bit
      data tec_LvMgmt_EISSDiagDTC_8bit: type=uint8
    IF_LvMgmt_IBSBattDiagSts_Enum
      data tec_LvMgmt_IBSBattDiagSts_Enum: type=uint8
    IF_LvMgmt_IBSBattReChrgReq_Flg
      data tec_LvMgmt_IBSBattReChrgReq_Flg: type=boolean
    IF_LvMgmt_KL15ActSts_Flg
      data tec_LvMgmt_KL15ActSts_Flg: type=boolean
    IF_LvMgmt_KL15CtrlReq_Flg
      data tec_LvMgmt_KL15CtrlReq_Flg: type=boolean
    IF_LvMgmt_LvBattMgmtDiagDTC_8bit
      data tec_LvMgmt_LvBattMgmtDiagDTC_8bit: type=uint8
    IF_LvMgmt_LvPwrDwn_Flg
      data tec_LvMgmt_LvPwrDwn_Flg: type=boolean
    IF_LvMgmt_SelfChkSts_Flg
      data tec_LvMgmt_SelfChkSts_Flg: type=boolean
    IF_LvMgmt_StayInRun_Flg
      data tec_LvMgmt_StayInRun_Flg: type=boolean
    IF_LvMgmt_WakeUpReq_Flg
      data tec_LvMgmt_WakeUpReq_Flg: type=boolean
    IF_LvMgmt_WakeUpSrc_Enum
      data tec_LvMgmt_WakeUpSrc_Enum: type=uint8
    IF_ModMgmt_ActDrvMod_Enum
      data tec_ModMgmt_ActDrvMod_Enum: type=uint8
    IF_ModMgmt_DrvModSwtWarn_Flg
      data tec_ModMgmt_DrvModSwtWarn_Flg: type=boolean
    IF_ModMgmt_HvSts_Enum
      data tec_ModMgmt_HvSts_Enum: type=uint8
    IF_ModMgmt_ReqSleep_Flg
      data tec_ModMgmt_ReqSleep_Flg: type=boolean
    IF_ModMgmt_RstCtrl_Flg
      data tec_ModMgmt_RstCtrl_Flg: type=boolean
    IF_ModMgmt_SysRdy_Enum
      data tec_ModMgmt_SysRdy_Enum: type=uint8
    IF_OBCMgmt_AcChrgnSts_Enum
      data tec_OBCMgmt_AcChrgnSts_Enum: type=uint8
    IF_OBCMgmt_ElectcLockCtrlCmd_Enum
      data tec_OBCMgmt_ElectcLockCtrlCmd_Enum: type=uint8
    IF_OBCMgmt_ElectcLockCtrlSts_Enum
      data tec_OBCMgmt_ElectcLockCtrlSts_Enum: type=uint8
    IF_OBCMgmt_ElectcLockStatErrDTC_8bit
      data tec_OBCMgmt_ElectcLockStatErrDTC_8bit: type=uint8
    IF_OBCMgmt_MnyUnlckCmt_Enum
      data tec_OBCMgmt_MnyUnlckCmt_Enum: type=uint8
    IF_OBCMgmt_OBCCtrlErrDTC_8bit
      data tec_OBCMgmt_OBCCtrlErrDTC_8bit: type=uint8
    IF_OBCMgmt_OBCEnaCmd_Enum
      data tec_OBCMgmt_OBCEnaCmd_Enum: type=uint8
    IF_OBCMgmt_OBCOutpCpbyIDc_A
      data tec_OBCMgmt_OBCOutpCpbyIDc_A: type=float32
    IF_OBCMgmt_ReqOBCIDc_A
      data tec_OBCMgmt_ReqOBCIDc_A: type=float32
    IF_OBCMgmt_S2SwtCtrlCmd_Enum
      data tec_OBCMgmt_S2SwtCtrlCmd_Enum: type=uint8
    IF_OBCMgmt_S2SwtCtrlErrDTC_8bit
      data tec_OBCMgmt_S2SwtCtrlErrDTC_8bit: type=uint8
    IF_OBCMgmt_S2SwtCtrlSts_Enum
      data tec_OBCMgmt_S2SwtCtrlSts_Enum: type=uint8
    IF_TorqPahMgmt_DesCoorTq_Nm
      data tec_TorqPahMgmt_DesCoorTq_Nm: type=float32
    IF_TorqPahMgmt_DesFildTq_Nm
      data tec_TorqPahMgmt_DesFildTq_Nm: type=float32
    IF_TorqPahMgmt_DesLpFildTq_Nm
      data tec_TorqPahMgmt_DesLpFildTq_Nm: type=float32
    IF_TorqPahMgmt_DesMotSpd_rpm
      data tec_TorqPahMgmt_DesMotSpd_rpm: type=float32
    IF_TorqPahMgmt_DesMotTq_Nm
      data tec_TorqPahMgmt_DesMotTq_Nm: type=float32
    IF_TorqPahMgmt_EmacDynMaxTq_Nm
      data tec_TorqPahMgmt_EmacDynMaxTq_Nm: type=float32
    IF_TorqPahMgmt_EmacDynMinTq_Nm
      data tec_TorqPahMgmt_EmacDynMinTq_Nm: type=float32
    IF_TorqPahMgmt_EmacQstyMaxTq_Nm
      data tec_TorqPahMgmt_EmacQstyMaxTq_Nm: type=float32
    IF_TorqPahMgmt_EmacQstyMinTq_Nm
      data tec_TorqPahMgmt_EmacQstyMinTq_Nm: type=float32
    IF_TorqPahMgmt_FwdMaxSpdSts_Flg
      data tec_TorqPahMgmt_FwdMaxSpdSts_Flg: type=boolean
    IF_TorqPahMgmt_FwdMaxVehSpd_kph
      data tec_TorqPahMgmt_FwdMaxVehSpd_kph: type=float32
    IF_TorqPahMgmt_IBSIntvTqSts_Enum
      data tec_TorqPahMgmt_IBSIntvTqSts_Enum: type=uint8
    IF_TorqPahMgmt_ReqMotDampSts_Enum
      data tec_TorqPahMgmt_ReqMotDampSts_Enum: type=uint8
    IF_TorqPahMgmt_ReqMotDampThdTq_Nm
      data tec_TorqPahMgmt_ReqMotDampThdTq_Nm: type=float32
    IF_TorqPahMgmt_TramProtdLimMaxTq_Nm
      data tec_TorqPahMgmt_TramProtdLmtMaxTq_Nm: type=float32
    IF_TorqPahMgmt_TramProtdLimMinTq_Nm
      data tec_TorqPahMgmt_TramProtdLmtMinTq_Nm: type=float32
    IF_TorqPahMgmt_TramProtdLmtMaxTq_Nm
      data tec_TorqPahMgmt_TramProtdLmtMaxTq_Nm: type=float32
    IF_TorqPahMgmt_TramProtdLmtMinTq_Nm
      data tec_TorqPahMgmt_TramProtdLmtMinTq_Nm: type=float32
    IF_TorqPahMgmt_VehSpdLmtSts_Flg
      data tec_TorqPahMgmt_VehSpdLmtSts_Flg: type=boolean
    IF_TorqPahMgmt_VehSpdLmtTq_Nm
      data tec_TorqPahMgmt_VehSpdLmtTq_Nm: type=float32
    IF_VehMot_Acclr2Tq_Nm
      data tec_VehMot_Acclr2Tq_Nm: type=float32
    IF_VehMot_AcclrPrpCurr_mps2q
      data tec_VehMot_AcclrPrpCurr_mps2q: type=float32
    IF_VehMot_AcclrPrpMax_mps2q
      data tec_VehMot_AcclrPrpMax_mps2q: type=float32
    IF_VehMot_AcclrPrpMin_mps2q
      data tec_VehMot_AcclrPrpMin_mps2q: type=float32
    IF_VehMot_SlopGrd_deg
      data tec_VehMot_SlopGrd_deg: type=sint8
    IF_VehMot_VehDirDif_Flg
      data tec_VehMot_VehDirDif_Flg: type=boolean
    IF_VehMot_VehDragTq_Nm
      data tec_VehMot_VehDragTq_Nm: type=float32
    IF_VehMot_VehSpd_kph
      data tec_VehMot_VehSpd_kph: type=float32
    IF_VehMot_VehSpdABS_kph
      data tec_VehMot_VehSpdABS_kph: type=float32
    IF_VehMot_VehSpdAcclr_mps2q
      data tec_VehMot_VehSpdAcclr_mps2q: type=float32
    IF_VehMot_VehSpdVld_Flg
      data tec_VehMot_VehSpdVld_Flg: type=boolean
    IF_GearMgmt_WakeUpFinsh_Flg
      data tec_GearMgmt_WakeUpFinsh_Flg: type=boolean
package /Predefined_DEV/PortInterfaces
  43 x client server interface:
    NvMAdministration: is-service=true
      operation SetBlockProtection: possible-error=NvMAdministration/E_NOT_OK
        arg ProtectionEnabled: type=boolean, direction=IN, server-argument-impl-policy=USE-ARGUMENT-TYPE
      error E_NOT_OK: error-code=1
    NvMNotifyInitBlock: is-service=true
      operation InitBlock
    NvMNotifyJobFinished: is-service=true
      operation JobFinished
        arg ServiceId: type=NvM_ServiceIdType, direction=IN, server-argument-impl-policy=USE-ARGUMENT-TYPE
        arg JobResult: type=NvM_RequestResultType, direction=IN, server-argument-impl-policy=USE-ARGUMENT-TYPE
    NvMService: is-service=true
      operation GetErrorStatus: possible-error=NvMService/E_NOT_OK
        arg ErrorStatus: type=NvM_RequestResultType, direction=OUT, server-argument-impl-policy=USE-ARGUMENT-TYPE
      error E_NOT_OK: error-code=1
    NvMService_AC2: is-service=true
      operation GetErrorStatus: possible-error=NvMService_AC2/E_NOT_OK
        arg ErrorStatus: type=NvM_RequestResultType, direction=OUT, server-argument-impl-policy=USE-ARGUMENT-TYPE
      operation ReadBlock: possible-error=NvMService_AC2/E_NOT_OK
        arg DstPtr: type=dtRef_VOID, direction=IN, server-argument-impl-policy=USE-ARGUMENT-TYPE
      operation WriteBlock: possible-error=NvMService_AC2/E_NOT_OK
        arg SrcPtr: type=dtRef_const_VOID, direction=IN, server-argument-impl-policy=USE-ARGUMENT-TYPE
      error E_NOT_OK: error-code=1
    NvMService_AC2_Defs: is-service=true
      4 x operation, all with possible-error=NvMService_AC2_Defs/E_NOT_OK:
        GetErrorStatus
          arg ErrorStatus: type=NvM_RequestResultType, direction=OUT, server-argument-impl-policy=USE-ARGUMENT-TYPE
        ReadBlock
          arg DstPtr: type=dtRef_VOID, direction=IN, server-argument-impl-policy=USE-ARGUMENT-TYPE
        RestoreBlockDefaults
          arg DstPtr: type=dtRef_VOID, direction=IN, server-argument-impl-policy=USE-ARGUMENT-TYPE
        WriteBlock
          arg SrcPtr: type=dtRef_const_VOID, direction=IN, server-argument-impl-policy=USE-ARGUMENT-TYPE
      error E_NOT_OK: error-code=1
    NvMService_AC2_DS: is-service=true
      5 x operation, all with possible-error=NvMService_AC2_DS/E_NOT_OK:
        GetDataIndex
          arg DataIndex: type=uint8, direction=OUT, server-argument-impl-policy=USE-ARGUMENT-TYPE
        GetErrorStatus
          arg ErrorStatus: type=NvM_RequestResultType, direction=OUT, server-argument-impl-policy=USE-ARGUMENT-TYPE
        ReadBlock
          arg DstPtr: type=dtRef_VOID, direction=IN, server-argument-impl-policy=USE-ARGUMENT-TYPE
        SetDataIndex
          arg DataIndex: type=uint8, direction=IN, server-argument-impl-policy=USE-ARGUMENT-TYPE
        WriteBlock
          arg SrcPtr: type=dtRef_const_VOID, direction=IN, server-argument-impl-policy=USE-ARGUMENT-TYPE
      error E_NOT_OK: error-code=1
    NvMService_AC2_DS_Defs: is-service=true
      6 x operation, all with possible-error=NvMService_AC2_DS_Defs/E_NOT_OK:
        GetDataIndex
          arg DataIndex: type=uint8, direction=OUT, server-argument-impl-policy=USE-ARGUMENT-TYPE
        GetErrorStatus
          arg ErrorStatus: type=NvM_RequestResultType, direction=OUT, server-argument-impl-policy=USE-ARGUMENT-TYPE
        ReadBlock
          arg DstPtr: type=dtRef_VOID, direction=IN, server-argument-impl-policy=USE-ARGUMENT-TYPE
        RestoreBlockDefaults
          arg DstPtr: type=dtRef_VOID, direction=IN, server-argument-impl-policy=USE-ARGUMENT-TYPE
        SetDataIndex
          arg DataIndex: type=uint8, direction=IN, server-argument-impl-policy=USE-ARGUMENT-TYPE
        WriteBlock
          arg SrcPtr: type=dtRef_const_VOID, direction=IN, server-argument-impl-policy=USE-ARGUMENT-TYPE
      error E_NOT_OK: error-code=1
    NvMService_AC2_SRBS: is-service=true
      4 x operation, all with possible-error=NvMService_AC2_SRBS/E_NOT_OK:
        GetErrorStatus
          arg ErrorStatus: type=NvM_RequestResultType, direction=OUT, server-argument-impl-policy=USE-ARGUMENT-TYPE
        ReadBlock
          arg DstPtr: type=dtRef_VOID, direction=IN, server-argument-impl-policy=USE-ARGUMENT-TYPE
        SetRamBlockStatus
          arg RamBlockStatus: type=boolean, direction=IN, server-argument-impl-policy=USE-ARGUMENT-TYPE
        WriteBlock
          arg SrcPtr: type=dtRef_const_VOID, direction=IN, server-argument-impl-policy=USE-ARGUMENT-TYPE
      error E_NOT_OK: error-code=1
    NvMService_AC2_SRBS_Defs: is-service=true
      5 x operation, all with possible-error=NvMService_AC2_SRBS_Defs/E_NOT_OK:
        GetErrorStatus
          arg ErrorStatus: type=NvM_RequestResultType, direction=OUT, server-argument-impl-policy=USE-ARGUMENT-TYPE
        ReadBlock
          arg DstPtr: type=dtRef_VOID, direction=IN, server-argument-impl-policy=USE-ARGUMENT-TYPE
        RestoreBlockDefaults
          arg DstPtr: type=dtRef_VOID, direction=IN, server-argument-impl-policy=USE-ARGUMENT-TYPE
        SetRamBlockStatus
          arg RamBlockStatus: type=boolean, direction=IN, server-argument-impl-policy=USE-ARGUMENT-TYPE
        WriteBlock
          arg SrcPtr: type=dtRef_const_VOID, direction=IN, server-argument-impl-policy=USE-ARGUMENT-TYPE
      error E_NOT_OK: error-code=1
    NvMService_AC2_SRBS_DS: is-service=true
      6 x operation, all with possible-error=NvMService_AC2_SRBS_DS/E_NOT_OK:
        GetDataIndex
          arg DataIndex: type=uint8, direction=OUT, server-argument-impl-policy=USE-ARGUMENT-TYPE
        GetErrorStatus
          arg ErrorStatus: type=NvM_RequestResultType, direction=OUT, server-argument-impl-policy=USE-ARGUMENT-TYPE
        ReadBlock
          arg DstPtr: type=dtRef_VOID, direction=IN, server-argument-impl-policy=USE-ARGUMENT-TYPE
        SetDataIndex
          arg DataIndex: type=uint8, direction=IN, server-argument-impl-policy=USE-ARGUMENT-TYPE
        SetRamBlockStatus
          arg RamBlockStatus: type=boolean, direction=IN, server-argument-impl-policy=USE-ARGUMENT-TYPE
        WriteBlock
          arg SrcPtr: type=dtRef_const_VOID, direction=IN, server-argument-impl-policy=USE-ARGUMENT-TYPE
      error E_NOT_OK: error-code=1
    NvMService_AC2_SRBS_DS_Defs: is-service=true
      7 x operation, all with possible-error=NvMService_AC2_SRBS_DS_Defs/E_NOT_OK:
        GetDataIndex
          arg DataIndex: type=uint8, direction=OUT, server-argument-impl-policy=USE-ARGUMENT-TYPE
        GetErrorStatus
          arg ErrorStatus: type=NvM_RequestResultType, direction=OUT, server-argument-impl-policy=USE-ARGUMENT-TYPE
        ReadBlock
          arg DstPtr: type=dtRef_VOID, direction=IN, server-argument-impl-policy=USE-ARGUMENT-TYPE
        RestoreBlockDefaults
          arg DstPtr: type=dtRef_VOID, direction=IN, server-argument-impl-policy=USE-ARGUMENT-TYPE
        SetDataIndex
          arg DataIndex: type=uint8, direction=IN, server-argument-impl-policy=USE-ARGUMENT-TYPE
        SetRamBlockStatus
          arg RamBlockStatus: type=boolean, direction=IN, server-argument-impl-policy=USE-ARGUMENT-TYPE
        WriteBlock
          arg SrcPtr: type=dtRef_const_VOID, direction=IN, server-argument-impl-policy=USE-ARGUMENT-TYPE
      error E_NOT_OK: error-code=1
    NvMService_AC3: is-service=true
      5 x operation, all with possible-error=NvMService_AC3/E_NOT_OK:
        EraseBlock
        GetErrorStatus
          arg ErrorStatus: type=NvM_RequestResultType, direction=OUT, server-argument-impl-policy=USE-ARGUMENT-TYPE
        InvalidateNvBlock
        ReadBlock
          arg DstPtr: type=dtRef_VOID, direction=IN, server-argument-impl-policy=USE-ARGUMENT-TYPE
        WriteBlock
          arg SrcPtr: type=dtRef_const_VOID, direction=IN, server-argument-impl-policy=USE-ARGUMENT-TYPE
      error E_NOT_OK: error-code=1
    NvMService_AC3_Defs: is-service=true
      6 x operation, all with possible-error=NvMService_AC3_Defs/E_NOT_OK:
        EraseBlock
        GetErrorStatus
          arg ErrorStatus: type=NvM_RequestResultType, direction=OUT, server-argument-impl-policy=USE-ARGUMENT-TYPE
        InvalidateNvBlock
        ReadBlock
          arg DstPtr: type=dtRef_VOID, direction=IN, server-argument-impl-policy=USE-ARGUMENT-TYPE
        RestoreBlockDefaults
          arg DstPtr: type=dtRef_VOID, direction=IN, server-argument-impl-policy=USE-ARGUMENT-TYPE
        WriteBlock
          arg SrcPtr: type=dtRef_const_VOID, direction=IN, server-argument-impl-policy=USE-ARGUMENT-TYPE
      error E_NOT_OK: error-code=1
    NvMService_AC3_DS: is-service=true
      7 x operation, all with possible-error=NvMService_AC3_DS/E_NOT_OK:
        EraseBlock
        GetDataIndex
          arg DataIndex: type=uint8, direction=OUT, server-argument-impl-policy=USE-ARGUMENT-TYPE
        GetErrorStatus
          arg ErrorStatus: type=NvM_RequestResultType, direction=OUT, server-argument-impl-policy=USE-ARGUMENT-TYPE
        InvalidateNvBlock
        ReadBlock
          arg DstPtr: type=dtRef_VOID, direction=IN, server-argument-impl-policy=USE-ARGUMENT-TYPE
        SetDataIndex
          arg DataIndex: type=uint8, direction=IN, server-argument-impl-policy=USE-ARGUMENT-TYPE
        WriteBlock
          arg SrcPtr: type=dtRef_const_VOID, direction=IN, server-argument-impl-policy=USE-ARGUMENT-TYPE
      error E_NOT_OK: error-code=1
    NvMService_AC3_DS_Defs: is-service=true
      8 x operation, all with possible-error=NvMService_AC3_DS_Defs/E_NOT_OK:
        EraseBlock
        GetDataIndex
          arg DataIndex: type=uint8, direction=OUT, server-argument-impl-policy=USE-ARGUMENT-TYPE
        GetErrorStatus
          arg ErrorStatus: type=NvM_RequestResultType, direction=OUT, server-argument-impl-policy=USE-ARGUMENT-TYPE
        InvalidateNvBlock
        ReadBlock
          arg DstPtr: type=dtRef_VOID, direction=IN, server-argument-impl-policy=USE-ARGUMENT-TYPE
        RestoreBlockDefaults
          arg DstPtr: type=dtRef_VOID, direction=IN, server-argument-impl-policy=USE-ARGUMENT-TYPE
        SetDataIndex
          arg DataIndex: type=uint8, direction=IN, server-argument-impl-policy=USE-ARGUMENT-TYPE
        WriteBlock
          arg SrcPtr: type=dtRef_const_VOID, direction=IN, server-argument-impl-policy=USE-ARGUMENT-TYPE
      error E_NOT_OK: error-code=1
    NvMService_AC3_SRBS: is-service=true
      6 x operation, all with possible-error=NvMService_AC3_SRBS/E_NOT_OK:
        EraseBlock
        GetErrorStatus
          arg ErrorStatus: type=NvM_RequestResultType, direction=OUT, server-argument-impl-policy=USE-ARGUMENT-TYPE
        InvalidateNvBlock
        ReadBlock
          arg DstPtr: type=dtRef_VOID, direction=IN, server-argument-impl-policy=USE-ARGUMENT-TYPE
        SetRamBlockStatus
          arg RamBlockStatus: type=boolean, direction=IN, server-argument-impl-policy=USE-ARGUMENT-TYPE
        WriteBlock
          arg SrcPtr: type=dtRef_const_VOID, direction=IN, server-argument-impl-policy=USE-ARGUMENT-TYPE
      error E_NOT_OK: error-code=1
    NvMService_AC3_SRBS_Defs: is-service=true
      7 x operation, all with possible-error=NvMService_AC3_SRBS_Defs/E_NOT_OK:
        EraseBlock
        GetErrorStatus
          arg ErrorStatus: type=NvM_RequestResultType, direction=OUT, server-argument-impl-policy=USE-ARGUMENT-TYPE
        InvalidateNvBlock
        ReadBlock
          arg DstPtr: type=dtRef_VOID, direction=IN, server-argument-impl-policy=USE-ARGUMENT-TYPE
        RestoreBlockDefaults
          arg DstPtr: type=dtRef_VOID, direction=IN, server-argument-impl-policy=USE-ARGUMENT-TYPE
        SetRamBlockStatus
          arg RamBlockStatus: type=boolean, direction=IN, server-argument-impl-policy=USE-ARGUMENT-TYPE
        WriteBlock
          arg SrcPtr: type=dtRef_const_VOID, direction=IN, server-argument-impl-policy=USE-ARGUMENT-TYPE
      error E_NOT_OK: error-code=1
    NvMService_AC3_SRBS_DS: is-service=true
      8 x operation, all with possible-error=NvMService_AC3_SRBS_DS/E_NOT_OK:
        EraseBlock
        GetDataIndex
          arg DataIndex: type=uint8, direction=OUT, server-argument-impl-policy=USE-ARGUMENT-TYPE
        GetErrorStatus
          arg ErrorStatus: type=NvM_RequestResultType, direction=OUT, server-argument-impl-policy=USE-ARGUMENT-TYPE
        InvalidateNvBlock
        ReadBlock
          arg DstPtr: type=dtRef_VOID, direction=IN, server-argument-impl-policy=USE-ARGUMENT-TYPE
        SetDataIndex
          arg DataIndex: type=uint8, direction=IN, server-argument-impl-policy=USE-ARGUMENT-TYPE
        SetRamBlockStatus
          arg RamBlockStatus: type=boolean, direction=IN, server-argument-impl-policy=USE-ARGUMENT-TYPE
        WriteBlock
          arg SrcPtr: type=dtRef_const_VOID, direction=IN, server-argument-impl-policy=USE-ARGUMENT-TYPE
      error E_NOT_OK: error-code=1
    NvMService_AC3_SRBS_DS_Defs: is-service=true
      9 x operation, all with possible-error=NvMService_AC3_SRBS_DS_Defs/E_NOT_OK:
        EraseBlock
        GetDataIndex
          arg DataIndex: type=uint8, direction=OUT, server-argument-impl-policy=USE-ARGUMENT-TYPE
        GetErrorStatus
          arg ErrorStatus: type=NvM_RequestResultType, direction=OUT, server-argument-impl-policy=USE-ARGUMENT-TYPE
        InvalidateNvBlock
        ReadBlock
          arg DstPtr: type=dtRef_VOID, direction=IN, server-argument-impl-policy=USE-ARGUMENT-TYPE
        RestoreBlockDefaults
          arg DstPtr: type=dtRef_VOID, direction=IN, server-argument-impl-policy=USE-ARGUMENT-TYPE
        SetDataIndex
          arg DataIndex: type=uint8, direction=IN, server-argument-impl-policy=USE-ARGUMENT-TYPE
        SetRamBlockStatus
          arg RamBlockStatus: type=boolean, direction=IN, server-argument-impl-policy=USE-ARGUMENT-TYPE
        WriteBlock
          arg SrcPtr: type=dtRef_const_VOID, direction=IN, server-argument-impl-policy=USE-ARGUMENT-TYPE
      error E_NOT_OK: error-code=1
    NvMService_SRBS: is-service=true
      operation GetErrorStatus: possible-error=NvMService_SRBS/E_NOT_OK
        arg ErrorStatus: type=NvM_RequestResultType, direction=OUT, server-argument-impl-policy=USE-ARGUMENT-TYPE
      operation SetRamBlockStatus: possible-error=NvMService_SRBS/E_NOT_OK
        arg RamBlockStatus: type=boolean, direction=IN, server-argument-impl-policy=USE-ARGUMENT-TYPE
      error E_NOT_OK: error-code=1
    CallbackDTCStatusChange: is-service=true, service-kind=DIAGNOSTIC-EVENT-MANAGER
      operation DTCStatusChanged: possible-error=CallbackDTCStatusChange/E_NOT_OK
        arg DTC: type=uint32, direction=IN, server-argument-impl-policy=USE-ARGUMENT-TYPE
        arg DTCStatusOld: type=Dem_UdsStatusByteType, direction=IN, server-argument-impl-policy=USE-ARGUMENT-TYPE
        arg DTCStatusNew: type=Dem_UdsStatusByteType, direction=IN, server-argument-impl-policy=USE-ARGUMENT-TYPE
      error E_NOT_OK: error-code=1
    NvSWC_NvMAdministration
      operation SetBlockProtection: possible-error=NvSWC_NvMAdministration/E_NOT_OK
        arg ProtectionEnabled: type=boolean, direction=IN, server-argument-impl-policy=USE-ARGUMENT-TYPE
      error E_NOT_OK: error-code=1
    NvSWC_NvMNotifyInitBlock
      operation InitBlock
    NvSWC_NvMNotifyJobFinished
      operation JobFinished
        arg ServiceId: type=NvM_ServiceIdType, direction=IN, server-argument-impl-policy=USE-ARGUMENT-TYPE
        arg JobResult: type=NvM_RequestResultType, direction=IN, server-argument-impl-policy=USE-ARGUMENT-TYPE
    NvSWC_NvMService
      operation GetErrorStatus: possible-error=NvSWC_NvMService/E_NOT_OK
        arg ErrorStatus: type=NvM_RequestResultType, direction=OUT, server-argument-impl-policy=USE-ARGUMENT-TYPE
      error E_NOT_OK: error-code=1
    NvSWC_NvMService_AC2
      operation GetErrorStatus: possible-error=NvSWC_NvMService_AC2/E_NOT_OK
        arg ErrorStatus: type=NvM_RequestResultType, direction=OUT, server-argument-impl-policy=USE-ARGUMENT-TYPE
      operation ReadBlock: possible-error=NvSWC_NvMService_AC2/E_NOT_OK
        arg DstPtr: type=dtRef_VOID, direction=IN, server-argument-impl-policy=USE-ARGUMENT-TYPE
      operation WriteBlock: possible-error=NvSWC_NvMService_AC2/E_NOT_OK
        arg SrcPtr: type=dtRef_const_VOID, direction=IN, server-argument-impl-policy=USE-ARGUMENT-TYPE
      error E_NOT_OK: error-code=1
    NvSWC_NvMService_AC2_Defs
      4 x operation, all with possible-error=NvSWC_NvMService_AC2_Defs/E_NOT_OK:
        GetErrorStatus
          arg ErrorStatus: type=NvM_RequestResultType, direction=OUT, server-argument-impl-policy=USE-ARGUMENT-TYPE
        ReadBlock
          arg DstPtr: type=dtRef_VOID, direction=IN, server-argument-impl-policy=USE-ARGUMENT-TYPE
        RestoreBlockDefaults
          arg DstPtr: type=dtRef_VOID, direction=IN, server-argument-impl-policy=USE-ARGUMENT-TYPE
        WriteBlock
          arg SrcPtr: type=dtRef_const_VOID, direction=IN, server-argument-impl-policy=USE-ARGUMENT-TYPE
      error E_NOT_OK: error-code=1
    NvSWC_NvMService_AC2_DS
      5 x operation, all with possible-error=NvSWC_NvMService_AC2_DS/E_NOT_OK:
        GetDataIndex
          arg DataIndex: type=uint8, direction=OUT, server-argument-impl-policy=USE-ARGUMENT-TYPE
        GetErrorStatus
          arg ErrorStatus: type=NvM_RequestResultType, direction=OUT, server-argument-impl-policy=USE-ARGUMENT-TYPE
        ReadBlock
          arg DstPtr: type=dtRef_VOID, direction=IN, server-argument-impl-policy=USE-ARGUMENT-TYPE
        SetDataIndex
          arg DataIndex: type=uint8, direction=IN, server-argument-impl-policy=USE-ARGUMENT-TYPE
        WriteBlock
          arg SrcPtr: type=dtRef_const_VOID, direction=IN, server-argument-impl-policy=USE-ARGUMENT-TYPE
      error E_NOT_OK: error-code=1
    NvSWC_NvMService_AC2_DS_Defs
      6 x operation, all with possible-error=NvSWC_NvMService_AC2_DS_Defs/E_NOT_OK:
        GetDataIndex
          arg DataIndex: type=uint8, direction=OUT, server-argument-impl-policy=USE-ARGUMENT-TYPE
        GetErrorStatus
          arg ErrorStatus: type=NvM_RequestResultType, direction=OUT, server-argument-impl-policy=USE-ARGUMENT-TYPE
        ReadBlock
          arg DstPtr: type=dtRef_VOID, direction=IN, server-argument-impl-policy=USE-ARGUMENT-TYPE
        RestoreBlockDefaults
          arg DstPtr: type=dtRef_VOID, direction=IN, server-argument-impl-policy=USE-ARGUMENT-TYPE
        SetDataIndex
          arg DataIndex: type=uint8, direction=IN, server-argument-impl-policy=USE-ARGUMENT-TYPE
        WriteBlock
          arg SrcPtr: type=dtRef_const_VOID, direction=IN, server-argument-impl-policy=USE-ARGUMENT-TYPE
      error E_NOT_OK: error-code=1
    NvSWC_NvMService_AC2_SRBS
      4 x operation, all with possible-error=NvSWC_NvMService_AC2_SRBS/E_NOT_OK:
        GetErrorStatus
          arg ErrorStatus: type=NvM_RequestResultType, direction=OUT, server-argument-impl-policy=USE-ARGUMENT-TYPE
        ReadBlock
          arg DstPtr: type=dtRef_VOID, direction=IN, server-argument-impl-policy=USE-ARGUMENT-TYPE
        SetRamBlockStatus
          arg RamBlockStatus: type=boolean, direction=IN, server-argument-impl-policy=USE-ARGUMENT-TYPE
        WriteBlock
          arg SrcPtr: type=dtRef_const_VOID, direction=IN, server-argument-impl-policy=USE-ARGUMENT-TYPE
      error E_NOT_OK: error-code=1
    NvSWC_NvMService_AC2_SRBS_Defs
      5 x operation, all with possible-error=NvSWC_NvMService_AC2_SRBS_Defs/E_NOT_OK:
        GetErrorStatus
          arg ErrorStatus: type=NvM_RequestResultType, direction=OUT, server-argument-impl-policy=USE-ARGUMENT-TYPE
        ReadBlock
          arg DstPtr: type=dtRef_VOID, direction=IN, server-argument-impl-policy=USE-ARGUMENT-TYPE
        RestoreBlockDefaults
          arg DstPtr: type=dtRef_VOID, direction=IN, server-argument-impl-policy=USE-ARGUMENT-TYPE
        SetRamBlockStatus
          arg RamBlockStatus: type=boolean, direction=IN, server-argument-impl-policy=USE-ARGUMENT-TYPE
        WriteBlock
          arg SrcPtr: type=dtRef_const_VOID, direction=IN, server-argument-impl-policy=USE-ARGUMENT-TYPE
      error E_NOT_OK: error-code=1
    NvSWC_NvMService_AC2_SRBS_DS
      6 x operation, all with possible-error=NvSWC_NvMService_AC2_SRBS_DS/E_NOT_OK:
        GetDataIndex
          arg DataIndex: type=uint8, direction=OUT, server-argument-impl-policy=USE-ARGUMENT-TYPE
        GetErrorStatus
          arg ErrorStatus: type=NvM_RequestResultType, direction=OUT, server-argument-impl-policy=USE-ARGUMENT-TYPE
        ReadBlock
          arg DstPtr: type=dtRef_VOID, direction=IN, server-argument-impl-policy=USE-ARGUMENT-TYPE
        SetDataIndex
          arg DataIndex: type=uint8, direction=IN, server-argument-impl-policy=USE-ARGUMENT-TYPE
        SetRamBlockStatus
          arg RamBlockStatus: type=boolean, direction=IN, server-argument-impl-policy=USE-ARGUMENT-TYPE
        WriteBlock
          arg SrcPtr: type=dtRef_const_VOID, direction=IN, server-argument-impl-policy=USE-ARGUMENT-TYPE
      error E_NOT_OK: error-code=1
    NvSWC_NvMService_AC2_SRBS_DS_Defs
      7 x operation, all with possible-error=NvSWC_NvMService_AC2_SRBS_DS_Defs/E_NOT_OK:
        GetDataIndex
          arg DataIndex: type=uint8, direction=OUT, server-argument-impl-policy=USE-ARGUMENT-TYPE
        GetErrorStatus
          arg ErrorStatus: type=NvM_RequestResultType, direction=OUT, server-argument-impl-policy=USE-ARGUMENT-TYPE
        ReadBlock
          arg DstPtr: type=dtRef_VOID, direction=IN, server-argument-impl-policy=USE-ARGUMENT-TYPE
        RestoreBlockDefaults
          arg DstPtr: type=dtRef_VOID, direction=IN, server-argument-impl-policy=USE-ARGUMENT-TYPE
        SetDataIndex
          arg DataIndex: type=uint8, direction=IN, server-argument-impl-policy=USE-ARGUMENT-TYPE
        SetRamBlockStatus
          arg RamBlockStatus: type=boolean, direction=IN, server-argument-impl-policy=USE-ARGUMENT-TYPE
        WriteBlock
          arg SrcPtr: type=dtRef_const_VOID, direction=IN, server-argument-impl-policy=USE-ARGUMENT-TYPE
      error E_NOT_OK: error-code=1
    NvSWC_NvMService_AC3
      5 x operation, all with possible-error=NvSWC_NvMService_AC3/E_NOT_OK:
        EraseBlock
        GetErrorStatus
          arg ErrorStatus: type=NvM_RequestResultType, direction=OUT, server-argument-impl-policy=USE-ARGUMENT-TYPE
        InvalidateNvBlock
        ReadBlock
          arg DstPtr: type=dtRef_VOID, direction=IN, server-argument-impl-policy=USE-ARGUMENT-TYPE
        WriteBlock
          arg SrcPtr: type=dtRef_const_VOID, direction=IN, server-argument-impl-policy=USE-ARGUMENT-TYPE
      error E_NOT_OK: error-code=1
    NvSWC_NvMService_AC3_Defs
      6 x operation, all with possible-error=NvSWC_NvMService_AC3_Defs/E_NOT_OK:
        EraseBlock
        GetErrorStatus
          arg ErrorStatus: type=NvM_RequestResultType, direction=OUT, server-argument-impl-policy=USE-ARGUMENT-TYPE
        InvalidateNvBlock
        ReadBlock
          arg DstPtr: type=dtRef_VOID, direction=IN, server-argument-impl-policy=USE-ARGUMENT-TYPE
        RestoreBlockDefaults
          arg DstPtr: type=dtRef_VOID, direction=IN, server-argument-impl-policy=USE-ARGUMENT-TYPE
        WriteBlock
          arg SrcPtr: type=dtRef_const_VOID, direction=IN, server-argument-impl-policy=USE-ARGUMENT-TYPE
      error E_NOT_OK: error-code=1
    NvSWC_NvMService_AC3_DS
      7 x operation, all with possible-error=NvSWC_NvMService_AC3_DS/E_NOT_OK:
        EraseBlock
        GetDataIndex
          arg DataIndex: type=uint8, direction=OUT, server-argument-impl-policy=USE-ARGUMENT-TYPE
        GetErrorStatus
          arg ErrorStatus: type=NvM_RequestResultType, direction=OUT, server-argument-impl-policy=USE-ARGUMENT-TYPE
        InvalidateNvBlock
        ReadBlock
          arg DstPtr: type=dtRef_VOID, direction=IN, server-argument-impl-policy=USE-ARGUMENT-TYPE
        SetDataIndex
          arg DataIndex: type=uint8, direction=IN, server-argument-impl-policy=USE-ARGUMENT-TYPE
        WriteBlock
          arg SrcPtr: type=dtRef_const_VOID, direction=IN, server-argument-impl-policy=USE-ARGUMENT-TYPE
      error E_NOT_OK: error-code=1
    NvSWC_NvMService_AC3_DS_Defs
      8 x operation, all with possible-error=NvSWC_NvMService_AC3_DS_Defs/E_NOT_OK:
        EraseBlock
        GetDataIndex
          arg DataIndex: type=uint8, direction=OUT, server-argument-impl-policy=USE-ARGUMENT-TYPE
        GetErrorStatus
          arg ErrorStatus: type=NvM_RequestResultType, direction=OUT, server-argument-impl-policy=USE-ARGUMENT-TYPE
        InvalidateNvBlock
        ReadBlock
          arg DstPtr: type=dtRef_VOID, direction=IN, server-argument-impl-policy=USE-ARGUMENT-TYPE
        RestoreBlockDefaults
          arg DstPtr: type=dtRef_VOID, direction=IN, server-argument-impl-policy=USE-ARGUMENT-TYPE
        SetDataIndex
          arg DataIndex: type=uint8, direction=IN, server-argument-impl-policy=USE-ARGUMENT-TYPE
        WriteBlock
          arg SrcPtr: type=dtRef_const_VOID, direction=IN, server-argument-impl-policy=USE-ARGUMENT-TYPE
      error E_NOT_OK: error-code=1
    NvSWC_NvMService_AC3_SRBS
      6 x operation, all with possible-error=NvSWC_NvMService_AC3_SRBS/E_NOT_OK:
        EraseBlock
        GetErrorStatus
          arg ErrorStatus: type=NvM_RequestResultType, direction=OUT, server-argument-impl-policy=USE-ARGUMENT-TYPE
        InvalidateNvBlock
        ReadBlock
          arg DstPtr: type=dtRef_VOID, direction=IN, server-argument-impl-policy=USE-ARGUMENT-TYPE
        SetRamBlockStatus
          arg RamBlockStatus: type=boolean, direction=IN, server-argument-impl-policy=USE-ARGUMENT-TYPE
        WriteBlock
          arg SrcPtr: type=dtRef_const_VOID, direction=IN, server-argument-impl-policy=USE-ARGUMENT-TYPE
      error E_NOT_OK: error-code=1
    NvSWC_NvMService_AC3_SRBS_Defs
      7 x operation, all with possible-error=NvSWC_NvMService_AC3_SRBS_Defs/E_NOT_OK:
        EraseBlock
        GetErrorStatus
          arg ErrorStatus: type=NvM_RequestResultType, direction=OUT, server-argument-impl-policy=USE-ARGUMENT-TYPE
        InvalidateNvBlock
        ReadBlock
          arg DstPtr: type=dtRef_VOID, direction=IN, server-argument-impl-policy=USE-ARGUMENT-TYPE
        RestoreBlockDefaults
          arg DstPtr: type=dtRef_VOID, direction=IN, server-argument-impl-policy=USE-ARGUMENT-TYPE
        SetRamBlockStatus
          arg RamBlockStatus: type=boolean, direction=IN, server-argument-impl-policy=USE-ARGUMENT-TYPE
        WriteBlock
          arg SrcPtr: type=dtRef_const_VOID, direction=IN, server-argument-impl-policy=USE-ARGUMENT-TYPE
      error E_NOT_OK: error-code=1
    NvSWC_NvMService_AC3_SRBS_DS
      8 x operation, all with possible-error=NvSWC_NvMService_AC3_SRBS_DS/E_NOT_OK:
        EraseBlock
        GetDataIndex
          arg DataIndex: type=uint8, direction=OUT, server-argument-impl-policy=USE-ARGUMENT-TYPE
        GetErrorStatus
          arg ErrorStatus: type=NvM_RequestResultType, direction=OUT, server-argument-impl-policy=USE-ARGUMENT-TYPE
        InvalidateNvBlock
        ReadBlock
          arg DstPtr: type=dtRef_VOID, direction=IN, server-argument-impl-policy=USE-ARGUMENT-TYPE
        SetDataIndex
          arg DataIndex: type=uint8, direction=IN, server-argument-impl-policy=USE-ARGUMENT-TYPE
        SetRamBlockStatus
          arg RamBlockStatus: type=boolean, direction=IN, server-argument-impl-policy=USE-ARGUMENT-TYPE
        WriteBlock
          arg SrcPtr: type=dtRef_const_VOID, direction=IN, server-argument-impl-policy=USE-ARGUMENT-TYPE
      error E_NOT_OK: error-code=1
    NvSWC_NvMService_AC3_SRBS_DS_Defs
      9 x operation, all with possible-error=NvSWC_NvMService_AC3_SRBS_DS_Defs/E_NOT_OK:
        EraseBlock
        GetDataIndex
          arg DataIndex: type=uint8, direction=OUT, server-argument-impl-policy=USE-ARGUMENT-TYPE
        GetErrorStatus
          arg ErrorStatus: type=NvM_RequestResultType, direction=OUT, server-argument-impl-policy=USE-ARGUMENT-TYPE
        InvalidateNvBlock
        ReadBlock
          arg DstPtr: type=dtRef_VOID, direction=IN, server-argument-impl-policy=USE-ARGUMENT-TYPE
        RestoreBlockDefaults
          arg DstPtr: type=dtRef_VOID, direction=IN, server-argument-impl-policy=USE-ARGUMENT-TYPE
        SetDataIndex
          arg DataIndex: type=uint8, direction=IN, server-argument-impl-policy=USE-ARGUMENT-TYPE
        SetRamBlockStatus
          arg RamBlockStatus: type=boolean, direction=IN, server-argument-impl-policy=USE-ARGUMENT-TYPE
        WriteBlock
          arg SrcPtr: type=dtRef_const_VOID, direction=IN, server-argument-impl-policy=USE-ARGUMENT-TYPE
      error E_NOT_OK: error-code=1
    NvSWC_NvMService_SRBS
      operation GetErrorStatus: possible-error=NvSWC_NvMService_SRBS/E_NOT_OK
        arg ErrorStatus: type=NvM_RequestResultType, direction=OUT, server-argument-impl-policy=USE-ARGUMENT-TYPE
      operation SetRamBlockStatus: possible-error=NvSWC_NvMService_SRBS/E_NOT_OK
        arg RamBlockStatus: type=boolean, direction=IN, server-argument-impl-policy=USE-ARGUMENT-TYPE
      error E_NOT_OK: error-code=1
