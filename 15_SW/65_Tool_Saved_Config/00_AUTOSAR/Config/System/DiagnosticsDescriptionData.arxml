[part 1 of 2: package /InitialEcuC]
AUTOSAR XML (schema 00048)
package /InitialEcuC
  ecuc value collection InitialEcuC: ecuc-values=[Dcm, Dem]
  module config Dcm: module-description=Dcm_Impl
    DcmConfigSet
      DcmGeneral: DcmResetToFblAfterSessionFinalResponseEnabled=false
      DcmDsd
        DcmDsdServiceTable
          17 x DcmDsdService:
            ProcessOBDService01: DcmDsdSidTabServiceId=1, DcmDsdSidTabSubfuncAvail=false, DcmDsdSidTabSessionLevelRef=DcmDspSession/Default, DcmDsdSidTabSessionLevelRef=DcmDspSession/Extended, DcmDsdSidTabSessionLevelRef=Coding_Session
            ProcessOBDService09: DcmDsdSidTabServiceId=9, DcmDsdSidTabSubfuncAvail=false, DcmDsdSidTabSessionLevelRef=DcmDspSession/Default, DcmDsdSidTabSessionLevelRef=DcmDspSession/Extended, DcmDsdSidTabSessionLevelRef=Coding_Session
            DiagSessionControl: DcmDsdSidTabServiceId=16, DcmDsdSidTabSubfuncAvail=true
              4 x DcmDsdSubService:
                Default: DcmDsdSubServiceId=1
                Programming: DcmDsdSubServiceId=2, DcmDsdSubServiceSessionLevelRef=DcmDspSession/Programming, DcmDsdSubServiceSessionLevelRef=DcmDspSession/Extended
                Extended: DcmDsdSubServiceId=3, DcmDsdSubServiceSessionLevelRef=DcmDspSession/Default, DcmDsdSubServiceSessionLevelRef=DcmDspSession/Extended, DcmDsdSubServiceSessionLevelRef=Coding_Session
                Coding_Session_Start: DcmDsdSubServiceId=65, DcmDsdSubServiceSessionLevelRef=DcmDspSession/Extended, DcmDsdSubServiceSessionLevelRef=Coding_Session
            EcuReset: DcmDsdSidTabServiceId=17, DcmDsdSidTabSubfuncAvail=true, DcmDsdSidTabSessionLevelRef=DcmDspSession/Programming, DcmDsdSidTabSessionLevelRef=DcmDspSession/Extended, DcmDsdSidTabSessionLevelRef=Coding_Session
              Hard (DcmDsdSubService):
                DcmDsdSubServiceId = 1
                DcmDsdSubServiceSessionLevelRef = DcmDspSession/Programming
                DcmDsdSubServiceSessionLevelRef = DcmDspSession/Extended
                DcmDsdSubServiceSessionLevelRef = Coding_Session
              Soft (DcmDsdSubService):
                DcmDsdSubServiceId = 3
                DcmDsdSubServiceSessionLevelRef = DcmDspSession/Programming
                DcmDsdSubServiceSessionLevelRef = DcmDspSession/Extended
                DcmDsdSubServiceSessionLevelRef = Coding_Session
            ClearDiagInfo: DcmDsdSidTabServiceId=20, DcmDsdSidTabSubfuncAvail=false, DcmDsdSidTabSessionLevelRef=DcmDspSession/Default, DcmDsdSidTabSessionLevelRef=DcmDspSession/Extended, DcmDsdSidTabSessionLevelRef=Coding_Session
            ReadDtcInfo: DcmDsdSidTabServiceId=25, DcmDsdSidTabSubfuncAvail=true, DcmDsdSidTabSessionLevelRef=DcmDspSession/Default, DcmDsdSidTabSessionLevelRef=DcmDspSession/Extended, DcmDsdSidTabSessionLevelRef=Coding_Session
              6 x DcmDsdSubService, all with DcmDsdSubServiceSessionLevelRef=DcmDspSession/Default, DcmDsdSubServiceSessionLevelRef=DcmDspSession/Extended, DcmDsdSubServiceSessionLevelRef=Coding_Session:
                RNODTCBSM: DcmDsdSubServiceId=1
                RDTCBSM: DcmDsdSubServiceId=2
                RDTCSSI: DcmDsdSubServiceId=3
                RDTCSSBDTC: DcmDsdSubServiceId=4
                RDTCEDRBDN: DcmDsdSubServiceId=6
                RSUPDTC: DcmDsdSubServiceId=10
            ReadDataById: DcmDsdSidTabServiceId=34, DcmDsdSidTabSubfuncAvail=false, DcmDsdSidTabSessionLevelRef=DcmDspSession/Default, DcmDsdSidTabSessionLevelRef=DcmDspSession/Extended, DcmDsdSidTabSessionLevelRef=Coding_Session
            SecurityAccess: DcmDsdSidTabServiceId=39, DcmDsdSidTabSubfuncAvail=true, DcmDsdSidTabSessionLevelRef=DcmDspSession/Programming, DcmDsdSidTabSessionLevelRef=DcmDspSession/Extended, DcmDsdSidTabSessionLevelRef=Coding_Session
              8 x DcmDsdSubService:
                SeedLevel1_Request: DcmDsdSubServiceId=1, DcmDsdSubServiceSessionLevelRef=DcmDspSession/Extended
                KeyLevel1_Send: DcmDsdSubServiceId=2, DcmDsdSubServiceSessionLevelRef=DcmDspSession/Extended
                RequestSeed_Level2_Request: DcmDsdSubServiceId=3, DcmDsdSubServiceSessionLevelRef=DcmDspSession/Extended
                SendKey_Level2_Send: DcmDsdSubServiceId=4, DcmDsdSubServiceSessionLevelRef=DcmDspSession/Extended
                RequestSeed_Level3_Request: DcmDsdSubServiceId=5, DcmDsdSubServiceSessionLevelRef=Coding_Session
                SendKey_Level3_Send: DcmDsdSubServiceId=6, DcmDsdSubServiceSessionLevelRef=Coding_Session
                RequestSeed_Level4_Request: DcmDsdSubServiceId=7, DcmDsdSubServiceSessionLevelRef=DcmDspSession/Programming
                SendKey_Level4_Send: DcmDsdSubServiceId=8, DcmDsdSubServiceSessionLevelRef=DcmDspSession/Programming
            CommunicationControl: DcmDsdSidTabServiceId=40, DcmDsdSidTabSubfuncAvail=true, DcmDsdSidTabSessionLevelRef=DcmDspSession/Extended, DcmDsdSidTabSessionLevelRef=Coding_Session
              EnableRxAndTx (DcmDsdSubService): DcmDsdSubServiceId=0, DcmDsdSubServiceSessionLevelRef=DcmDspSession/Extended, DcmDsdSubServiceSessionLevelRef=Coding_Session
              DisableRxAndTx (DcmDsdSubService): DcmDsdSubServiceId=3, DcmDsdSubServiceSessionLevelRef=DcmDspSession/Extended, DcmDsdSubServiceSessionLevelRef=Coding_Session
            WriteDataById: DcmDsdSidTabServiceId=46, DcmDsdSidTabSubfuncAvail=false, DcmDsdSidTabSessionLevelRef=DcmDspSession/Programming, DcmDsdSidTabSessionLevelRef=DcmDspSession/Extended, DcmDsdSidTabSessionLevelRef=Coding_Session, DcmDsdSidTabSecurityLevelRef=UnlockedL1, DcmDsdSidTabSecurityLevelRef=Unlocked_Level_2, DcmDsdSidTabSecurityLevelRef=Unlocked_Level_3, DcmDsdSidTabSecurityLevelRef=Unlocked_Level_4
            RoutineControl: DcmDsdSidTabServiceId=49, DcmDsdSidTabSubfuncAvail=true, DcmDsdSidTabSessionLevelRef=DcmDspSession/Programming, DcmDsdSidTabSessionLevelRef=DcmDspSession/Extended, DcmDsdSidTabSessionLevelRef=Coding_Session
            RequestDownload: DcmDsdSidTabServiceId=52, DcmDsdSidTabSubfuncAvail=false, DcmDsdSidTabSessionLevelRef=DcmDspSession/Programming, DcmDsdSidTabSecurityLevelRef=Unlocked_Level_4
            TransferData: DcmDsdSidTabServiceId=54, DcmDsdSidTabSubfuncAvail=false, DcmDsdSidTabSessionLevelRef=DcmDspSession/Programming, DcmDsdSidTabSecurityLevelRef=Unlocked_Level_4
            RequestTransferExit: DcmDsdSidTabServiceId=55, DcmDsdSidTabSubfuncAvail=false, DcmDsdSidTabSessionLevelRef=DcmDspSession/Programming, DcmDsdSidTabSecurityLevelRef=Unlocked_Level_4
            Upload_Download_RequestFileTransfer: DcmDsdSidTabServiceId=56, DcmDsdSidTabSubfuncAvail=false, DcmDsdSidTabSessionLevelRef=DcmDspSession/Programming, DcmDsdSidTabSecurityLevelRef=Unlocked_Level_4
            TesterPresent: DcmDsdSidTabServiceId=62, DcmDsdSidTabSubfuncAvail=true
              TesterPresent (DcmDsdSubService): DcmDsdSubServiceId=0
            ControlDtcSetting: DcmDsdSidTabServiceId=133, DcmDsdSidTabSubfuncAvail=true, DcmDsdSidTabSessionLevelRef=DcmDspSession/Extended, DcmDsdSidTabSessionLevelRef=Coding_Session
              Enable (DcmDsdSubService): DcmDsdSubServiceId=1, DcmDsdSubServiceSessionLevelRef=DcmDspSession/Extended, DcmDsdSubServiceSessionLevelRef=Coding_Session
              Disable (DcmDsdSubService): DcmDsdSubServiceId=2, DcmDsdSubServiceSessionLevelRef=DcmDspSession/Extended, DcmDsdSubServiceSessionLevelRef=Coding_Session
      DcmDsp: DcmDspMaxDidToRead=5
        HV_Status_and_Charging_Status_HV_status_and_charging_status (DcmDspData): DcmDspDataSize=8, DcmDspDataType=UINT8, DcmDspDataInfoRef=DataInfo_HV_Status_and_Charging_Status_HV_status_and_charging_status
        DataInfo_HV_Status_and_Charging_Status_HV_status_and_charging_status (DcmDspDataInfo): DcmDspDataFixedLength=true
        VCU_AccPealparameter_VCU_VehicleSpeed (DcmDspData): DcmDspDataSize=16, DcmDspDataType=UINT16, DcmDspDataInfoRef=DataInfo_VCU_AccPealparameter_VCU_VehicleSpeed
        DataInfo_VCU_AccPealparameter_VCU_VehicleSpeed (DcmDspDataInfo): DcmDspDataFixedLength=true
        VCU_AccPealparameter_Accelerator_pedal_sensor_1_voltage (DcmDspData): DcmDspDataSize=8, DcmDspDataType=UINT8, DcmDspDataInfoRef=DataInfo_VCU_AccPealparameter_Accelerator_pedal_sensor_1_voltage
        DataInfo_VCU_AccPealparameter_Accelerator_pedal_sensor_1_voltage (DcmDspDataInfo): DcmDspDataFixedLength=true
        VCU_AccPealparameter_Accelerator_pedal_sensor_2_voltage (DcmDspData): DcmDspDataSize=8, DcmDspDataType=UINT8, DcmDspDataInfoRef=DataInfo_VCU_AccPealparameter_Accelerator_pedal_sensor_2_voltage
        DataInfo_VCU_AccPealparameter_Accelerator_pedal_sensor_2_voltage (DcmDspDataInfo): DcmDspDataFixedLength=true
        VCU_AccPealparameter_VCU_AccelerationPedal (DcmDspData): DcmDspDataSize=8, DcmDspDataType=UINT8, DcmDspDataInfoRef=DataInfo_VCU_AccPealparameter_VCU_AccelerationPedal
        DataInfo_VCU_AccPealparameter_VCU_AccelerationPedal (DcmDspDataInfo): DcmDspDataFixedLength=true
        VCU_Torque_parameter_VCU_MCUDesiredTorque (DcmDspData): DcmDspDataSize=16, DcmDspDataType=UINT16, DcmDspDataInfoRef=DataInfo_VCU_Torque_parameter_VCU_MCUDesiredTorque
        DataInfo_VCU_Torque_parameter_VCU_MCUDesiredTorque (DcmDspDataInfo): DcmDspDataFixedLength=true
        VCU_Torque_parameter_Torque_MaxAllowed (DcmDspData): DcmDspDataSize=16, DcmDspDataType=UINT16, DcmDspDataInfoRef=DataInfo_VCU_Torque_parameter_Torque_MaxAllowed
        DataInfo_VCU_Torque_parameter_Torque_MaxAllowed (DcmDspDataInfo): DcmDspDataFixedLength=true
        VCU_Torque_parameter_Torque_MinAllowed (DcmDspData): DcmDspDataSize=16, DcmDspDataType=UINT16, DcmDspDataInfoRef=DataInfo_VCU_Torque_parameter_Torque_MinAllowed
        DataInfo_VCU_Torque_parameter_Torque_MinAllowed (DcmDspDataInfo): DcmDspDataFixedLength=true
        VCU_Torque_parameter_VCU_RegenTorqueCap (DcmDspData): DcmDspDataSize=16, DcmDspDataType=UINT16, DcmDspDataInfoRef=DataInfo_VCU_Torque_parameter_VCU_RegenTorqueCap
        DataInfo_VCU_Torque_parameter_VCU_RegenTorqueCap (DcmDspDataInfo): DcmDspDataFixedLength=true
        Driver_Mode_Driver_Mode (DcmDspData): DcmDspDataSize=8, DcmDspDataType=UINT8, DcmDspDataInfoRef=DataInfo_Driver_Mode_Driver_Mode
        DataInfo_Driver_Mode_Driver_Mode (DcmDspDataInfo): DcmDspDataFixedLength=true
        VCU_PowerMaxAllowed_parameter1_VCU_TCUPowerAllowed (DcmDspData): DcmDspDataSize=16, DcmDspDataType=UINT16, DcmDspDataInfoRef=DataInfo_VCU_PowerMaxAllowed_parameter1_VCU_TCUPowerAllowed
        DataInfo_VCU_PowerMaxAllowed_parameter1_VCU_TCUPowerAllowed (DcmDspDataInfo): DcmDspDataFixedLength=true
        VCU_PowerMaxAllowed_parameter1_VCU_DCDCPowerLimit (DcmDspData): DcmDspDataSize=16, DcmDspDataType=UINT16, DcmDspDataInfoRef=DataInfo_VCU_PowerMaxAllowed_parameter1_VCU_DCDCPowerLimit
        DataInfo_VCU_PowerMaxAllowed_parameter1_VCU_DCDCPowerLimit (DcmDspDataInfo): DcmDspDataFixedLength=true
        VCU_PowerMaxAllowed_parameter1_MCUPowerLimit (DcmDspData): DcmDspDataSize=16, DcmDspDataType=UINT16, DcmDspDataInfoRef=DataInfo_VCU_PowerMaxAllowed_parameter1_MCUPowerLimit
        DataInfo_VCU_PowerMaxAllowed_parameter1_MCUPowerLimit (DcmDspDataInfo): DcmDspDataFixedLength=true
        VCU_PowerMaxAllowed_parameter1_VCU_A2LPowerMaxAllowed (DcmDspData): DcmDspDataSize=16, DcmDspDataType=UINT16, DcmDspDataInfoRef=DataInfo_VCU_PowerMaxAllowed_parameter1_VCU_A2LPowerMaxAllowed
        DataInfo_VCU_PowerMaxAllowed_parameter1_VCU_A2LPowerMaxAllowed (DcmDspDataInfo): DcmDspDataFixedLength=true
        AC_charging_parameter_POD_OBC_InputACVoltage (DcmDspData): DcmDspDataSize=16, DcmDspDataType=UINT16, DcmDspDataInfoRef=DataInfo_AC_charging_parameter_POD_OBC_InputACVoltage
        DataInfo_AC_charging_parameter_POD_OBC_InputACVoltage (DcmDspDataInfo): DcmDspDataFixedLength=true
        AC_charging_parameter_VCU_OBC_ChargeCurrentCommand (DcmDspData): DcmDspDataSize=16, DcmDspDataType=UINT16, DcmDspDataInfoRef=DataInfo_AC_charging_parameter_VCU_OBC_ChargeCurrentCommand
        DataInfo_AC_charging_parameter_VCU_OBC_ChargeCurrentCommand (DcmDspDataInfo): DcmDspDataFixedLength=true
        AC_charging_parameter_POD_OBC_OutputDCChargeCurrent (DcmDspData): DcmDspDataSize=16, DcmDspDataType=UINT16, DcmDspDataInfoRef=DataInfo_AC_charging_parameter_POD_OBC_OutputDCChargeCurrent
        DataInfo_AC_charging_parameter_POD_OBC_OutputDCChargeCurrent (DcmDspDataInfo): DcmDspDataFixedLength=true
        AC_charging_parameter_POD_OBC_OutputDCChargeVoltage (DcmDspData): DcmDspDataSize=16, DcmDspDataType=UINT16, DcmDspDataInfoRef=DataInfo_AC_charging_parameter_POD_OBC_OutputDCChargeVoltage
        DataInfo_AC_charging_parameter_POD_OBC_OutputDCChargeVoltage (DcmDspDataInfo): DcmDspDataFixedLength=true
        Chargestatus_Chargestatus (DcmDspData): DcmDspDataSize=8, DcmDspDataType=UINT8, DcmDspDataInfoRef=DataInfo_Chargestatus_Chargestatus
        DataInfo_Chargestatus_Chargestatus (DcmDspDataInfo): DcmDspDataFixedLength=true
        Electronic_lock_state_Electronic_lock_state (DcmDspData): DcmDspDataSize=8, DcmDspDataType=UINT8, DcmDspDataInfoRef=DataInfo_Electronic_lock_state_Electronic_lock_state
        DataInfo_Electronic_lock_state_Electronic_lock_state (DcmDspDataInfo): DcmDspDataFixedLength=true
        VCU_HV_InterLock_PWM_pfrequency_VCU_HVIL (DcmDspData): DcmDspDataSize=8, DcmDspDataType=UINT8, DcmDspDataInfoRef=DataInfo_VCU_HV_InterLock_PWM_pfrequency_VCU_HVIL
        DataInfo_VCU_HV_InterLock_PWM_pfrequency_VCU_HVIL (DcmDspDataInfo): DcmDspDataFixedLength=true
        S2_status_New_Bit_Field (DcmDspData): DcmDspDataSize=8, DcmDspDataType=UINT8, DcmDspDataInfoRef=DataInfo_S2_status_New_Bit_Field
        DataInfo_S2_status_New_Bit_Field (DcmDspDataInfo): DcmDspDataFixedLength=true
        VCU_PowerMaxAllowed_parameter2_VCU_DCDCPowerLimit (DcmDspData): DcmDspDataSize=16, DcmDspDataType=UINT16, DcmDspDataInfoRef=DataInfo_VCU_PowerMaxAllowed_parameter2_VCU_DCDCPowerLimit
        DataInfo_VCU_PowerMaxAllowed_parameter2_VCU_DCDCPowerLimit (DcmDspDataInfo): DcmDspDataFixedLength=true
        VCU_PowerMaxAllowed_parameter2_MCUPowerLimit (DcmDspData): DcmDspDataSize=16, DcmDspDataType=UINT16, DcmDspDataInfoRef=DataInfo_VCU_PowerMaxAllowed_parameter2_MCUPowerLimit
        DataInfo_VCU_PowerMaxAllowed_parameter2_MCUPowerLimit (DcmDspDataInfo): DcmDspDataFixedLength=true
        VCU_control_main_relay_Mainrealy1 (DcmDspData): DcmDspDataSize=8, DcmDspDataType=UINT8, DcmDspDataInfoRef=DataInfo_VCU_control_main_relay_Mainrealy1
        DataInfo_VCU_control_main_relay_Mainrealy1 (DcmDspDataInfo): DcmDspDataFixedLength=true
        VCU_control_main_relay_Mainrelay2 (DcmDspData): DcmDspDataSize=8, DcmDspDataType=UINT8, DcmDspDataInfoRef=DataInfo_VCU_control_main_relay_Mainrelay2
        DataInfo_VCU_control_main_relay_Mainrelay2 (DcmDspDataInfo): DcmDspDataFixedLength=true
        PWT_vehicle_fault_Level_PWT_ErrorLevel (DcmDspData): DcmDspDataSize=8, DcmDspDataType=UINT8, DcmDspDataInfoRef=DataInfo_PWT_vehicle_fault_Level_PWT_ErrorLevel
        DataInfo_PWT_vehicle_fault_Level_PWT_ErrorLevel (DcmDspDataInfo): DcmDspDataFixedLength=true
        Write_Level1_OEM_Key_OEM_Key_Value (DcmDspData): DcmDspDataSize=128, DcmDspDataType=UINT8_N, DcmDspDataInfoRef=DataInfo_Write_Level1_OEM_Key_OEM_Key_Value
        DataInfo_Write_Level1_OEM_Key_OEM_Key_Value (DcmDspDataInfo): DcmDspDataFixedLength=true
        Read_Level1_OEM_Key_written_status_OEM_Key_Write_state (DcmDspData): DcmDspDataSize=8, DcmDspDataType=UINT8, DcmDspDataInfoRef=DataInfo_Read_Level1_OEM_Key_written_status_OEM_Key_Write_state
        DataInfo_Read_Level1_OEM_Key_written_status_OEM_Key_Write_state (DcmDspDataInfo): DcmDspDataFixedLength=true
        Write_Level2_OEM_Key_OEM_Key_Value (DcmDspData): DcmDspDataSize=128, DcmDspDataType=UINT8_N, DcmDspDataInfoRef=DataInfo_Write_Level2_OEM_Key_OEM_Key_Value
        DataInfo_Write_Level2_OEM_Key_OEM_Key_Value (DcmDspDataInfo): DcmDspDataFixedLength=true
        Read_Level2_OEM_Key_written_status_OEM_Key_Write_state (DcmDspData): DcmDspDataSize=8, DcmDspDataType=UINT8, DcmDspDataInfoRef=DataInfo_Read_Level2_OEM_Key_written_status_OEM_Key_Write_state
        DataInfo_Read_Level2_OEM_Key_written_status_OEM_Key_Write_state (DcmDspDataInfo): DcmDspDataFixedLength=true
        Write_Level3_OEM_Key_OEM_Key_Value (DcmDspData): DcmDspDataSize=128, DcmDspDataType=UINT8_N, DcmDspDataInfoRef=DataInfo_Write_Level3_OEM_Key_OEM_Key_Value
        DataInfo_Write_Level3_OEM_Key_OEM_Key_Value (DcmDspDataInfo): DcmDspDataFixedLength=true
        Read_Level3_OEM_Key_written_status_OEM_Key_Write_state (DcmDspData): DcmDspDataSize=8, DcmDspDataType=UINT8, DcmDspDataInfoRef=DataInfo_Read_Level3_OEM_Key_written_status_OEM_Key_Write_state
        DataInfo_Read_Level3_OEM_Key_written_status_OEM_Key_Write_state (DcmDspDataInfo): DcmDspDataFixedLength=true
        Write_Level4_OEM_Key_OEM_Key_Value (DcmDspData): DcmDspDataSize=128, DcmDspDataType=UINT8_N, DcmDspDataInfoRef=DataInfo_Write_Level4_OEM_Key_OEM_Key_Value
        DataInfo_Write_Level4_OEM_Key_OEM_Key_Value (DcmDspDataInfo): DcmDspDataFixedLength=true
        Read_Level4_OEM_Key_written_status_OEM_Key_Write_state (DcmDspData): DcmDspDataSize=8, DcmDspDataType=UINT8, DcmDspDataInfoRef=DataInfo_Read_Level4_OEM_Key_written_status_OEM_Key_Write_state
        DataInfo_Read_Level4_OEM_Key_written_status_OEM_Key_Write_state (DcmDspDataInfo): DcmDspDataFixedLength=true
        Bootloader_version_number_Major_release (DcmDspData): DcmDspDataSize=8, DcmDspDataType=UINT8, DcmDspDataInfoRef=DataInfo_Bootloader_version_number_Major_release
        DataInfo_Bootloader_version_number_Major_release (DcmDspDataInfo): DcmDspDataFixedLength=true
        Bootloader_version_number_Minor_release (DcmDspData): DcmDspDataSize=8, DcmDspDataType=UINT8, DcmDspDataInfoRef=DataInfo_Bootloader_version_number_Minor_release
        DataInfo_Bootloader_version_number_Minor_release (DcmDspDataInfo): DcmDspDataFixedLength=true
        Bootloader_version_number_No_functional_content_change (DcmDspData): DcmDspDataSize=8, DcmDspDataType=UINT8, DcmDspDataInfoRef=DataInfo_Bootloader_version_number_No_functional_content_change
        DataInfo_Bootloader_version_number_No_functional_content_change (DcmDspDataInfo): DcmDspDataFixedLength=true
        EcuIdentification_Specific_Vehicle_Code_WMI (DcmDspData): DcmDspDataSize=48, DcmDspDataType=UINT8_N, DcmDspDataInfoRef=DataInfo_EcuIdentification_Specific_Vehicle_Code_WMI
        DataInfo_EcuIdentification_Specific_Vehicle_Code_WMI (DcmDspDataInfo): DcmDspDataFixedLength=true
        EcuIdentification_Group (DcmDspData): DcmDspDataSize=16, DcmDspDataType=UINT8_N, DcmDspDataInfoRef=DataInfo_EcuIdentification_Group
        DataInfo_EcuIdentification_Group (DcmDspDataInfo): DcmDspDataFixedLength=true
        EcuIdentification_Subgroup (DcmDspData): DcmDspDataSize=16, DcmDspDataType=UINT8_N, DcmDspDataInfoRef=DataInfo_EcuIdentification_Subgroup
        DataInfo_EcuIdentification_Subgroup (DcmDspDataInfo): DcmDspDataFixedLength=true
        EcuIdentification_Detail_Code (DcmDspData): DcmDspDataSize=24, DcmDspDataType=UINT8_N, DcmDspDataInfoRef=DataInfo_EcuIdentification_Detail_Code
        DataInfo_EcuIdentification_Detail_Code (DcmDspDataInfo): DcmDspDataFixedLength=true
        EcuIdentification_Execution_Package (DcmDspData): DcmDspDataSize=16, DcmDspDataType=UINT8_N, DcmDspDataInfoRef=DataInfo_EcuIdentification_Execution_Package
        DataInfo_EcuIdentification_Execution_Package (DcmDspDataInfo): DcmDspDataFixedLength=true
        ECU_application_software_ASW_part_number_Major_release (DcmDspData): DcmDspDataSize=8, DcmDspDataType=UINT8, DcmDspDataInfoRef=DataInfo_ECU_application_software_ASW_part_number_Major_release
        DataInfo_ECU_application_software_ASW_part_number_Major_release (DcmDspDataInfo): DcmDspDataFixedLength=true
        ECU_application_software_ASW_part_number_Minor_release (DcmDspData): DcmDspDataSize=8, DcmDspDataType=UINT8, DcmDspDataInfoRef=DataInfo_ECU_application_software_ASW_part_number_Minor_release
        DataInfo_ECU_application_software_ASW_part_number_Minor_release (DcmDspDataInfo): DcmDspDataFixedLength=true
        ECU_application_software_ASW_part_number_No_functional_content_change (DcmDspData): DcmDspDataSize=8, DcmDspDataType=UINT8, DcmDspDataInfoRef=DataInfo_ECU_application_software_ASW_part_number_No_functional_content_change
        DataInfo_ECU_application_software_ASW_part_number_No_functional_content_change (DcmDspDataInfo): DcmDspDataFixedLength=true
        Read_Write_coding_data_string_CDS_Version_Byte_0 (DcmDspData): DcmDspDataSize=8, DcmDspDataType=UINT8, DcmDspDataInfoRef=DataInfo_Read_Write_coding_data_string_CDS_Version_Byte_0
        DataInfo_Read_Write_coding_data_string_CDS_Version_Byte_0 (DcmDspDataInfo): DcmDspDataFixedLength=true
        Read_Write_coding_data_string_CDS_Version_Byte_1 (DcmDspData): DcmDspDataSize=8, DcmDspDataType=UINT8, DcmDspDataInfoRef=DataInfo_Read_Write_coding_data_string_CDS_Version_Byte_1
        DataInfo_Read_Write_coding_data_string_CDS_Version_Byte_1 (DcmDspDataInfo): DcmDspDataFixedLength=true
        Read_Write_coding_data_string_CDS_CDS_Short_VIN_High_Byte_0 (DcmDspData): DcmDspDataSize=8, DcmDspDataType=UINT8_N, DcmDspDataInfoRef=DataInfo_Read_Write_coding_data_string_CDS_CDS_Short_VIN_High_Byte_0
        DataInfo_Read_Write_coding_data_string_CDS_CDS_Short_VIN_High_Byte_0 (DcmDspDataInfo): DcmDspDataFixedLength=true
        Read_Write_coding_data_string_CDS_CDS_Short_VIN_High_Byte_1 (DcmDspData): DcmDspDataSize=8, DcmDspDataType=UINT8_N, DcmDspDataInfoRef=DataInfo_Read_Write_coding_data_string_CDS_CDS_Short_VIN_High_Byte_1
        DataInfo_Read_Write_coding_data_string_CDS_CDS_Short_VIN_High_Byte_1 (DcmDspDataInfo): DcmDspDataFixedLength=true
        Read_Write_coding_data_string_CDS_CDS_Short_VIN_High_Byte_2 (DcmDspData): DcmDspDataSize=8, DcmDspDataType=UINT8_N, DcmDspDataInfoRef=DataInfo_Read_Write_coding_data_string_CDS_CDS_Short_VIN_High_Byte_2
        DataInfo_Read_Write_coding_data_string_CDS_CDS_Short_VIN_High_Byte_2 (DcmDspDataInfo): DcmDspDataFixedLength=true
        Read_Write_coding_data_string_CDS_CDS_Short_VIN_High_Byte_3 (DcmDspData): DcmDspDataSize=8, DcmDspDataType=UINT8_N, DcmDspDataInfoRef=DataInfo_Read_Write_coding_data_string_CDS_CDS_Short_VIN_High_Byte_3
        DataInfo_Read_Write_coding_data_string_CDS_CDS_Short_VIN_High_Byte_3 (DcmDspDataInfo): DcmDspDataFixedLength=true
        Read_Write_coding_data_string_CDS_CDS_Short_VIN_High_Byte_4 (DcmDspData): DcmDspDataSize=8, DcmDspDataType=UINT8_N, DcmDspDataInfoRef=DataInfo_Read_Write_coding_data_string_CDS_CDS_Short_VIN_High_Byte_4
        DataInfo_Read_Write_coding_data_string_CDS_CDS_Short_VIN_High_Byte_4 (DcmDspDataInfo): DcmDspDataFixedLength=true
        Read_Write_coding_data_string_CDS_CDS_Short_VIN_High_Byte_5 (DcmDspData): DcmDspDataSize=8, DcmDspDataType=UINT8_N, DcmDspDataInfoRef=DataInfo_Read_Write_coding_data_string_CDS_CDS_Short_VIN_High_Byte_5
        DataInfo_Read_Write_coding_data_string_CDS_CDS_Short_VIN_High_Byte_5 (DcmDspDataInfo): DcmDspDataFixedLength=true
        Read_Write_coding_data_string_CDS_CDS_Short_VIN_High_Byte_7 (DcmDspData): DcmDspDataSize=8, DcmDspDataType=UINT8_N, DcmDspDataInfoRef=DataInfo_Read_Write_coding_data_string_CDS_CDS_Short_VIN_High_Byte_7
        DataInfo_Read_Write_coding_data_string_CDS_CDS_Short_VIN_High_Byte_7 (DcmDspDataInfo): DcmDspDataFixedLength=true
        Read_Write_coding_data_string_CDS_CDS_Format_Byte_High_Byte_0 (DcmDspData): DcmDspDataSize=8, DcmDspDataType=UINT8, DcmDspDataInfoRef=DataInfo_Read_Write_coding_data_string_CDS_CDS_Format_Byte_High_Byte_0
        DataInfo_Read_Write_coding_data_string_CDS_CDS_Format_Byte_High_Byte_0 (DcmDspDataInfo): DcmDspDataFixedLength=true
        Read_Write_coding_data_string_CDS_CDS_Format_Byte_High_Byte_1 (DcmDspData): DcmDspDataSize=8, DcmDspDataType=UINT8, DcmDspDataInfoRef=DataInfo_Read_Write_coding_data_string_CDS_CDS_Format_Byte_High_Byte_1
        DataInfo_Read_Write_coding_data_string_CDS_CDS_Format_Byte_High_Byte_1 (DcmDspDataInfo): DcmDspDataFixedLength=true
        Read_Write_coding_data_string_CDS_Configuration1 (DcmDspData): DcmDspDataSize=8, DcmDspDataType=UINT8, DcmDspDataInfoRef=DataInfo_Read_Write_coding_data_string_CDS_Configuration1
        DataInfo_Read_Write_coding_data_string_CDS_Configuration1 (DcmDspDataInfo): DcmDspDataFixedLength=true
        Read_Write_coding_data_string_CDS_Configuration2 (DcmDspData): DcmDspDataSize=8, DcmDspDataType=UINT8_N, DcmDspDataInfoRef=DataInfo_Read_Write_coding_data_string_CDS_Configuration2
        DataInfo_Read_Write_coding_data_string_CDS_Configuration2 (DcmDspDataInfo): DcmDspDataFixedLength=true
        Read_Write_coding_data_string_CDS_CDS_CRC (DcmDspData): DcmDspDataSize=8, DcmDspDataType=UINT8, DcmDspDataInfoRef=DataInfo_Read_Write_coding_data_string_CDS_CDS_CRC
        DataInfo_Read_Write_coding_data_string_CDS_CDS_CRC (DcmDspDataInfo): DcmDspDataFixedLength=true
        Coding_for_CDS_fingerprint_codingDate_byte_1_YY (DcmDspData): DcmDspDataSize=8, DcmDspDataType=UINT8_N, DcmDspDataInfoRef=DataInfo_Coding_for_CDS_fingerprint_codingDate_byte_1_YY
        DataInfo_Coding_for_CDS_fingerprint_codingDate_byte_1_YY (DcmDspDataInfo): DcmDspDataFixedLength=true
        Coding_for_CDS_fingerprint_codingDate_byte_2_MM (DcmDspData): DcmDspDataSize=8, DcmDspDataType=UINT8_N, DcmDspDataInfoRef=DataInfo_Coding_for_CDS_fingerprint_codingDate_byte_2_MM
        DataInfo_Coding_for_CDS_fingerprint_codingDate_byte_2_MM (DcmDspDataInfo): DcmDspDataFixedLength=true
        Coding_for_CDS_fingerprint_codingDate_byte_3_DD (DcmDspData): DcmDspDataSize=8, DcmDspDataType=UINT8_N, DcmDspDataInfoRef=DataInfo_Coding_for_CDS_fingerprint_codingDate_byte_3_DD
        DataInfo_Coding_for_CDS_fingerprint_codingDate_byte_3_DD (DcmDspDataInfo): DcmDspDataFixedLength=true
        Coding_for_CDS_fingerprint_repairShopCodeorTesterSerialNumber_byte_1_27_MSB (DcmDspData):
          DcmDspDataSize = 216
          DcmDspDataType = UINT8_N
          DcmDspDataInfoRef = DataInfo_Coding_for_CDS_fingerprint_repairShopCodeorTesterSerialNumber_byte_1_27_MSB
        DataInfo_Coding_for_CDS_fingerprint_repairShopCodeorTesterSerialNumber_byte_1_27_MSB (DcmDspDataInfo): DcmDspDataFixedLength=true
        Last_service_date_Year (DcmDspData): DcmDspDataSize=8, DcmDspDataType=UINT8_N, DcmDspDataInfoRef=DataInfo_Last_service_date_Year
        DataInfo_Last_service_date_Year (DcmDspDataInfo): DcmDspDataFixedLength=true
        Last_service_date_Month (DcmDspData): DcmDspDataSize=8, DcmDspDataType=UINT8_N, DcmDspDataInfoRef=DataInfo_Last_service_date_Month
        DataInfo_Last_service_date_Month (DcmDspDataInfo): DcmDspDataFixedLength=true
        Last_service_date_Day (DcmDspData): DcmDspDataSize=8, DcmDspDataType=UINT8_N, DcmDspDataInfoRef=DataInfo_Last_service_date_Day
        DataInfo_Last_service_date_Day (DcmDspDataInfo): DcmDspDataFixedLength=true
        Read_active_diagnostic_session_Active_diagnostic_session (DcmDspData): DcmDspDataSize=8, DcmDspDataType=UINT8, DcmDspDataInfoRef=DataInfo_Read_active_diagnostic_session_Active_diagnostic_session
        DataInfo_Read_active_diagnostic_session_Active_diagnostic_session (DcmDspDataInfo): DcmDspDataFixedLength=true
        Read_ECU_Part_Number_Specific_Vehicle_Code_WMI (DcmDspData): DcmDspDataSize=48, DcmDspDataType=UINT8_N, DcmDspDataInfoRef=DataInfo_Read_ECU_Part_Number_Specific_Vehicle_Code_WMI
        DataInfo_Read_ECU_Part_Number_Specific_Vehicle_Code_WMI (DcmDspDataInfo): DcmDspDataFixedLength=true
        Read_ECU_Part_Number_Group (DcmDspData): DcmDspDataSize=16, DcmDspDataType=UINT8_N, DcmDspDataInfoRef=DataInfo_Read_ECU_Part_Number_Group
        DataInfo_Read_ECU_Part_Number_Group (DcmDspDataInfo): DcmDspDataFixedLength=true
        Read_ECU_Part_Number_Subgroup (DcmDspData): DcmDspDataSize=16, DcmDspDataType=UINT8_N, DcmDspDataInfoRef=DataInfo_Read_ECU_Part_Number_Subgroup
        DataInfo_Read_ECU_Part_Number_Subgroup (DcmDspDataInfo): DcmDspDataFixedLength=true
        Read_ECU_Part_Number_Detail_Code (DcmDspData): DcmDspDataSize=24, DcmDspDataType=UINT8_N, DcmDspDataInfoRef=DataInfo_Read_ECU_Part_Number_Detail_Code
        DataInfo_Read_ECU_Part_Number_Detail_Code (DcmDspDataInfo): DcmDspDataFixedLength=true
        Read_ECU_Part_Number_Execution_Package (DcmDspData): DcmDspDataSize=16, DcmDspDataType=UINT8_N, DcmDspDataInfoRef=DataInfo_Read_ECU_Part_Number_Execution_Package
        DataInfo_Read_ECU_Part_Number_Execution_Package (DcmDspDataInfo): DcmDspDataFixedLength=true
        DevelopmentData_OperatingSystemVersion (DcmDspData): DcmDspDataSize=16, DcmDspDataType=UINT8_N, DcmDspDataInfoRef=DataInfo_DevelopmentData_OperatingSystemVersion
        DataInfo_DevelopmentData_OperatingSystemVersion (DcmDspDataInfo): DcmDspDataFixedLength=true
        DevelopmentData_CanDriverVersion (DcmDspData): DcmDspDataSize=24, DcmDspDataType=UINT8_N, DcmDspDataInfoRef=DataInfo_DevelopmentData_CanDriverVersion
        DataInfo_DevelopmentData_CanDriverVersion (DcmDspDataInfo): DcmDspDataFixedLength=true
        DevelopmentData_NmVersion (DcmDspData): DcmDspDataSize=8, DcmDspDataType=UINT8_N, DcmDspDataInfoRef=DataInfo_DevelopmentData_NmVersion
        DataInfo_DevelopmentData_NmVersion (DcmDspDataInfo): DcmDspDataFixedLength=true
        Read_ECU_manufacturing_date_ECU_Manufacturing_Date_Year (DcmDspData): DcmDspDataSize=8, DcmDspDataType=UINT8_N, DcmDspDataInfoRef=DataInfo_Read_ECU_manufacturing_date_ECU_Manufacturing_Date_Year
        DataInfo_Read_ECU_manufacturing_date_ECU_Manufacturing_Date_Year (DcmDspDataInfo): DcmDspDataFixedLength=true
        Read_ECU_manufacturing_date_ECU_Manufacturing_Date_Month (DcmDspData): DcmDspDataSize=8, DcmDspDataType=UINT8_N, DcmDspDataInfoRef=DataInfo_Read_ECU_manufacturing_date_ECU_Manufacturing_Date_Month
        DataInfo_Read_ECU_manufacturing_date_ECU_Manufacturing_Date_Month (DcmDspDataInfo): DcmDspDataFixedLength=true
        Read_ECU_manufacturing_date_ECU_Manufacturing_Date_Day (DcmDspData): DcmDspDataSize=8, DcmDspDataType=UINT8_N, DcmDspDataInfoRef=DataInfo_Read_ECU_manufacturing_date_ECU_Manufacturing_Date_Day
        DataInfo_Read_ECU_manufacturing_date_ECU_Manufacturing_Date_Day (DcmDspDataInfo): DcmDspDataFixedLength=true
        SerialNumber_ECU_Name (DcmDspData): DcmDspDataSize=24, DcmDspDataType=UINT8_N, DcmDspDataInfoRef=DataInfo_SerialNumber_ECU_Name
        DataInfo_SerialNumber_ECU_Name (DcmDspDataInfo): DcmDspDataFixedLength=true
        SerialNumber_Supplier_name (DcmDspData): DcmDspDataSize=40, DcmDspDataType=UINT8_N, DcmDspDataInfoRef=DataInfo_SerialNumber_Supplier_name
        DataInfo_SerialNumber_Supplier_name (DcmDspDataInfo): DcmDspDataFixedLength=true
        SerialNumber_ECU_production_date_in_DD_MM_YY_format (DcmDspData): DcmDspDataSize=48, DcmDspDataType=UINT8_N, DcmDspDataInfoRef=DataInfo_SerialNumber_ECU_production_date_in_DD_MM_YY_format
        DataInfo_SerialNumber_ECU_production_date_in_DD_MM_YY_format (DcmDspDataInfo): DcmDspDataFixedLength=true
        SerialNumber_ECU_index_number (DcmDspData): DcmDspDataSize=48, DcmDspDataType=UINT8_N, DcmDspDataInfoRef=DataInfo_SerialNumber_ECU_index_number
        DataInfo_SerialNumber_ECU_index_number (DcmDspDataInfo): DcmDspDataFixedLength=true
        Read_Write_complete_VIN_World_Manufacturers_Identification (DcmDspData): DcmDspDataSize=24, DcmDspDataType=UINT8_N, DcmDspDataInfoRef=DataInfo_Read_Write_complete_VIN_World_Manufacturers_Identification
        DataInfo_Read_Write_complete_VIN_World_Manufacturers_Identification (DcmDspDataInfo): DcmDspDataFixedLength=true
        Read_Write_complete_VIN_Vehicle_Description_Section (DcmDspData): DcmDspDataSize=40, DcmDspDataType=UINT8_N, DcmDspDataInfoRef=DataInfo_Read_Write_complete_VIN_Vehicle_Description_Section
        DataInfo_Read_Write_complete_VIN_Vehicle_Description_Section (DcmDspDataInfo): DcmDspDataFixedLength=true
        Read_Write_complete_VIN_Vehicle_Identification_Section (DcmDspData): DcmDspDataSize=72, DcmDspDataType=UINT8_N, DcmDspDataInfoRef=DataInfo_Read_Write_complete_VIN_Vehicle_Identification_Section
        DataInfo_Read_Write_complete_VIN_Vehicle_Identification_Section (DcmDspDataInfo): DcmDspDataFixedLength=true
        Supplier_ECU_hardware_part_number_Major_release (DcmDspData): DcmDspDataSize=8, DcmDspDataType=UINT8, DcmDspDataInfoRef=DataInfo_Supplier_ECU_hardware_part_number_Major_release
        DataInfo_Supplier_ECU_hardware_part_number_Major_release (DcmDspDataInfo): DcmDspDataFixedLength=true
        Supplier_ECU_hardware_part_number_Changes_in_electronic_components_level (DcmDspData): DcmDspDataSize=8, DcmDspDataType=UINT8, DcmDspDataInfoRef=DataInfo_Supplier_ECU_hardware_part_number_Changes_in_electronic_components_level
        DataInfo_Supplier_ECU_hardware_part_number_Changes_in_electronic_components_level (DcmDspDataInfo): DcmDspDataFixedLength=true
        Ignition_Switch_Signal_Ignition_Switch_Signal (DcmDspData): DcmDspDataSize=8, DcmDspDataType=UINT8, DcmDspDataInfoRef=DataInfo_Ignition_Switch_Signal_Ignition_Switch_Signal
        DataInfo_Ignition_Switch_Signal_Ignition_Switch_Signal (DcmDspDataInfo): DcmDspDataFixedLength=true
        Battery_Voltage_Battery_Voltage (DcmDspData): DcmDspDataSize=16, DcmDspDataType=UINT16, DcmDspDataInfoRef=DataInfo_Battery_Voltage_Battery_Voltage
        DataInfo_Battery_Voltage_Battery_Voltage (DcmDspDataInfo): DcmDspDataFixedLength=true
        Total_Odometer_Total_Odometer (DcmDspData): DcmDspDataSize=24, DcmDspDataType=UINT8_N, DcmDspDataInfoRef=DataInfo_Total_Odometer_Total_Odometer
        DataInfo_Total_Odometer_Total_Odometer (DcmDspDataInfo): DcmDspDataFixedLength=true
        Vehicle_speed_Vehicle_speed (DcmDspData): DcmDspDataSize=16, DcmDspDataType=UINT16, DcmDspDataInfoRef=DataInfo_Vehicle_speed_Vehicle_speed
        DataInfo_Vehicle_speed_Vehicle_speed (DcmDspDataInfo): DcmDspDataFixedLength=true
        Date_And_Time_Date_And_Time_Second (DcmDspData): DcmDspDataSize=8, DcmDspDataType=UINT8, DcmDspDataInfoRef=DataInfo_Date_And_Time_Date_And_Time_Second
        DataInfo_Date_And_Time_Date_And_Time_Second (DcmDspDataInfo): DcmDspDataFixedLength=true
        Date_And_Time_Date_And_Time_Minute (DcmDspData): DcmDspDataSize=8, DcmDspDataType=UINT8, DcmDspDataInfoRef=DataInfo_Date_And_Time_Date_And_Time_Minute
        DataInfo_Date_And_Time_Date_And_Time_Minute (DcmDspDataInfo): DcmDspDataFixedLength=true
        Date_And_Time_Date_And_Time_Hour (DcmDspData): DcmDspDataSize=8, DcmDspDataType=UINT8, DcmDspDataInfoRef=DataInfo_Date_And_Time_Date_And_Time_Hour
        DataInfo_Date_And_Time_Date_And_Time_Hour (DcmDspDataInfo): DcmDspDataFixedLength=true
        Date_And_Time_Date_And_Time_Day (DcmDspData): DcmDspDataSize=8, DcmDspDataType=UINT8, DcmDspDataInfoRef=DataInfo_Date_And_Time_Date_And_Time_Day
        DataInfo_Date_And_Time_Date_And_Time_Day (DcmDspDataInfo): DcmDspDataFixedLength=true
        Date_And_Time_Date_And_Time_Month (DcmDspData): DcmDspDataSize=8, DcmDspDataType=UINT8, DcmDspDataInfoRef=DataInfo_Date_And_Time_Date_And_Time_Month
        DataInfo_Date_And_Time_Date_And_Time_Month (DcmDspDataInfo): DcmDspDataFixedLength=true
        Date_And_Time_Date_And_Time_Year (DcmDspData): DcmDspDataSize=8, DcmDspDataType=UINT8, DcmDspDataInfoRef=DataInfo_Date_And_Time_Date_And_Time_Year
        DataInfo_Date_And_Time_Date_And_Time_Year (DcmDspDataInfo): DcmDspDataFixedLength=true
        VCU_HVStatus_VCU_HVStatus (DcmDspData): DcmDspDataSize=8, DcmDspDataType=UINT8, DcmDspDataInfoRef=DataInfo_VCU_HVStatus_VCU_HVStatus
        DataInfo_VCU_HVStatus_VCU_HVStatus (DcmDspDataInfo): DcmDspDataFixedLength=true
        SOC_SOC (DcmDspData): DcmDspDataSize=16, DcmDspDataType=UINT16, DcmDspDataInfoRef=DataInfo_SOC_SOC
        DataInfo_SOC_SOC (DcmDspDataInfo): DcmDspDataFixedLength=true
        Gear_Gear (DcmDspData): DcmDspDataSize=8, DcmDspDataType=UINT8, DcmDspDataInfoRef=DataInfo_Gear_Gear
        DataInfo_Gear_Gear (DcmDspDataInfo): DcmDspDataFixedLength=true
        42 x DcmDspDid:
          HV_Status_and_Charging_Status: DcmDspDidIdentifier=364, DcmDspDidInfoRef=DidInfo_HV_Status_and_Charging_Status
            HV_status_and_charging_status (DcmDspDidSignal): DcmDspDidDataPos=0, DcmDspDidDataRef=HV_Status_and_Charging_Status_HV_status_and_charging_status
          VCU_AccPealparameter: DcmDspDidIdentifier=7425, DcmDspDidInfoRef=DidInfo_VCU_AccPealparameter
            4 x DcmDspDidSignal:
              VCU_VehicleSpeed: DcmDspDidDataPos=0, DcmDspDidDataRef=VCU_AccPealparameter_VCU_VehicleSpeed
              Accelerator_pedal_sensor_1_voltage: DcmDspDidDataPos=16, DcmDspDidDataRef=VCU_AccPealparameter_Accelerator_pedal_sensor_1_voltage
              Accelerator_pedal_sensor_2_voltage: DcmDspDidDataPos=24, DcmDspDidDataRef=VCU_AccPealparameter_Accelerator_pedal_sensor_2_voltage
              VCU_AccelerationPedal: DcmDspDidDataPos=32, DcmDspDidDataRef=VCU_AccPealparameter_VCU_AccelerationPedal
          VCU_Torque_parameter: DcmDspDidIdentifier=7426, DcmDspDidInfoRef=DidInfo_VCU_Torque_parameter
            4 x DcmDspDidSignal:
              VCU_MCUDesiredTorque: DcmDspDidDataPos=0, DcmDspDidDataRef=VCU_Torque_parameter_VCU_MCUDesiredTorque
              Torque_MaxAllowed: DcmDspDidDataPos=16, DcmDspDidDataRef=VCU_Torque_parameter_Torque_MaxAllowed
              Torque_MinAllowed: DcmDspDidDataPos=32, DcmDspDidDataRef=VCU_Torque_parameter_Torque_MinAllowed
              VCU_RegenTorqueCap: DcmDspDidDataPos=48, DcmDspDidDataRef=VCU_Torque_parameter_VCU_RegenTorqueCap
          Driver_Mode: DcmDspDidIdentifier=7427, DcmDspDidInfoRef=DidInfo_Driver_Mode
            Driver_Mode (DcmDspDidSignal): DcmDspDidDataPos=0, DcmDspDidDataRef=Driver_Mode_Driver_Mode
          VCU_PowerMaxAllowed_parameter1: DcmDspDidIdentifier=7428, DcmDspDidInfoRef=DidInfo_VCU_PowerMaxAllowed_parameter1
            4 x DcmDspDidSignal:
              VCU_TCUPowerAllowed: DcmDspDidDataPos=0, DcmDspDidDataRef=VCU_PowerMaxAllowed_parameter1_VCU_TCUPowerAllowed
              VCU_DCDCPowerLimit: DcmDspDidDataPos=16, DcmDspDidDataRef=VCU_PowerMaxAllowed_parameter1_VCU_DCDCPowerLimit
              MCUPowerLimit: DcmDspDidDataPos=32, DcmDspDidDataRef=VCU_PowerMaxAllowed_parameter1_MCUPowerLimit
              VCU_A2LPowerMaxAllowed: DcmDspDidDataPos=48, DcmDspDidDataRef=VCU_PowerMaxAllowed_parameter1_VCU_A2LPowerMaxAllowed
          AC_charging_parameter: DcmDspDidIdentifier=7429, DcmDspDidInfoRef=DidInfo_AC_charging_parameter
            4 x DcmDspDidSignal:
              POD_OBC_InputACVoltage: DcmDspDidDataPos=0, DcmDspDidDataRef=AC_charging_parameter_POD_OBC_InputACVoltage
              VCU_OBC_ChargeCurrentCommand: DcmDspDidDataPos=16, DcmDspDidDataRef=AC_charging_parameter_VCU_OBC_ChargeCurrentCommand
              POD_OBC_OutputDCChargeCurrent: DcmDspDidDataPos=32, DcmDspDidDataRef=AC_charging_parameter_POD_OBC_OutputDCChargeCurrent
              POD_OBC_OutputDCChargeVoltage: DcmDspDidDataPos=48, DcmDspDidDataRef=AC_charging_parameter_POD_OBC_OutputDCChargeVoltage
          Chargestatus: DcmDspDidIdentifier=7430, DcmDspDidInfoRef=DidInfo_Chargestatus
            Chargestatus (DcmDspDidSignal): DcmDspDidDataPos=0, DcmDspDidDataRef=Chargestatus_Chargestatus
          Electronic_lock_state: DcmDspDidIdentifier=7431, DcmDspDidInfoRef=DidInfo_Electronic_lock_state
            Electronic_lock_state (DcmDspDidSignal): DcmDspDidDataPos=0, DcmDspDidDataRef=Electronic_lock_state_Electronic_lock_state
          VCU_HV_InterLock_PWM_pfrequency: DcmDspDidIdentifier=7432, DcmDspDidInfoRef=DidInfo_VCU_HV_InterLock_PWM_pfrequency
            VCU_HVIL (DcmDspDidSignal): DcmDspDidDataPos=0, DcmDspDidDataRef=VCU_HV_InterLock_PWM_pfrequency_VCU_HVIL
          S2_status: DcmDspDidIdentifier=7433, DcmDspDidInfoRef=DidInfo_S2_status
            New_Bit_Field (DcmDspDidSignal): DcmDspDidDataPos=0, DcmDspDidDataRef=S2_status_New_Bit_Field
          VCU_PowerMaxAllowed_parameter2: DcmDspDidIdentifier=7440, DcmDspDidInfoRef=DidInfo_VCU_PowerMaxAllowed_parameter2
            VCU_DCDCPowerLimit (DcmDspDidSignal): DcmDspDidDataPos=0, DcmDspDidDataRef=VCU_PowerMaxAllowed_parameter2_VCU_DCDCPowerLimit
            MCUPowerLimit (DcmDspDidSignal): DcmDspDidDataPos=16, DcmDspDidDataRef=VCU_PowerMaxAllowed_parameter2_MCUPowerLimit
          VCU_control_main_relay: DcmDspDidIdentifier=7441, DcmDspDidInfoRef=DidInfo_VCU_control_main_relay
            Mainrealy1 (DcmDspDidSignal): DcmDspDidDataPos=0, DcmDspDidDataRef=VCU_control_main_relay_Mainrealy1
            Mainrelay2 (DcmDspDidSignal): DcmDspDidDataPos=8, DcmDspDidDataRef=VCU_control_main_relay_Mainrelay2
          PWT_vehicle_fault_Level: DcmDspDidIdentifier=7442, DcmDspDidInfoRef=DidInfo_PWT_vehicle_fault_Level
            PWT_ErrorLevel (DcmDspDidSignal): DcmDspDidDataPos=0, DcmDspDidDataRef=PWT_vehicle_fault_Level_PWT_ErrorLevel
          Write_Level1_OEM_Key: DcmDspDidIdentifier=61456, DcmDspDidInfoRef=DidInfo_Write_Level1_OEM_Key
            OEM_Key_Value (DcmDspDidSignal): DcmDspDidDataPos=0, DcmDspDidDataRef=Write_Level1_OEM_Key_OEM_Key_Value
          Read_Level1_OEM_Key_written_status: DcmDspDidIdentifier=61457, DcmDspDidInfoRef=DidInfo_Read_Level1_OEM_Key_written_status
            OEM_Key_Write_state (DcmDspDidSignal): DcmDspDidDataPos=0, DcmDspDidDataRef=Read_Level1_OEM_Key_written_status_OEM_Key_Write_state
          Write_Level2_OEM_Key: DcmDspDidIdentifier=61458, DcmDspDidInfoRef=DidInfo_Write_Level2_OEM_Key
            OEM_Key_Value (DcmDspDidSignal): DcmDspDidDataPos=0, DcmDspDidDataRef=Write_Level2_OEM_Key_OEM_Key_Value
          Read_Level2_OEM_Key_written_status: DcmDspDidIdentifier=61459, DcmDspDidInfoRef=DidInfo_Read_Level2_OEM_Key_written_status
            OEM_Key_Write_state (DcmDspDidSignal): DcmDspDidDataPos=0, DcmDspDidDataRef=Read_Level2_OEM_Key_written_status_OEM_Key_Write_state
          Write_Level3_OEM_Key: DcmDspDidIdentifier=61460, DcmDspDidInfoRef=DidInfo_Write_Level3_OEM_Key
            OEM_Key_Value (DcmDspDidSignal): DcmDspDidDataPos=0, DcmDspDidDataRef=Write_Level3_OEM_Key_OEM_Key_Value
          Read_Level3_OEM_Key_written_status: DcmDspDidIdentifier=61461, DcmDspDidInfoRef=DidInfo_Read_Level3_OEM_Key_written_status
            OEM_Key_Write_state (DcmDspDidSignal): DcmDspDidDataPos=0, DcmDspDidDataRef=Read_Level3_OEM_Key_written_status_OEM_Key_Write_state
          Write_Level4_OEM_Key: DcmDspDidIdentifier=61462, DcmDspDidInfoRef=DidInfo_Write_Level4_OEM_Key
            OEM_Key_Value (DcmDspDidSignal): DcmDspDidDataPos=0, DcmDspDidDataRef=Write_Level4_OEM_Key_OEM_Key_Value
          Read_Level4_OEM_Key_written_status: DcmDspDidIdentifier=61463, DcmDspDidInfoRef=DidInfo_Read_Level4_OEM_Key_written_status
            OEM_Key_Write_state (DcmDspDidSignal): DcmDspDidDataPos=0, DcmDspDidDataRef=Read_Level4_OEM_Key_written_status_OEM_Key_Write_state
          Bootloader_version_number: DcmDspDidIdentifier=61697, DcmDspDidInfoRef=DidInfo_Bootloader_version_number
            3 x DcmDspDidSignal:
              Major_release: DcmDspDidDataPos=0, DcmDspDidDataRef=Bootloader_version_number_Major_release
              Minor_release: DcmDspDidDataPos=8, DcmDspDidDataRef=Bootloader_version_number_Minor_release
              No_functional_content_change: DcmDspDidDataPos=16, DcmDspDidDataRef=Bootloader_version_number_No_functional_content_change
          EcuIdentification: DcmDspDidIdentifier=61698, DcmDspDidInfoRef=DidInfo_EcuIdentification
            5 x DcmDspDidSignal:
              Specific_Vehicle_Code_WMI: DcmDspDidDataPos=0, DcmDspDidDataRef=EcuIdentification_Specific_Vehicle_Code_WMI
              Group: DcmDspDidDataPos=48, DcmDspDidDataRef=EcuIdentification_Group
              Subgroup: DcmDspDidDataPos=64, DcmDspDidDataRef=EcuIdentification_Subgroup
              Detail_Code: DcmDspDidDataPos=80, DcmDspDidDataRef=EcuIdentification_Detail_Code
              Execution_Package: DcmDspDidDataPos=104, DcmDspDidDataRef=EcuIdentification_Execution_Package
          ECU_application_software_ASW_part_number: DcmDspDidIdentifier=61700, DcmDspDidInfoRef=DidInfo_ECU_application_software_ASW_part_number
            3 x DcmDspDidSignal:
              Major_release: DcmDspDidDataPos=0, DcmDspDidDataRef=ECU_application_software_ASW_part_number_Major_release
              Minor_release: DcmDspDidDataPos=8, DcmDspDidDataRef=ECU_application_software_ASW_part_number_Minor_release
              No_functional_content_change: DcmDspDidDataPos=16, DcmDspDidDataRef=ECU_application_software_ASW_part_number_No_functional_content_change
          Read_Write_coding_data_string_CDS: DcmDspDidIdentifier=61704, DcmDspDidInfoRef=DidInfo_Read_Write_coding_data_string_CDS
            14 x DcmDspDidSignal:
              Version_Byte_0: DcmDspDidDataPos=0, DcmDspDidDataRef=Read_Write_coding_data_string_CDS_Version_Byte_0
              Version_Byte_1: DcmDspDidDataPos=8, DcmDspDidDataRef=Read_Write_coding_data_string_CDS_Version_Byte_1
              CDS_Short_VIN_High_Byte_0: DcmDspDidDataPos=16, DcmDspDidDataRef=Read_Write_coding_data_string_CDS_CDS_Short_VIN_High_Byte_0
              CDS_Short_VIN_High_Byte_1: DcmDspDidDataPos=24, DcmDspDidDataRef=Read_Write_coding_data_string_CDS_CDS_Short_VIN_High_Byte_1
              CDS_Short_VIN_High_Byte_2: DcmDspDidDataPos=32, DcmDspDidDataRef=Read_Write_coding_data_string_CDS_CDS_Short_VIN_High_Byte_2
              CDS_Short_VIN_High_Byte_3: DcmDspDidDataPos=40, DcmDspDidDataRef=Read_Write_coding_data_string_CDS_CDS_Short_VIN_High_Byte_3
              CDS_Short_VIN_High_Byte_4: DcmDspDidDataPos=48, DcmDspDidDataRef=Read_Write_coding_data_string_CDS_CDS_Short_VIN_High_Byte_4
              CDS_Short_VIN_High_Byte_5: DcmDspDidDataPos=56, DcmDspDidDataRef=Read_Write_coding_data_string_CDS_CDS_Short_VIN_High_Byte_5
              CDS_Short_VIN_High_Byte_7: DcmDspDidDataPos=64, DcmDspDidDataRef=Read_Write_coding_data_string_CDS_CDS_Short_VIN_High_Byte_7
              CDS_Format_Byte_High_Byte_0: DcmDspDidDataPos=72, DcmDspDidDataRef=Read_Write_coding_data_string_CDS_CDS_Format_Byte_High_Byte_0
              CDS_Format_Byte_High_Byte_1: DcmDspDidDataPos=80, DcmDspDidDataRef=Read_Write_coding_data_string_CDS_CDS_Format_Byte_High_Byte_1
              Configuration1: DcmDspDidDataPos=88, DcmDspDidDataRef=Read_Write_coding_data_string_CDS_Configuration1
              Configuration2: DcmDspDidDataPos=96, DcmDspDidDataRef=Read_Write_coding_data_string_CDS_Configuration2
              CDS_CRC: DcmDspDidDataPos=104, DcmDspDidDataRef=Read_Write_coding_data_string_CDS_CDS_CRC
          Coding_for_CDS_fingerprint: DcmDspDidIdentifier=61706, DcmDspDidInfoRef=DidInfo_Coding_for_CDS_fingerprint
            4 x DcmDspDidSignal:
              codingDate_byte_1_YY: DcmDspDidDataPos=0, DcmDspDidDataRef=Coding_for_CDS_fingerprint_codingDate_byte_1_YY
              codingDate_byte_2_MM: DcmDspDidDataPos=8, DcmDspDidDataRef=Coding_for_CDS_fingerprint_codingDate_byte_2_MM
              codingDate_byte_3_DD: DcmDspDidDataPos=16, DcmDspDidDataRef=Coding_for_CDS_fingerprint_codingDate_byte_3_DD
              repairShopCodeorTesterSerialNumber_byte_1_27_MSB: DcmDspDidDataPos=24, DcmDspDidDataRef=Coding_for_CDS_fingerprint_repairShopCodeorTesterSerialNumber_byte_1_27_MSB
          Last_service_date: DcmDspDidIdentifier=61711, DcmDspDidInfoRef=DidInfo_Last_service_date
            3 x DcmDspDidSignal:
              Year: DcmDspDidDataPos=0, DcmDspDidDataRef=Last_service_date_Year
              Month: DcmDspDidDataPos=8, DcmDspDidDataRef=Last_service_date_Month
              Day: DcmDspDidDataPos=16, DcmDspDidDataRef=Last_service_date_Day
          Read_active_diagnostic_session: DcmDspDidIdentifier=61830, DcmDspDidInfoRef=DidInfo_Read_active_diagnostic_session
            Active_diagnostic_session (DcmDspDidSignal): DcmDspDidDataPos=0, DcmDspDidDataRef=Read_active_diagnostic_session_Active_diagnostic_session
          Read_ECU_Part_Number: DcmDspDidIdentifier=61831, DcmDspDidInfoRef=DidInfo_Read_ECU_Part_Number
            5 x DcmDspDidSignal:
              Specific_Vehicle_Code_WMI: DcmDspDidDataPos=0, DcmDspDidDataRef=Read_ECU_Part_Number_Specific_Vehicle_Code_WMI
              Group: DcmDspDidDataPos=48, DcmDspDidDataRef=Read_ECU_Part_Number_Group
              Subgroup: DcmDspDidDataPos=64, DcmDspDidDataRef=Read_ECU_Part_Number_Subgroup
              Detail_Code: DcmDspDidDataPos=80, DcmDspDidDataRef=Read_ECU_Part_Number_Detail_Code
              Execution_Package: DcmDspDidDataPos=104, DcmDspDidDataRef=Read_ECU_Part_Number_Execution_Package
          DevelopmentData: DcmDspDidIdentifier=61834, DcmDspDidInfoRef=DidInfo_DevelopmentData
            3 x DcmDspDidSignal:
              OperatingSystemVersion: DcmDspDidDataPos=0, DcmDspDidDataRef=DevelopmentData_OperatingSystemVersion
              CanDriverVersion: DcmDspDidDataPos=16, DcmDspDidDataRef=DevelopmentData_CanDriverVersion
              NmVersion: DcmDspDidDataPos=40, DcmDspDidDataRef=DevelopmentData_NmVersion
          Read_ECU_manufacturing_date: DcmDspDidIdentifier=61835, DcmDspDidInfoRef=DidInfo_Read_ECU_manufacturing_date
            3 x DcmDspDidSignal:
              ECU_Manufacturing_Date_Year: DcmDspDidDataPos=0, DcmDspDidDataRef=Read_ECU_manufacturing_date_ECU_Manufacturing_Date_Year
              ECU_Manufacturing_Date_Month: DcmDspDidDataPos=8, DcmDspDidDataRef=Read_ECU_manufacturing_date_ECU_Manufacturing_Date_Month
              ECU_Manufacturing_Date_Day: DcmDspDidDataPos=16, DcmDspDidDataRef=Read_ECU_manufacturing_date_ECU_Manufacturing_Date_Day
          SerialNumber: DcmDspDidIdentifier=61836, DcmDspDidInfoRef=DidInfo_SerialNumber
            4 x DcmDspDidSignal:
              ECU_Name: DcmDspDidDataPos=0, DcmDspDidDataRef=SerialNumber_ECU_Name
              Supplier_name: DcmDspDidDataPos=24, DcmDspDidDataRef=SerialNumber_Supplier_name
              ECU_production_date_in_DD_MM_YY_format: DcmDspDidDataPos=64, DcmDspDidDataRef=SerialNumber_ECU_production_date_in_DD_MM_YY_format
              ECU_index_number: DcmDspDidDataPos=112, DcmDspDidDataRef=SerialNumber_ECU_index_number
          Read_Write_complete_VIN: DcmDspDidIdentifier=61840, DcmDspDidInfoRef=DidInfo_Read_Write_complete_VIN
            3 x DcmDspDidSignal:
              World_Manufacturers_Identification: DcmDspDidDataPos=0, DcmDspDidDataRef=Read_Write_complete_VIN_World_Manufacturers_Identification
              Vehicle_Description_Section: DcmDspDidDataPos=24, DcmDspDidDataRef=Read_Write_complete_VIN_Vehicle_Description_Section
              Vehicle_Identification_Section: DcmDspDidDataPos=64, DcmDspDidDataRef=Read_Write_complete_VIN_Vehicle_Identification_Section
          Supplier_ECU_hardware_part_number: DcmDspDidIdentifier=61842, DcmDspDidInfoRef=DidInfo_Supplier_ECU_hardware_part_number
            Major_release (DcmDspDidSignal): DcmDspDidDataPos=0, DcmDspDidDataRef=Supplier_ECU_hardware_part_number_Major_release
            Changes_in_electronic_components_level (DcmDspDidSignal): DcmDspDidDataPos=8, DcmDspDidDataRef=Supplier_ECU_hardware_part_number_Changes_in_electronic_components_level
          Ignition_Switch_Signal: DcmDspDidIdentifier=61856, DcmDspDidInfoRef=DidInfo_Ignition_Switch_Signal
            Ignition_Switch_Signal (DcmDspDidSignal): DcmDspDidDataPos=0, DcmDspDidDataRef=Ignition_Switch_Signal_Ignition_Switch_Signal
          Battery_Voltage: DcmDspDidIdentifier=61857, DcmDspDidInfoRef=DidInfo_Battery_Voltage
            Battery_Voltage (DcmDspDidSignal): DcmDspDidDataPos=0, DcmDspDidDataRef=Battery_Voltage_Battery_Voltage
          Total_Odometer: DcmDspDidIdentifier=61858, DcmDspDidInfoRef=DidInfo_Total_Odometer
            Total_Odometer (DcmDspDidSignal): DcmDspDidDataPos=0, DcmDspDidDataRef=Total_Odometer_Total_Odometer
          Vehicle_speed: DcmDspDidIdentifier=61859, DcmDspDidInfoRef=DidInfo_Vehicle_speed
            Vehicle_speed (DcmDspDidSignal): DcmDspDidDataPos=0, DcmDspDidDataRef=Vehicle_speed_Vehicle_speed
          Date_And_Time: DcmDspDidIdentifier=61860, DcmDspDidInfoRef=DidInfo_Date_And_Time
            6 x DcmDspDidSignal:
              Date_And_Time_Second: DcmDspDidDataPos=0, DcmDspDidDataRef=Date_And_Time_Date_And_Time_Second
              Date_And_Time_Minute: DcmDspDidDataPos=8, DcmDspDidDataRef=Date_And_Time_Date_And_Time_Minute
              Date_And_Time_Hour: DcmDspDidDataPos=16, DcmDspDidDataRef=Date_And_Time_Date_And_Time_Hour
              Date_And_Time_Day: DcmDspDidDataPos=24, DcmDspDidDataRef=Date_And_Time_Date_And_Time_Day
              Date_And_Time_Month: DcmDspDidDataPos=32, DcmDspDidDataRef=Date_And_Time_Date_And_Time_Month
              Date_And_Time_Year: DcmDspDidDataPos=40, DcmDspDidDataRef=Date_And_Time_Date_And_Time_Year
          VCU_HVStatus: DcmDspDidIdentifier=61861, DcmDspDidInfoRef=DidInfo_VCU_HVStatus
            VCU_HVStatus (DcmDspDidSignal): DcmDspDidDataPos=0, DcmDspDidDataRef=VCU_HVStatus_VCU_HVStatus
          SOC: DcmDspDidIdentifier=61862, DcmDspDidInfoRef=DidInfo_SOC
            SOC (DcmDspDidSignal): DcmDspDidDataPos=0, DcmDspDidDataRef=SOC_SOC
          Gear: DcmDspDidIdentifier=61863, DcmDspDidInfoRef=DidInfo_Gear
            Gear (DcmDspDidSignal): DcmDspDidDataPos=0, DcmDspDidDataRef=Gear_Gear
        42 x DcmDspDidInfo:
          DidInfo_HV_Status_and_Charging_Status
            DcmDspDidAccess
              DcmDspDidRead: DcmDspDidReadSessionRef=DcmDspSession/Default, DcmDspDidReadSessionRef=DcmDspSession/Extended, DcmDspDidReadSessionRef=Coding_Session
          DidInfo_VCU_AccPealparameter
            DcmDspDidAccess
              DcmDspDidRead: DcmDspDidReadSessionRef=DcmDspSession/Default, DcmDspDidReadSessionRef=DcmDspSession/Extended, DcmDspDidReadSessionRef=Coding_Session
          DidInfo_VCU_Torque_parameter
            DcmDspDidAccess
              DcmDspDidRead: DcmDspDidReadSessionRef=DcmDspSession/Default, DcmDspDidReadSessionRef=DcmDspSession/Extended, DcmDspDidReadSessionRef=Coding_Session
          DidInfo_Driver_Mode
            DcmDspDidAccess
              DcmDspDidRead: DcmDspDidReadSessionRef=DcmDspSession/Default, DcmDspDidReadSessionRef=DcmDspSession/Extended, DcmDspDidReadSessionRef=Coding_Session
          DidInfo_VCU_PowerMaxAllowed_parameter1
            DcmDspDidAccess
              DcmDspDidRead: DcmDspDidReadSessionRef=DcmDspSession/Default, DcmDspDidReadSessionRef=DcmDspSession/Extended, DcmDspDidReadSessionRef=Coding_Session
          DidInfo_AC_charging_parameter
            DcmDspDidAccess
              DcmDspDidRead: DcmDspDidReadSessionRef=DcmDspSession/Default, DcmDspDidReadSessionRef=DcmDspSession/Extended, DcmDspDidReadSessionRef=Coding_Session
          DidInfo_Chargestatus
            DcmDspDidAccess
              DcmDspDidRead: DcmDspDidReadSessionRef=DcmDspSession/Default, DcmDspDidReadSessionRef=DcmDspSession/Extended, DcmDspDidReadSessionRef=Coding_Session
          DidInfo_Electronic_lock_state
            DcmDspDidAccess
              DcmDspDidRead: DcmDspDidReadSessionRef=DcmDspSession/Default, DcmDspDidReadSessionRef=DcmDspSession/Extended, DcmDspDidReadSessionRef=Coding_Session
          DidInfo_VCU_HV_InterLock_PWM_pfrequency
            DcmDspDidAccess
              DcmDspDidRead: DcmDspDidReadSessionRef=DcmDspSession/Default, DcmDspDidReadSessionRef=DcmDspSession/Extended, DcmDspDidReadSessionRef=Coding_Session
          DidInfo_S2_status
            DcmDspDidAccess
              DcmDspDidRead: DcmDspDidReadSessionRef=DcmDspSession/Default, DcmDspDidReadSessionRef=DcmDspSession/Extended, DcmDspDidReadSessionRef=Coding_Session
          DidInfo_VCU_PowerMaxAllowed_parameter2
            DcmDspDidAccess
              DcmDspDidRead: DcmDspDidReadSessionRef=DcmDspSession/Default, DcmDspDidReadSessionRef=DcmDspSession/Extended, DcmDspDidReadSessionRef=Coding_Session
          DidInfo_VCU_control_main_relay
            DcmDspDidAccess
              DcmDspDidRead: DcmDspDidReadSessionRef=DcmDspSession/Default, DcmDspDidReadSessionRef=DcmDspSession/Extended, DcmDspDidReadSessionRef=Coding_Session
          DidInfo_PWT_vehicle_fault_Level
            DcmDspDidAccess
              DcmDspDidRead: DcmDspDidReadSessionRef=DcmDspSession/Default, DcmDspDidReadSessionRef=DcmDspSession/Extended, DcmDspDidReadSessionRef=Coding_Session
          DidInfo_Write_Level1_OEM_Key
            DcmDspDidAccess
              DcmDspDidWrite: DcmDspDidWriteSessionRef=DcmDspSession/Extended, DcmDspDidWriteSecurityLevelRef=UnlockedL1
          DidInfo_Read_Level1_OEM_Key_written_status
            DcmDspDidAccess
              DcmDspDidRead: DcmDspDidReadSessionRef=DcmDspSession/Default, DcmDspDidReadSessionRef=DcmDspSession/Extended, DcmDspDidReadSessionRef=Coding_Session
          DidInfo_Write_Level2_OEM_Key
            DcmDspDidAccess
              DcmDspDidWrite: DcmDspDidWriteSessionRef=DcmDspSession/Extended, DcmDspDidWriteSecurityLevelRef=Unlocked_Level_2
          DidInfo_Read_Level2_OEM_Key_written_status
            DcmDspDidAccess
              DcmDspDidRead: DcmDspDidReadSessionRef=DcmDspSession/Default, DcmDspDidReadSessionRef=DcmDspSession/Extended, DcmDspDidReadSessionRef=Coding_Session
          DidInfo_Write_Level3_OEM_Key
            DcmDspDidAccess
              DcmDspDidWrite: DcmDspDidWriteSessionRef=Coding_Session, DcmDspDidWriteSecurityLevelRef=Unlocked_Level_3
          DidInfo_Read_Level3_OEM_Key_written_status
            DcmDspDidAccess
              DcmDspDidRead: DcmDspDidReadSessionRef=DcmDspSession/Default, DcmDspDidReadSessionRef=DcmDspSession/Extended, DcmDspDidReadSessionRef=Coding_Session
          DidInfo_Write_Level4_OEM_Key
            DcmDspDidAccess
              DcmDspDidWrite: DcmDspDidWriteSessionRef=DcmDspSession/Programming, DcmDspDidWriteSecurityLevelRef=Unlocked_Level_4
          DidInfo_Read_Level4_OEM_Key_written_status
            DcmDspDidAccess
              DcmDspDidRead: DcmDspDidReadSessionRef=DcmDspSession/Default, DcmDspDidReadSessionRef=DcmDspSession/Extended, DcmDspDidReadSessionRef=Coding_Session
          DidInfo_Bootloader_version_number
            DcmDspDidAccess
              DcmDspDidRead: DcmDspDidReadSessionRef=DcmDspSession/Default, DcmDspDidReadSessionRef=DcmDspSession/Extended, DcmDspDidReadSessionRef=Coding_Session
          DidInfo_EcuIdentification
            DcmDspDidAccess
              DcmDspDidRead: DcmDspDidReadSessionRef=DcmDspSession/Default, DcmDspDidReadSessionRef=DcmDspSession/Extended, DcmDspDidReadSessionRef=Coding_Session
          DidInfo_ECU_application_software_ASW_part_number
            DcmDspDidAccess
              DcmDspDidRead: DcmDspDidReadSessionRef=DcmDspSession/Default, DcmDspDidReadSessionRef=DcmDspSession/Extended, DcmDspDidReadSessionRef=Coding_Session
          DidInfo_Read_Write_coding_data_string_CDS
            DcmDspDidAccess
              DcmDspDidRead: DcmDspDidReadSessionRef=DcmDspSession/Default, DcmDspDidReadSessionRef=DcmDspSession/Extended, DcmDspDidReadSessionRef=Coding_Session
              DcmDspDidWrite: DcmDspDidWriteSessionRef=Coding_Session, DcmDspDidWriteSecurityLevelRef=Unlocked_Level_3
          DidInfo_Coding_for_CDS_fingerprint
            DcmDspDidAccess
              DcmDspDidRead: DcmDspDidReadSessionRef=DcmDspSession/Default, DcmDspDidReadSessionRef=DcmDspSession/Extended, DcmDspDidReadSessionRef=Coding_Session
              DcmDspDidWrite: DcmDspDidWriteSessionRef=Coding_Session, DcmDspDidWriteSecurityLevelRef=Unlocked_Level_3
          DidInfo_Last_service_date
            DcmDspDidAccess
              DcmDspDidRead: DcmDspDidReadSessionRef=DcmDspSession/Default, DcmDspDidReadSessionRef=DcmDspSession/Extended, DcmDspDidReadSessionRef=Coding_Session
              DcmDspDidWrite: DcmDspDidWriteSessionRef=DcmDspSession/Extended, DcmDspDidWriteSecurityLevelRef=UnlockedL1
          DidInfo_Read_active_diagnostic_session
            DcmDspDidAccess
              DcmDspDidRead: DcmDspDidReadSessionRef=DcmDspSession/Default, DcmDspDidReadSessionRef=DcmDspSession/Extended, DcmDspDidReadSessionRef=Coding_Session
          DidInfo_Read_ECU_Part_Number
            DcmDspDidAccess
              DcmDspDidRead: DcmDspDidReadSessionRef=DcmDspSession/Default, DcmDspDidReadSessionRef=DcmDspSession/Extended, DcmDspDidReadSessionRef=Coding_Session
          DidInfo_DevelopmentData
            DcmDspDidAccess
              DcmDspDidRead: DcmDspDidReadSessionRef=DcmDspSession/Default, DcmDspDidReadSessionRef=DcmDspSession/Extended, DcmDspDidReadSessionRef=Coding_Session
          DidInfo_Read_ECU_manufacturing_date
            DcmDspDidAccess
              DcmDspDidRead: DcmDspDidReadSessionRef=DcmDspSession/Default, DcmDspDidReadSessionRef=DcmDspSession/Extended, DcmDspDidReadSessionRef=Coding_Session
          DidInfo_SerialNumber
            DcmDspDidAccess
              DcmDspDidRead: DcmDspDidReadSessionRef=DcmDspSession/Default, DcmDspDidReadSessionRef=DcmDspSession/Extended, DcmDspDidReadSessionRef=Coding_Session
          DidInfo_Read_Write_complete_VIN
            DcmDspDidAccess
              DcmDspDidRead: DcmDspDidReadSessionRef=DcmDspSession/Default, DcmDspDidReadSessionRef=DcmDspSession/Extended, DcmDspDidReadSessionRef=Coding_Session
              DcmDspDidWrite: DcmDspDidWriteSessionRef=DcmDspSession/Extended, DcmDspDidWriteSecurityLevelRef=UnlockedL1, DcmDspDidWriteSecurityLevelRef=Unlocked_Level_2
          DidInfo_Supplier_ECU_hardware_part_number
            DcmDspDidAccess
              DcmDspDidRead: DcmDspDidReadSessionRef=DcmDspSession/Default, DcmDspDidReadSessionRef=DcmDspSession/Extended, DcmDspDidReadSessionRef=Coding_Session
          DidInfo_Ignition_Switch_Signal
            DcmDspDidAccess
              DcmDspDidRead: DcmDspDidReadSessionRef=DcmDspSession/Default, DcmDspDidReadSessionRef=DcmDspSession/Extended, DcmDspDidReadSessionRef=Coding_Session
          DidInfo_Battery_Voltage
            DcmDspDidAccess
              DcmDspDidRead: DcmDspDidReadSessionRef=DcmDspSession/Default, DcmDspDidReadSessionRef=DcmDspSession/Extended, DcmDspDidReadSessionRef=Coding_Session
          DidInfo_Total_Odometer
            DcmDspDidAccess
              DcmDspDidRead: DcmDspDidReadSessionRef=DcmDspSession/Default, DcmDspDidReadSessionRef=DcmDspSession/Extended, DcmDspDidReadSessionRef=Coding_Session
          DidInfo_Vehicle_speed
            DcmDspDidAccess
              DcmDspDidRead: DcmDspDidReadSessionRef=DcmDspSession/Default, DcmDspDidReadSessionRef=DcmDspSession/Extended, DcmDspDidReadSessionRef=Coding_Session
          DidInfo_Date_And_Time
            DcmDspDidAccess
              DcmDspDidRead: DcmDspDidReadSessionRef=DcmDspSession/Default, DcmDspDidReadSessionRef=DcmDspSession/Extended, DcmDspDidReadSessionRef=Coding_Session
          DidInfo_VCU_HVStatus
            DcmDspDidAccess
              DcmDspDidRead: DcmDspDidReadSessionRef=DcmDspSession/Default, DcmDspDidReadSessionRef=DcmDspSession/Extended, DcmDspDidReadSessionRef=Coding_Session
          DidInfo_SOC
            DcmDspDidAccess
              DcmDspDidRead: DcmDspDidReadSessionRef=DcmDspSession/Default, DcmDspDidReadSessionRef=DcmDspSession/Extended, DcmDspDidReadSessionRef=Coding_Session
          DidInfo_Gear
            DcmDspDidAccess
              DcmDspDidRead: DcmDspDidReadSessionRef=DcmDspSession/Default, DcmDspDidReadSessionRef=DcmDspSession/Extended, DcmDspDidReadSessionRef=Coding_Session
        6 x DcmDspRoutine, all with DcmDspRequestResultsRoutineSupported=false:
          CheckCodingState: DcmDspStopRoutineSupported=false, DcmDspRoutineIdentifier=258, DcmDspRoutineInfoRef=RoutineInfo_CheckCodingState
          Check_Memory: DcmDspStopRoutineSupported=false, DcmDspRoutineIdentifier=514, DcmDspRoutineInfoRef=RoutineInfo_Check_Memory
          CheckProgrammingPreCondition: DcmDspStopRoutineSupported=false, DcmDspRoutineIdentifier=515, DcmDspRoutineInfoRef=RoutineInfo_CheckProgrammingPreCondition
          Turn_Off_HV_Turn_Off_Charging: DcmDspStopRoutineSupported=true, DcmDspRoutineIdentifier=61440, DcmDspRoutineInfoRef=RoutineInfo_Turn_Off_HV_Turn_Off_Charging
          Erase_Memory: DcmDspStopRoutineSupported=false, DcmDspRoutineIdentifier=65280, DcmDspRoutineInfoRef=RoutineInfo_Erase_Memory
          CheckProgrammingDependencies: DcmDspStopRoutineSupported=false, DcmDspRoutineIdentifier=65281, DcmDspRoutineInfoRef=RoutineInfo_CheckProgrammingDependencies
        6 x DcmDspRoutineInfo:
          RoutineInfo_CheckCodingState
            DcmDspRoutineAuthorization: DcmDspRoutineSessionRef=Coding_Session, DcmDspRoutineSecurityLevelRef=Unlocked_Level_3
            DcmDspStartRoutineOut
              Out_routineResult (DcmDspStartRoutineOutSignal): DcmDspRoutineSignalLength=8, DcmDspRoutineSignalType=UINT8, DcmDspRoutineSignalPos=0
          RoutineInfo_Check_Memory
            DcmDspRoutineAuthorization: DcmDspRoutineSessionRef=DcmDspSession/Programming, DcmDspRoutineSecurityLevelRef=Unlocked_Level_4
            DcmDspStartRoutineIn
              In_checksum (DcmDspStartRoutineInSignal): DcmDspRoutineSignalLength=32, DcmDspRoutineSignalType=UINT32, DcmDspRoutineSignalEndianness=BIG_ENDIAN, DcmDspRoutineSignalPos=0
            DcmDspStartRoutineOut
              Out_routineResult (DcmDspStartRoutineOutSignal): DcmDspRoutineSignalLength=8, DcmDspRoutineSignalType=UINT8, DcmDspRoutineSignalPos=0
          RoutineInfo_CheckProgrammingPreCondition
            DcmDspRoutineAuthorization: DcmDspRoutineSessionRef=DcmDspSession/Extended
            DcmDspStartRoutineOut
              Out_programmingPreConditionList (DcmDspStartRoutineOutSignal): DcmDspRoutineSignalLength=56, DcmDspRoutineSignalType=UINT8_N, DcmDspRoutineSignalEndianness=opaque, DcmDspRoutineSignalPos=0
          RoutineInfo_Turn_Off_HV_Turn_Off_Charging
            DcmDspRoutineAuthorization: DcmDspRoutineSessionRef=DcmDspSession/Programming, DcmDspRoutineSessionRef=DcmDspSession/Extended, DcmDspRoutineSessionRef=Coding_Session
            DcmDspStartRoutineOut
              Out_routineResult (DcmDspStartRoutineOutSignal): DcmDspRoutineSignalLength=8, DcmDspRoutineSignalType=UINT8, DcmDspRoutineSignalPos=0
          RoutineInfo_Erase_Memory
            DcmDspRoutineAuthorization: DcmDspRoutineSessionRef=DcmDspSession/Programming, DcmDspRoutineSecurityLevelRef=Unlocked_Level_4
            DcmDspStartRoutineIn
              3 x DcmDspStartRoutineInSignal:
                In_addressAndLengthFormatIdentifier: DcmDspRoutineSignalLength=8, DcmDspRoutineSignalType=UINT8, DcmDspRoutineSignalPos=0
                In_memoryAddress: DcmDspRoutineSignalLength=32, DcmDspRoutineSignalType=UINT32, DcmDspRoutineSignalEndianness=BIG_ENDIAN, DcmDspRoutineSignalPos=8
                In_memorySize: DcmDspRoutineSignalLength=32, DcmDspRoutineSignalType=UINT32, DcmDspRoutineSignalEndianness=BIG_ENDIAN, DcmDspRoutineSignalPos=40
            DcmDspStartRoutineOut
              Out_routineResult (DcmDspStartRoutineOutSignal): DcmDspRoutineSignalLength=8, DcmDspRoutineSignalType=UINT8, DcmDspRoutineSignalPos=0
          RoutineInfo_CheckProgrammingDependencies
            DcmDspRoutineAuthorization: DcmDspRoutineSessionRef=DcmDspSession/Programming, DcmDspRoutineSecurityLevelRef=Unlocked_Level_4
            DcmDspStartRoutineOut
              Out_routineResult (DcmDspStartRoutineOutSignal): DcmDspRoutineSignalLength=8, DcmDspRoutineSignalType=UINT8, DcmDspRoutineSignalPos=0
        DcmDspSecurity
          4 x DcmDspSecurityRow, all with DcmDspSecurityDelayTime=10, DcmDspSecurityDelayTimeOnBoot=0, DcmDspSecurityKeySize=16, DcmDspSecurityNumAttDelay=3, DcmDspSecuritySeedSize=16:
            UnlockedL1: DcmDspSecurityLevel=1
            Unlocked_Level_{2..4}: DcmDspSecurityLevel={2..4}
        DcmDspSession
          4 x DcmDspSessionRow, all with DcmDspSessionP2ServerMax=0.05, DcmDspSessionP2StarServerMax=5:
            Default: DcmDspSessionLevel=1, DcmDspSessionForBoot=DCM_NO_BOOT
            Programming: DcmDspSessionLevel=2
            Extended: DcmDspSessionLevel=3, DcmDspSessionForBoot=DCM_NO_BOOT
            Coding_Session: DcmDspSessionLevel=65
        ComControl (DcmDspComControl)
          DspComContolAllChannel (DcmDspComControlAllChannel)
