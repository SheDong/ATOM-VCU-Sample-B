[part 2 of 2: package /InitialEcuC]
AUTOSAR XML (schema 00048)
package /InitialEcuC  (continued)
  module config Dem: module-description=Dem_Impl
    DemConfigSet
      DTCClass_DTC_0x110012 (DemDTCClass): DemDTCSeverity=DEM_DTC_SEV_NO_SEVERITY, DemUdsDTC=1114130
      DTC_0x110012 (DemEventParameter):
        DemEventKind = DEM_EVENT_KIND_SWC
        DemDTCClassRef = DTCClass_DTC_0x110012
        DemExtendedDataClassRef = ExtendedDataClass_83dcefb7
        DemFreezeFrameClassRef = FreezeFrameClass_5f5b5001
        DemFreezeFrameRecNumClassRef = FreezeFrameRecNumClass_f98c8aa7
        DemEventClass:
          DemAgingAllowed = true
          DemAgingCycleCounterThreshold = 40
          DemEventDestination = DEM_DTC_ORIGIN_PRIMARY_MEMORY
          DemEventPriority = 2
          DemEventSignificance = DEM_EVENT_SIGNIFICANCE_FAULT
          DemEventFailureCycleCounterThreshold = 0
          DemAgingCycleRef = PowerCycle
          DemEnableConditionGroupRef = EnableConditionGroup_d57a23d8
          DemOperationCycleRef = PowerCycle
          DemDebounceAlgorithmClass
            DemDebounceCounterBased: DemDebounceCounterDecrementStepSize=1, DemDebounceCounterIncrementStepSize=1, DemDebounceCounterJumpDown=false, DemDebounceCounterJumpUp=true
          IndicatorAttribute_WarningIndicator (DemIndicatorAttribute): DemIndicatorFailureCycleSource=DEM_FAILURE_CYCLE_EVENT, DemIndicatorHealingCycleRef=PowerCycle, DemIndicatorRef=WarningIndicator
      DTCClass_DTC_0x110112 (DemDTCClass): DemDTCSeverity=DEM_DTC_SEV_NO_SEVERITY, DemUdsDTC=1114386
      DTC_0x110112 (DemEventParameter):
        DemEventKind = DEM_EVENT_KIND_SWC
        DemDTCClassRef = DTCClass_DTC_0x110112
        DemExtendedDataClassRef = ExtendedDataClass_83dcefb7
        DemFreezeFrameClassRef = FreezeFrameClass_5f5b5001
        DemFreezeFrameRecNumClassRef = FreezeFrameRecNumClass_f98c8aa7
        DemEventClass:
          DemAgingAllowed = true
          DemAgingCycleCounterThreshold = 40
          DemEventDestination = DEM_DTC_ORIGIN_PRIMARY_MEMORY
          DemEventPriority = 2
          DemEventSignificance = DEM_EVENT_SIGNIFICANCE_FAULT
          DemEventFailureCycleCounterThreshold = 0
          DemAgingCycleRef = PowerCycle
          DemEnableConditionGroupRef = EnableConditionGroup_d57a23d8
          DemOperationCycleRef = PowerCycle
          DemDebounceAlgorithmClass
            DemDebounceCounterBased: DemDebounceCounterDecrementStepSize=1, DemDebounceCounterIncrementStepSize=1, DemDebounceCounterJumpDown=false, DemDebounceCounterJumpUp=true
          IndicatorAttribute_WarningIndicator (DemIndicatorAttribute): DemIndicatorFailureCycleSource=DEM_FAILURE_CYCLE_EVENT, DemIndicatorHealingCycleRef=PowerCycle, DemIndicatorRef=WarningIndicator
      DTCClass_DTC_0x110211 (DemDTCClass): DemDTCSeverity=DEM_DTC_SEV_NO_SEVERITY, DemUdsDTC=1114641
      DTC_0x110211 (DemEventParameter):
        DemEventKind = DEM_EVENT_KIND_SWC
        DemDTCClassRef = DTCClass_DTC_0x110211
        DemExtendedDataClassRef = ExtendedDataClass_83dcefb7
        DemFreezeFrameClassRef = FreezeFrameClass_5f5b5001
        DemFreezeFrameRecNumClassRef = FreezeFrameRecNumClass_f98c8aa7
        DemEventClass:
          DemAgingAllowed = true
          DemAgingCycleCounterThreshold = 40
          DemEventDestination = DEM_DTC_ORIGIN_PRIMARY_MEMORY
          DemEventPriority = 2
          DemEventSignificance = DEM_EVENT_SIGNIFICANCE_FAULT
          DemEventFailureCycleCounterThreshold = 0
          DemAgingCycleRef = PowerCycle
          DemEnableConditionGroupRef = EnableConditionGroup_d57a23d8
          DemOperationCycleRef = PowerCycle
          DemDebounceAlgorithmClass
            DemDebounceCounterBased: DemDebounceCounterDecrementStepSize=1, DemDebounceCounterIncrementStepSize=1, DemDebounceCounterJumpDown=false, DemDebounceCounterJumpUp=true
          IndicatorAttribute_WarningIndicator (DemIndicatorAttribute): DemIndicatorFailureCycleSource=DEM_FAILURE_CYCLE_EVENT, DemIndicatorHealingCycleRef=PowerCycle, DemIndicatorRef=WarningIndicator
      DTCClass_DTC_0x110311 (DemDTCClass): DemDTCSeverity=DEM_DTC_SEV_NO_SEVERITY, DemUdsDTC=1114897
      DTC_0x110311 (DemEventParameter):
        DemEventKind = DEM_EVENT_KIND_SWC
        DemDTCClassRef = DTCClass_DTC_0x110311
        DemExtendedDataClassRef = ExtendedDataClass_83dcefb7
        DemFreezeFrameClassRef = FreezeFrameClass_5f5b5001
        DemFreezeFrameRecNumClassRef = FreezeFrameRecNumClass_f98c8aa7
        DemEventClass:
          DemAgingAllowed = true
          DemAgingCycleCounterThreshold = 40
          DemEventDestination = DEM_DTC_ORIGIN_PRIMARY_MEMORY
          DemEventPriority = 2
          DemEventSignificance = DEM_EVENT_SIGNIFICANCE_FAULT
          DemEventFailureCycleCounterThreshold = 0
          DemAgingCycleRef = PowerCycle
          DemEnableConditionGroupRef = EnableConditionGroup_d57a23d8
          DemOperationCycleRef = PowerCycle
          DemDebounceAlgorithmClass
            DemDebounceCounterBased: DemDebounceCounterDecrementStepSize=1, DemDebounceCounterIncrementStepSize=1, DemDebounceCounterJumpDown=false, DemDebounceCounterJumpUp=true
          IndicatorAttribute_WarningIndicator (DemIndicatorAttribute): DemIndicatorFailureCycleSource=DEM_FAILURE_CYCLE_EVENT, DemIndicatorHealingCycleRef=PowerCycle, DemIndicatorRef=WarningIndicator
      DTCClass_DTC_0x11041e (DemDTCClass): DemDTCSeverity=DEM_DTC_SEV_NO_SEVERITY, DemUdsDTC=1115166
      DTC_0x11041e (DemEventParameter):
        DemEventKind = DEM_EVENT_KIND_SWC
        DemDTCClassRef = DTCClass_DTC_0x11041e
        DemExtendedDataClassRef = ExtendedDataClass_83dcefb7
        DemFreezeFrameClassRef = FreezeFrameClass_de0e94c2
        DemFreezeFrameRecNumClassRef = FreezeFrameRecNumClass_f98c8aa7
        DemEventClass:
          DemAgingAllowed = true
          DemAgingCycleCounterThreshold = 40
          DemEventDestination = DEM_DTC_ORIGIN_PRIMARY_MEMORY
          DemEventPriority = 2
          DemEventSignificance = DEM_EVENT_SIGNIFICANCE_FAULT
          DemEventFailureCycleCounterThreshold = 0
          DemAgingCycleRef = PowerCycle
          DemEnableConditionGroupRef = EnableConditionGroup_d57a23d8
          DemOperationCycleRef = PowerCycle
          DemDebounceAlgorithmClass
            DemDebounceCounterBased: DemDebounceCounterDecrementStepSize=1, DemDebounceCounterIncrementStepSize=1, DemDebounceCounterJumpDown=false, DemDebounceCounterJumpUp=true
          IndicatorAttribute_WarningIndicator (DemIndicatorAttribute): DemIndicatorFailureCycleSource=DEM_FAILURE_CYCLE_EVENT, DemIndicatorHealingCycleRef=PowerCycle, DemIndicatorRef=WarningIndicator
      DTCClass_DTC_0x110a1e (DemDTCClass): DemDTCSeverity=DEM_DTC_SEV_NO_SEVERITY, DemUdsDTC=1116702
      DTC_0x110a1e (DemEventParameter):
        DemEventKind = DEM_EVENT_KIND_SWC
        DemDTCClassRef = DTCClass_DTC_0x110a1e
        DemExtendedDataClassRef = ExtendedDataClass_83dcefb7
        DemFreezeFrameClassRef = FreezeFrameClass_5f5b5001
        DemFreezeFrameRecNumClassRef = FreezeFrameRecNumClass_f98c8aa7
        DemEventClass:
          DemAgingAllowed = true
          DemAgingCycleCounterThreshold = 40
          DemEventDestination = DEM_DTC_ORIGIN_PRIMARY_MEMORY
          DemEventPriority = 2
          DemEventSignificance = DEM_EVENT_SIGNIFICANCE_FAULT
          DemEventFailureCycleCounterThreshold = 0
          DemAgingCycleRef = PowerCycle
          DemEnableConditionGroupRef = EnableConditionGroup_d57a23d8
          DemOperationCycleRef = PowerCycle
          DemDebounceAlgorithmClass
            DemDebounceCounterBased: DemDebounceCounterDecrementStepSize=1, DemDebounceCounterIncrementStepSize=1, DemDebounceCounterJumpDown=false, DemDebounceCounterJumpUp=true
          IndicatorAttribute_WarningIndicator (DemIndicatorAttribute): DemIndicatorFailureCycleSource=DEM_FAILURE_CYCLE_EVENT, DemIndicatorHealingCycleRef=PowerCycle, DemIndicatorRef=WarningIndicator
      DTCClass_DTC_0x110b1e (DemDTCClass): DemDTCSeverity=DEM_DTC_SEV_NO_SEVERITY, DemUdsDTC=1116958
      DTC_0x110b1e (DemEventParameter):
        DemEventKind = DEM_EVENT_KIND_SWC
        DemDTCClassRef = DTCClass_DTC_0x110b1e
        DemExtendedDataClassRef = ExtendedDataClass_83dcefb7
        DemFreezeFrameClassRef = FreezeFrameClass_5f5b5001
        DemFreezeFrameRecNumClassRef = FreezeFrameRecNumClass_f98c8aa7
        DemEventClass:
          DemAgingAllowed = true
          DemAgingCycleCounterThreshold = 40
          DemEventDestination = DEM_DTC_ORIGIN_PRIMARY_MEMORY
          DemEventPriority = 2
          DemEventSignificance = DEM_EVENT_SIGNIFICANCE_FAULT
          DemEventFailureCycleCounterThreshold = 0
          DemAgingCycleRef = PowerCycle
          DemEnableConditionGroupRef = EnableConditionGroup_d57a23d8
          DemOperationCycleRef = PowerCycle
          DemDebounceAlgorithmClass
            DemDebounceCounterBased: DemDebounceCounterDecrementStepSize=1, DemDebounceCounterIncrementStepSize=1, DemDebounceCounterJumpDown=false, DemDebounceCounterJumpUp=true
          IndicatorAttribute_WarningIndicator (DemIndicatorAttribute): DemIndicatorFailureCycleSource=DEM_FAILURE_CYCLE_EVENT, DemIndicatorHealingCycleRef=PowerCycle, DemIndicatorRef=WarningIndicator
      DTCClass_DTC_0x111152 (DemDTCClass): DemDTCSeverity=DEM_DTC_SEV_NO_SEVERITY, DemUdsDTC=1118546
      DTC_0x111152 (DemEventParameter):
        DemEventKind = DEM_EVENT_KIND_SWC
        DemDTCClassRef = DTCClass_DTC_0x111152
        DemExtendedDataClassRef = ExtendedDataClass_83dcefb7
        DemFreezeFrameClassRef = FreezeFrameClass_5f5b5001
        DemFreezeFrameRecNumClassRef = FreezeFrameRecNumClass_f98c8aa7
        DemEventClass:
          DemAgingAllowed = true
          DemAgingCycleCounterThreshold = 40
          DemEventDestination = DEM_DTC_ORIGIN_PRIMARY_MEMORY
          DemEventPriority = 2
          DemEventSignificance = DEM_EVENT_SIGNIFICANCE_FAULT
          DemEventFailureCycleCounterThreshold = 0
          DemAgingCycleRef = PowerCycle
          DemEnableConditionGroupRef = EnableConditionGroup_d57a23d8
          DemOperationCycleRef = PowerCycle
          DemDebounceAlgorithmClass
            DemDebounceCounterBased: DemDebounceCounterDecrementStepSize=1, DemDebounceCounterIncrementStepSize=1, DemDebounceCounterJumpDown=false, DemDebounceCounterJumpUp=true
          IndicatorAttribute_WarningIndicator (DemIndicatorAttribute): DemIndicatorFailureCycleSource=DEM_FAILURE_CYCLE_EVENT, DemIndicatorHealingCycleRef=PowerCycle, DemIndicatorRef=WarningIndicator
      DTCClass_DTC_0x111252 (DemDTCClass): DemDTCSeverity=DEM_DTC_SEV_NO_SEVERITY, DemUdsDTC=1118802
      DTC_0x111252 (DemEventParameter):
        DemEventKind = DEM_EVENT_KIND_SWC
        DemDTCClassRef = DTCClass_DTC_0x111252
        DemExtendedDataClassRef = ExtendedDataClass_83dcefb7
        DemFreezeFrameClassRef = FreezeFrameClass_5f5b5001
        DemFreezeFrameRecNumClassRef = FreezeFrameRecNumClass_f98c8aa7
        DemEventClass:
          DemAgingAllowed = true
          DemAgingCycleCounterThreshold = 40
          DemEventDestination = DEM_DTC_ORIGIN_PRIMARY_MEMORY
          DemEventPriority = 2
          DemEventSignificance = DEM_EVENT_SIGNIFICANCE_FAULT
          DemEventFailureCycleCounterThreshold = 0
          DemAgingCycleRef = PowerCycle
          DemEnableConditionGroupRef = EnableConditionGroup_d57a23d8
          DemOperationCycleRef = PowerCycle
          DemDebounceAlgorithmClass
            DemDebounceCounterBased: DemDebounceCounterDecrementStepSize=1, DemDebounceCounterIncrementStepSize=1, DemDebounceCounterJumpDown=false, DemDebounceCounterJumpUp=true
          IndicatorAttribute_WarningIndicator (DemIndicatorAttribute): DemIndicatorFailureCycleSource=DEM_FAILURE_CYCLE_EVENT, DemIndicatorHealingCycleRef=PowerCycle, DemIndicatorRef=WarningIndicator
      DTCClass_DTC_0x111352 (DemDTCClass): DemDTCSeverity=DEM_DTC_SEV_NO_SEVERITY, DemUdsDTC=1119058
      DTC_0x111352 (DemEventParameter):
        DemEventKind = DEM_EVENT_KIND_SWC
        DemDTCClassRef = DTCClass_DTC_0x111352
        DemExtendedDataClassRef = ExtendedDataClass_83dcefb7
        DemFreezeFrameClassRef = FreezeFrameClass_5f5b5001
        DemFreezeFrameRecNumClassRef = FreezeFrameRecNumClass_f98c8aa7
        DemEventClass:
          DemAgingAllowed = true
          DemAgingCycleCounterThreshold = 40
          DemEventDestination = DEM_DTC_ORIGIN_PRIMARY_MEMORY
          DemEventPriority = 2
          DemEventSignificance = DEM_EVENT_SIGNIFICANCE_FAULT
          DemEventFailureCycleCounterThreshold = 0
          DemAgingCycleRef = PowerCycle
          DemEnableConditionGroupRef = EnableConditionGroup_d57a23d8
          DemOperationCycleRef = PowerCycle
          DemDebounceAlgorithmClass
            DemDebounceCounterBased: DemDebounceCounterDecrementStepSize=1, DemDebounceCounterIncrementStepSize=1, DemDebounceCounterJumpDown=false, DemDebounceCounterJumpUp=true
          IndicatorAttribute_WarningIndicator (DemIndicatorAttribute): DemIndicatorFailureCycleSource=DEM_FAILURE_CYCLE_EVENT, DemIndicatorHealingCycleRef=PowerCycle, DemIndicatorRef=WarningIndicator
      DTCClass_DTC_0x111e71 (DemDTCClass): DemDTCSeverity=DEM_DTC_SEV_NO_SEVERITY, DemUdsDTC=1121905
      DTC_0x111e71 (DemEventParameter):
        DemEventKind = DEM_EVENT_KIND_SWC
        DemDTCClassRef = DTCClass_DTC_0x111e71
        DemExtendedDataClassRef = ExtendedDataClass_83dcefb7
        DemFreezeFrameClassRef = FreezeFrameClass_376d31f7
        DemFreezeFrameRecNumClassRef = FreezeFrameRecNumClass_f98c8aa7
        DemEventClass:
          DemAgingAllowed = true
          DemAgingCycleCounterThreshold = 40
          DemEventDestination = DEM_DTC_ORIGIN_PRIMARY_MEMORY
          DemEventPriority = 2
          DemEventSignificance = DEM_EVENT_SIGNIFICANCE_FAULT
          DemEventFailureCycleCounterThreshold = 0
          DemAgingCycleRef = PowerCycle
          DemEnableConditionGroupRef = EnableConditionGroup_2261a858
          DemOperationCycleRef = PowerCycle
          DemDebounceAlgorithmClass
            DemDebounceCounterBased: DemDebounceCounterDecrementStepSize=1, DemDebounceCounterIncrementStepSize=1, DemDebounceCounterJumpDown=false, DemDebounceCounterJumpUp=true
          IndicatorAttribute_WarningIndicator (DemIndicatorAttribute): DemIndicatorFailureCycleSource=DEM_FAILURE_CYCLE_EVENT, DemIndicatorHealingCycleRef=PowerCycle, DemIndicatorRef=WarningIndicator
      DTCClass_DTC_0x111f16 (DemDTCClass): DemDTCSeverity=DEM_DTC_SEV_NO_SEVERITY, DemUdsDTC=1122070
      DTC_0x111f16 (DemEventParameter):
        DemEventKind = DEM_EVENT_KIND_SWC
        DemDTCClassRef = DTCClass_DTC_0x111f16
        DemExtendedDataClassRef = ExtendedDataClass_83dcefb7
        DemFreezeFrameClassRef = FreezeFrameClass_d96350db
        DemFreezeFrameRecNumClassRef = FreezeFrameRecNumClass_f98c8aa7
        DemEventClass:
          DemAgingAllowed = true
          DemAgingCycleCounterThreshold = 40
          DemEventDestination = DEM_DTC_ORIGIN_PRIMARY_MEMORY
          DemEventPriority = 2
          DemEventSignificance = DEM_EVENT_SIGNIFICANCE_FAULT
          DemEventFailureCycleCounterThreshold = 0
          DemAgingCycleRef = PowerCycle
          DemEnableConditionGroupRef = EnableConditionGroup_f1606167
          DemOperationCycleRef = PowerCycle
          DemDebounceAlgorithmClass
            DemDebounceCounterBased: DemDebounceCounterDecrementStepSize=1, DemDebounceCounterIncrementStepSize=1, DemDebounceCounterJumpDown=false, DemDebounceCounterJumpUp=true
          IndicatorAttribute_WarningIndicator (DemIndicatorAttribute): DemIndicatorFailureCycleSource=DEM_FAILURE_CYCLE_EVENT, DemIndicatorHealingCycleRef=PowerCycle, DemIndicatorRef=WarningIndicator
      DTCClass_DTC_0x11281e (DemDTCClass): DemDTCSeverity=DEM_DTC_SEV_NO_SEVERITY, DemUdsDTC=1124382
      DTC_0x11281e (DemEventParameter):
        DemEventKind = DEM_EVENT_KIND_SWC
        DemDTCClassRef = DTCClass_DTC_0x11281e
        DemExtendedDataClassRef = ExtendedDataClass_83dcefb7
        DemFreezeFrameClassRef = FreezeFrameClass_5f5b5001
        DemFreezeFrameRecNumClassRef = FreezeFrameRecNumClass_f98c8aa7
        DemEventClass:
          DemAgingAllowed = true
          DemAgingCycleCounterThreshold = 40
          DemEventDestination = DEM_DTC_ORIGIN_PRIMARY_MEMORY
          DemEventPriority = 2
          DemEventSignificance = DEM_EVENT_SIGNIFICANCE_FAULT
          DemEventFailureCycleCounterThreshold = 0
          DemAgingCycleRef = PowerCycle
          DemEnableConditionGroupRef = EnableConditionGroup_d57a23d8
          DemOperationCycleRef = PowerCycle
          DemDebounceAlgorithmClass
            DemDebounceCounterBased: DemDebounceCounterDecrementStepSize=1, DemDebounceCounterIncrementStepSize=1, DemDebounceCounterJumpDown=false, DemDebounceCounterJumpUp=true
          IndicatorAttribute_WarningIndicator (DemIndicatorAttribute): DemIndicatorFailureCycleSource=DEM_FAILURE_CYCLE_EVENT, DemIndicatorHealingCycleRef=PowerCycle, DemIndicatorRef=WarningIndicator
      DTCClass_DTC_0x11291c (DemDTCClass): DemDTCSeverity=DEM_DTC_SEV_NO_SEVERITY, DemUdsDTC=1124636
      DTC_0x11291c (DemEventParameter):
        DemEventKind = DEM_EVENT_KIND_SWC
        DemDTCClassRef = DTCClass_DTC_0x11291c
        DemExtendedDataClassRef = ExtendedDataClass_83dcefb7
        DemFreezeFrameClassRef = FreezeFrameClass_a7d22c66
        DemFreezeFrameRecNumClassRef = FreezeFrameRecNumClass_f98c8aa7
        DemEventClass:
          DemAgingAllowed = true
          DemAgingCycleCounterThreshold = 40
          DemEventDestination = DEM_DTC_ORIGIN_PRIMARY_MEMORY
          DemEventPriority = 2
          DemEventSignificance = DEM_EVENT_SIGNIFICANCE_FAULT
          DemEventFailureCycleCounterThreshold = 0
          DemAgingCycleRef = PowerCycle
          DemEnableConditionGroupRef = EnableConditionGroup_d57a23d8
          DemOperationCycleRef = PowerCycle
          DemDebounceAlgorithmClass
            DemDebounceCounterBased: DemDebounceCounterDecrementStepSize=1, DemDebounceCounterIncrementStepSize=1, DemDebounceCounterJumpDown=false, DemDebounceCounterJumpUp=true
          IndicatorAttribute_WarningIndicator (DemIndicatorAttribute): DemIndicatorFailureCycleSource=DEM_FAILURE_CYCLE_EVENT, DemIndicatorHealingCycleRef=PowerCycle, DemIndicatorRef=WarningIndicator
      DTCClass_DTC_0x11309a (DemDTCClass): DemDTCSeverity=DEM_DTC_SEV_NO_SEVERITY, DemUdsDTC=1126554
      DTC_0x11309a (DemEventParameter):
        DemEventKind = DEM_EVENT_KIND_SWC
        DemDTCClassRef = DTCClass_DTC_0x11309a
        DemExtendedDataClassRef = ExtendedDataClass_83dcefb7
        DemFreezeFrameClassRef = FreezeFrameClass_5f5b5001
        DemFreezeFrameRecNumClassRef = FreezeFrameRecNumClass_f98c8aa7
        DemEventClass:
          DemAgingAllowed = true
          DemAgingCycleCounterThreshold = 40
          DemEventDestination = DEM_DTC_ORIGIN_PRIMARY_MEMORY
          DemEventPriority = 2
          DemEventSignificance = DEM_EVENT_SIGNIFICANCE_FAULT
          DemEventFailureCycleCounterThreshold = 0
          DemAgingCycleRef = PowerCycle
          DemEnableConditionGroupRef = EnableConditionGroup_d57a23d8
          DemOperationCycleRef = PowerCycle
          DemDebounceAlgorithmClass
            DemDebounceCounterBased: DemDebounceCounterDecrementStepSize=1, DemDebounceCounterIncrementStepSize=1, DemDebounceCounterJumpDown=false, DemDebounceCounterJumpUp=true
          IndicatorAttribute_WarningIndicator (DemIndicatorAttribute): DemIndicatorFailureCycleSource=DEM_FAILURE_CYCLE_EVENT, DemIndicatorHealingCycleRef=PowerCycle, DemIndicatorRef=WarningIndicator
      DTCClass_DTC_0x113197 (DemDTCClass): DemDTCSeverity=DEM_DTC_SEV_NO_SEVERITY, DemUdsDTC=1126807
      DTC_0x113197 (DemEventParameter):
        DemEventKind = DEM_EVENT_KIND_SWC
        DemDTCClassRef = DTCClass_DTC_0x113197
        DemExtendedDataClassRef = ExtendedDataClass_83dcefb7
        DemFreezeFrameClassRef = FreezeFrameClass_d0d51cf0
        DemFreezeFrameRecNumClassRef = FreezeFrameRecNumClass_f98c8aa7
        DemEventClass:
          DemAgingAllowed = true
          DemAgingCycleCounterThreshold = 40
          DemEventDestination = DEM_DTC_ORIGIN_PRIMARY_MEMORY
          DemEventPriority = 2
          DemEventSignificance = DEM_EVENT_SIGNIFICANCE_FAULT
          DemEventFailureCycleCounterThreshold = 0
          DemAgingCycleRef = PowerCycle
          DemEnableConditionGroupRef = EnableConditionGroup_f26910b9
          DemOperationCycleRef = PowerCycle
          DemDebounceAlgorithmClass
            DemDebounceCounterBased: DemDebounceCounterDecrementStepSize=1, DemDebounceCounterIncrementStepSize=1, DemDebounceCounterJumpDown=false, DemDebounceCounterJumpUp=true
          IndicatorAttribute_WarningIndicator (DemIndicatorAttribute): DemIndicatorFailureCycleSource=DEM_FAILURE_CYCLE_EVENT, DemIndicatorHealingCycleRef=PowerCycle, DemIndicatorRef=WarningIndicator
      DTCClass_DTC_0x113297 (DemDTCClass): DemDTCSeverity=DEM_DTC_SEV_NO_SEVERITY, DemUdsDTC=1127063
      DTC_0x113297 (DemEventParameter):
        DemEventKind = DEM_EVENT_KIND_SWC
        DemDTCClassRef = DTCClass_DTC_0x113297
        DemExtendedDataClassRef = ExtendedDataClass_83dcefb7
        DemFreezeFrameClassRef = FreezeFrameClass_5f5b5001
        DemFreezeFrameRecNumClassRef = FreezeFrameRecNumClass_f98c8aa7
        DemEventClass:
          DemAgingAllowed = true
          DemAgingCycleCounterThreshold = 40
          DemEventDestination = DEM_DTC_ORIGIN_PRIMARY_MEMORY
          DemEventPriority = 2
          DemEventSignificance = DEM_EVENT_SIGNIFICANCE_FAULT
          DemEventFailureCycleCounterThreshold = 0
          DemAgingCycleRef = PowerCycle
          DemEnableConditionGroupRef = EnableConditionGroup_f1606167
          DemOperationCycleRef = PowerCycle
          DemDebounceAlgorithmClass
            DemDebounceCounterBased: DemDebounceCounterDecrementStepSize=1, DemDebounceCounterIncrementStepSize=1, DemDebounceCounterJumpDown=false, DemDebounceCounterJumpUp=true
          IndicatorAttribute_WarningIndicator (DemIndicatorAttribute): DemIndicatorFailureCycleSource=DEM_FAILURE_CYCLE_EVENT, DemIndicatorHealingCycleRef=PowerCycle, DemIndicatorRef=WarningIndicator
      DTCClass_DTC_0x113397 (DemDTCClass): DemDTCSeverity=DEM_DTC_SEV_NO_SEVERITY, DemUdsDTC=1127319
      DTC_0x113397 (DemEventParameter):
        DemEventKind = DEM_EVENT_KIND_SWC
        DemDTCClassRef = DTCClass_DTC_0x113397
        DemExtendedDataClassRef = ExtendedDataClass_83dcefb7
        DemFreezeFrameClassRef = FreezeFrameClass_d96350db
        DemFreezeFrameRecNumClassRef = FreezeFrameRecNumClass_f98c8aa7
        DemEventClass:
          DemAgingAllowed = true
          DemAgingCycleCounterThreshold = 40
          DemEventDestination = DEM_DTC_ORIGIN_PRIMARY_MEMORY
          DemEventPriority = 2
          DemEventSignificance = DEM_EVENT_SIGNIFICANCE_FAULT
          DemEventFailureCycleCounterThreshold = 0
          DemAgingCycleRef = PowerCycle
          DemEnableConditionGroupRef = EnableConditionGroup_ce1c6ac5
          DemOperationCycleRef = PowerCycle
          DemDebounceAlgorithmClass
            DemDebounceCounterBased: DemDebounceCounterDecrementStepSize=1, DemDebounceCounterIncrementStepSize=1, DemDebounceCounterJumpDown=false, DemDebounceCounterJumpUp=true
          IndicatorAttribute_WarningIndicator (DemIndicatorAttribute): DemIndicatorFailureCycleSource=DEM_FAILURE_CYCLE_EVENT, DemIndicatorHealingCycleRef=PowerCycle, DemIndicatorRef=WarningIndicator
      DTCClass_DTC_0x113497 (DemDTCClass): DemDTCSeverity=DEM_DTC_SEV_NO_SEVERITY, DemUdsDTC=1127575
      DTC_0x113497 (DemEventParameter):
        DemEventKind = DEM_EVENT_KIND_SWC
        DemDTCClassRef = DTCClass_DTC_0x113497
        DemExtendedDataClassRef = ExtendedDataClass_83dcefb7
        DemFreezeFrameClassRef = FreezeFrameClass_5f5b5001
        DemFreezeFrameRecNumClassRef = FreezeFrameRecNumClass_f98c8aa7
        DemEventClass:
          DemAgingAllowed = true
          DemAgingCycleCounterThreshold = 40
          DemEventDestination = DEM_DTC_ORIGIN_PRIMARY_MEMORY
          DemEventPriority = 2
          DemEventSignificance = DEM_EVENT_SIGNIFICANCE_FAULT
          DemEventFailureCycleCounterThreshold = 0
          DemAgingCycleRef = PowerCycle
          DemEnableConditionGroupRef = EnableConditionGroup_9200803a
          DemOperationCycleRef = PowerCycle
          DemDebounceAlgorithmClass
            DemDebounceCounterBased: DemDebounceCounterDecrementStepSize=1, DemDebounceCounterIncrementStepSize=1, DemDebounceCounterJumpDown=false, DemDebounceCounterJumpUp=true
          IndicatorAttribute_WarningIndicator (DemIndicatorAttribute): DemIndicatorFailureCycleSource=DEM_FAILURE_CYCLE_EVENT, DemIndicatorHealingCycleRef=PowerCycle, DemIndicatorRef=WarningIndicator
      DTCClass_DTC_0x113597 (DemDTCClass): DemDTCSeverity=DEM_DTC_SEV_NO_SEVERITY, DemUdsDTC=1127831
      DTC_0x113597 (DemEventParameter):
        DemEventKind = DEM_EVENT_KIND_SWC
        DemDTCClassRef = DTCClass_DTC_0x113597
        DemExtendedDataClassRef = ExtendedDataClass_83dcefb7
        DemFreezeFrameClassRef = FreezeFrameClass_c715a583
        DemFreezeFrameRecNumClassRef = FreezeFrameRecNumClass_f98c8aa7
        DemEventClass:
          DemAgingAllowed = true
          DemAgingCycleCounterThreshold = 40
          DemEventDestination = DEM_DTC_ORIGIN_PRIMARY_MEMORY
          DemEventPriority = 2
          DemEventSignificance = DEM_EVENT_SIGNIFICANCE_FAULT
          DemEventFailureCycleCounterThreshold = 0
          DemAgingCycleRef = PowerCycle
          DemEnableConditionGroupRef = EnableConditionGroup_c98c13ed
          DemOperationCycleRef = PowerCycle
          DemDebounceAlgorithmClass
            DemDebounceCounterBased: DemDebounceCounterDecrementStepSize=1, DemDebounceCounterIncrementStepSize=1, DemDebounceCounterJumpDown=false, DemDebounceCounterJumpUp=true
          IndicatorAttribute_WarningIndicator (DemIndicatorAttribute): DemIndicatorFailureCycleSource=DEM_FAILURE_CYCLE_EVENT, DemIndicatorHealingCycleRef=PowerCycle, DemIndicatorRef=WarningIndicator
      DTCClass_DTC_0x113697 (DemDTCClass): DemDTCSeverity=DEM_DTC_SEV_NO_SEVERITY, DemUdsDTC=1128087
      DTC_0x113697 (DemEventParameter):
        DemEventKind = DEM_EVENT_KIND_SWC
        DemDTCClassRef = DTCClass_DTC_0x113697
        DemExtendedDataClassRef = ExtendedDataClass_83dcefb7
        DemFreezeFrameClassRef = FreezeFrameClass_c715a583
        DemFreezeFrameRecNumClassRef = FreezeFrameRecNumClass_f98c8aa7
        DemEventClass:
          DemAgingAllowed = true
          DemAgingCycleCounterThreshold = 40
          DemEventDestination = DEM_DTC_ORIGIN_PRIMARY_MEMORY
          DemEventPriority = 2
          DemEventSignificance = DEM_EVENT_SIGNIFICANCE_FAULT
          DemEventFailureCycleCounterThreshold = 0
          DemAgingCycleRef = PowerCycle
          DemEnableConditionGroupRef = EnableConditionGroup_b2ccc4ca
          DemOperationCycleRef = PowerCycle
          DemDebounceAlgorithmClass
            DemDebounceCounterBased: DemDebounceCounterDecrementStepSize=1, DemDebounceCounterIncrementStepSize=1, DemDebounceCounterJumpDown=false, DemDebounceCounterJumpUp=true
          IndicatorAttribute_WarningIndicator (DemIndicatorAttribute): DemIndicatorFailureCycleSource=DEM_FAILURE_CYCLE_EVENT, DemIndicatorHealingCycleRef=PowerCycle, DemIndicatorRef=WarningIndicator
      DTCClass_DTC_0x113797 (DemDTCClass): DemDTCSeverity=DEM_DTC_SEV_NO_SEVERITY, DemUdsDTC=1128343
      DTC_0x113797 (DemEventParameter):
        DemEventKind = DEM_EVENT_KIND_SWC
        DemDTCClassRef = DTCClass_DTC_0x113797
        DemExtendedDataClassRef = ExtendedDataClass_83dcefb7
        DemFreezeFrameClassRef = FreezeFrameClass_5f5b5001
        DemFreezeFrameRecNumClassRef = FreezeFrameRecNumClass_f98c8aa7
        DemEventClass:
          DemAgingAllowed = true
          DemAgingCycleCounterThreshold = 40
          DemEventDestination = DEM_DTC_ORIGIN_PRIMARY_MEMORY
          DemEventPriority = 2
          DemEventSignificance = DEM_EVENT_SIGNIFICANCE_FAULT
          DemEventFailureCycleCounterThreshold = 0
          DemAgingCycleRef = PowerCycle
          DemEnableConditionGroupRef = EnableConditionGroup_63ddaef5
          DemOperationCycleRef = PowerCycle
          DemDebounceAlgorithmClass
            DemDebounceCounterBased: DemDebounceCounterDecrementStepSize=1, DemDebounceCounterIncrementStepSize=1, DemDebounceCounterJumpDown=false, DemDebounceCounterJumpUp=true
          IndicatorAttribute_WarningIndicator (DemIndicatorAttribute): DemIndicatorFailureCycleSource=DEM_FAILURE_CYCLE_EVENT, DemIndicatorHealingCycleRef=PowerCycle, DemIndicatorRef=WarningIndicator
      DTCClass_DTC_0x113897 (DemDTCClass): DemDTCSeverity=DEM_DTC_SEV_NO_SEVERITY, DemUdsDTC=1128599
      DTC_0x113897 (DemEventParameter):
        DemEventKind = DEM_EVENT_KIND_SWC
        DemDTCClassRef = DTCClass_DTC_0x113897
        DemExtendedDataClassRef = ExtendedDataClass_83dcefb7
        DemFreezeFrameClassRef = FreezeFrameClass_5f5b5001
        DemFreezeFrameRecNumClassRef = FreezeFrameRecNumClass_f98c8aa7
        DemEventClass:
          DemAgingAllowed = true
          DemAgingCycleCounterThreshold = 40
          DemEventDestination = DEM_DTC_ORIGIN_PRIMARY_MEMORY
          DemEventPriority = 2
          DemEventSignificance = DEM_EVENT_SIGNIFICANCE_FAULT
          DemEventFailureCycleCounterThreshold = 0
          DemAgingCycleRef = PowerCycle
          DemEnableConditionGroupRef = EnableConditionGroup_c828305f
          DemOperationCycleRef = PowerCycle
          DemDebounceAlgorithmClass
            DemDebounceCounterBased: DemDebounceCounterDecrementStepSize=1, DemDebounceCounterIncrementStepSize=1, DemDebounceCounterJumpDown=false, DemDebounceCounterJumpUp=true
          IndicatorAttribute_WarningIndicator (DemIndicatorAttribute): DemIndicatorFailureCycleSource=DEM_FAILURE_CYCLE_EVENT, DemIndicatorHealingCycleRef=PowerCycle, DemIndicatorRef=WarningIndicator
      DTCClass_DTC_0x113997 (DemDTCClass): DemDTCSeverity=DEM_DTC_SEV_NO_SEVERITY, DemUdsDTC=1128855
      DTC_0x113997 (DemEventParameter):
        DemEventKind = DEM_EVENT_KIND_SWC
        DemDTCClassRef = DTCClass_DTC_0x113997
        DemExtendedDataClassRef = ExtendedDataClass_83dcefb7
        DemFreezeFrameClassRef = FreezeFrameClass_5f5b5001
        DemFreezeFrameRecNumClassRef = FreezeFrameRecNumClass_f98c8aa7
        DemEventClass:
          DemAgingAllowed = true
          DemAgingCycleCounterThreshold = 40
          DemEventDestination = DEM_DTC_ORIGIN_PRIMARY_MEMORY
          DemEventPriority = 2
          DemEventSignificance = DEM_EVENT_SIGNIFICANCE_FAULT
          DemEventFailureCycleCounterThreshold = 0
          DemAgingCycleRef = PowerCycle
          DemEnableConditionGroupRef = EnableConditionGroup_36bf5180
          DemOperationCycleRef = PowerCycle
          DemDebounceAlgorithmClass
            DemDebounceCounterBased: DemDebounceCounterDecrementStepSize=1, DemDebounceCounterIncrementStepSize=1, DemDebounceCounterJumpDown=false, DemDebounceCounterJumpUp=true
          IndicatorAttribute_WarningIndicator (DemIndicatorAttribute): DemIndicatorFailureCycleSource=DEM_FAILURE_CYCLE_EVENT, DemIndicatorHealingCycleRef=PowerCycle, DemIndicatorRef=WarningIndicator
      DTCClass_DTC_0x114097 (DemDTCClass): DemDTCSeverity=DEM_DTC_SEV_NO_SEVERITY, DemUdsDTC=1130647
      DTC_0x114097 (DemEventParameter):
        DemEventKind = DEM_EVENT_KIND_SWC
        DemDTCClassRef = DTCClass_DTC_0x114097
        DemExtendedDataClassRef = ExtendedDataClass_83dcefb7
        DemFreezeFrameClassRef = FreezeFrameClass_5f5b5001
        DemFreezeFrameRecNumClassRef = FreezeFrameRecNumClass_f98c8aa7
        DemEventClass:
          DemAgingAllowed = true
          DemAgingCycleCounterThreshold = 40
          DemEventDestination = DEM_DTC_ORIGIN_PRIMARY_MEMORY
          DemEventPriority = 2
          DemEventSignificance = DEM_EVENT_SIGNIFICANCE_FAULT
          DemEventFailureCycleCounterThreshold = 0
          DemAgingCycleRef = PowerCycle
          DemEnableConditionGroupRef = EnableConditionGroup_36bf5180
          DemOperationCycleRef = PowerCycle
          DemDebounceAlgorithmClass
            DemDebounceCounterBased: DemDebounceCounterDecrementStepSize=1, DemDebounceCounterIncrementStepSize=1, DemDebounceCounterJumpDown=false, DemDebounceCounterJumpUp=true
          IndicatorAttribute_WarningIndicator (DemIndicatorAttribute): DemIndicatorFailureCycleSource=DEM_FAILURE_CYCLE_EVENT, DemIndicatorHealingCycleRef=PowerCycle, DemIndicatorRef=WarningIndicator
      DTCClass_DTC_0x114197 (DemDTCClass): DemDTCSeverity=DEM_DTC_SEV_NO_SEVERITY, DemUdsDTC=1130903
      DTC_0x114197 (DemEventParameter):
        DemEventKind = DEM_EVENT_KIND_SWC
        DemDTCClassRef = DTCClass_DTC_0x114197
        DemExtendedDataClassRef = ExtendedDataClass_83dcefb7
        DemFreezeFrameClassRef = FreezeFrameClass_5f5b5001
        DemFreezeFrameRecNumClassRef = FreezeFrameRecNumClass_f98c8aa7
        DemEventClass:
          DemAgingAllowed = true
          DemAgingCycleCounterThreshold = 40
          DemEventDestination = DEM_DTC_ORIGIN_PRIMARY_MEMORY
          DemEventPriority = 2
          DemEventSignificance = DEM_EVENT_SIGNIFICANCE_FAULT
          DemEventFailureCycleCounterThreshold = 0
          DemAgingCycleRef = PowerCycle
          DemEnableConditionGroupRef = EnableConditionGroup_36bf5180
          DemOperationCycleRef = PowerCycle
          DemDebounceAlgorithmClass
            DemDebounceCounterBased: DemDebounceCounterDecrementStepSize=1, DemDebounceCounterIncrementStepSize=1, DemDebounceCounterJumpDown=false, DemDebounceCounterJumpUp=true
          IndicatorAttribute_WarningIndicator (DemIndicatorAttribute): DemIndicatorFailureCycleSource=DEM_FAILURE_CYCLE_EVENT, DemIndicatorHealingCycleRef=PowerCycle, DemIndicatorRef=WarningIndicator
      DTCClass_DTC_0x114297 (DemDTCClass): DemDTCSeverity=DEM_DTC_SEV_NO_SEVERITY, DemUdsDTC=1131159
      DTC_0x114297 (DemEventParameter):
        DemEventKind = DEM_EVENT_KIND_SWC
        DemDTCClassRef = DTCClass_DTC_0x114297
        DemExtendedDataClassRef = ExtendedDataClass_83dcefb7
        DemFreezeFrameClassRef = FreezeFrameClass_5f5b5001
        DemFreezeFrameRecNumClassRef = FreezeFrameRecNumClass_f98c8aa7
        DemEventClass:
          DemAgingAllowed = true
          DemAgingCycleCounterThreshold = 40
          DemEventDestination = DEM_DTC_ORIGIN_PRIMARY_MEMORY
          DemEventPriority = 2
          DemEventSignificance = DEM_EVENT_SIGNIFICANCE_FAULT
          DemEventFailureCycleCounterThreshold = 0
          DemAgingCycleRef = PowerCycle
          DemEnableConditionGroupRef = EnableConditionGroup_36bf5180
          DemOperationCycleRef = PowerCycle
          DemDebounceAlgorithmClass
            DemDebounceCounterBased: DemDebounceCounterDecrementStepSize=1, DemDebounceCounterIncrementStepSize=1, DemDebounceCounterJumpDown=false, DemDebounceCounterJumpUp=true
          IndicatorAttribute_WarningIndicator (DemIndicatorAttribute): DemIndicatorFailureCycleSource=DEM_FAILURE_CYCLE_EVENT, DemIndicatorHealingCycleRef=PowerCycle, DemIndicatorRef=WarningIndicator
      DTCClass_DTC_0x114397 (DemDTCClass): DemDTCSeverity=DEM_DTC_SEV_NO_SEVERITY, DemUdsDTC=1131415
      DTC_0x114397 (DemEventParameter):
        DemEventKind = DEM_EVENT_KIND_SWC
        DemDTCClassRef = DTCClass_DTC_0x114397
        DemExtendedDataClassRef = ExtendedDataClass_83dcefb7
        DemFreezeFrameClassRef = FreezeFrameClass_5f5b5001
        DemFreezeFrameRecNumClassRef = FreezeFrameRecNumClass_f98c8aa7
        DemEventClass:
          DemAgingAllowed = true
          DemAgingCycleCounterThreshold = 40
          DemEventDestination = DEM_DTC_ORIGIN_PRIMARY_MEMORY
          DemEventPriority = 2
          DemEventSignificance = DEM_EVENT_SIGNIFICANCE_FAULT
          DemEventFailureCycleCounterThreshold = 0
          DemAgingCycleRef = PowerCycle
          DemEnableConditionGroupRef = EnableConditionGroup_36bf5180
          DemOperationCycleRef = PowerCycle
          DemDebounceAlgorithmClass
            DemDebounceCounterBased: DemDebounceCounterDecrementStepSize=1, DemDebounceCounterIncrementStepSize=1, DemDebounceCounterJumpDown=false, DemDebounceCounterJumpUp=true
          IndicatorAttribute_WarningIndicator (DemIndicatorAttribute): DemIndicatorFailureCycleSource=DEM_FAILURE_CYCLE_EVENT, DemIndicatorHealingCycleRef=PowerCycle, DemIndicatorRef=WarningIndicator
      DTCClass_DTC_0x114497 (DemDTCClass): DemDTCSeverity=DEM_DTC_SEV_NO_SEVERITY, DemUdsDTC=1131671
      DTC_0x114497 (DemEventParameter):
        DemEventKind = DEM_EVENT_KIND_SWC
        DemDTCClassRef = DTCClass_DTC_0x114497
        DemExtendedDataClassRef = ExtendedDataClass_83dcefb7
        DemFreezeFrameClassRef = FreezeFrameClass_5f5b5001
        DemFreezeFrameRecNumClassRef = FreezeFrameRecNumClass_f98c8aa7
        DemEventClass:
          DemAgingAllowed = true
          DemAgingCycleCounterThreshold = 40
          DemEventDestination = DEM_DTC_ORIGIN_PRIMARY_MEMORY
          DemEventPriority = 2
          DemEventSignificance = DEM_EVENT_SIGNIFICANCE_FAULT
          DemEventFailureCycleCounterThreshold = 0
          DemAgingCycleRef = PowerCycle
          DemEnableConditionGroupRef = EnableConditionGroup_36bf5180
          DemOperationCycleRef = PowerCycle
          DemDebounceAlgorithmClass
            DemDebounceCounterBased: DemDebounceCounterDecrementStepSize=1, DemDebounceCounterIncrementStepSize=1, DemDebounceCounterJumpDown=false, DemDebounceCounterJumpUp=true
          IndicatorAttribute_WarningIndicator (DemIndicatorAttribute): DemIndicatorFailureCycleSource=DEM_FAILURE_CYCLE_EVENT, DemIndicatorHealingCycleRef=PowerCycle, DemIndicatorRef=WarningIndicator
      DTCClass_DTC_0x114571 (DemDTCClass): DemDTCSeverity=DEM_DTC_SEV_NO_SEVERITY, DemUdsDTC=1131889
      DTC_0x114571 (DemEventParameter):
        DemEventKind = DEM_EVENT_KIND_SWC
        DemDTCClassRef = DTCClass_DTC_0x114571
        DemExtendedDataClassRef = ExtendedDataClass_83dcefb7
        DemFreezeFrameClassRef = FreezeFrameClass_376d31f7
        DemFreezeFrameRecNumClassRef = FreezeFrameRecNumClass_f98c8aa7
        DemEventClass:
          DemAgingAllowed = true
          DemAgingCycleCounterThreshold = 40
          DemEventDestination = DEM_DTC_ORIGIN_PRIMARY_MEMORY
          DemEventPriority = 2
          DemEventSignificance = DEM_EVENT_SIGNIFICANCE_FAULT
          DemEventFailureCycleCounterThreshold = 0
          DemAgingCycleRef = PowerCycle
          DemEnableConditionGroupRef = EnableConditionGroup_c8259b58
          DemOperationCycleRef = PowerCycle
          DemDebounceAlgorithmClass
            DemDebounceCounterBased: DemDebounceCounterDecrementStepSize=1, DemDebounceCounterIncrementStepSize=1, DemDebounceCounterJumpDown=false, DemDebounceCounterJumpUp=true
          IndicatorAttribute_WarningIndicator (DemIndicatorAttribute): DemIndicatorFailureCycleSource=DEM_FAILURE_CYCLE_EVENT, DemIndicatorHealingCycleRef=PowerCycle, DemIndicatorRef=WarningIndicator
      DTCClass_DTC_0x114697 (DemDTCClass): DemDTCSeverity=DEM_DTC_SEV_NO_SEVERITY, DemUdsDTC=1132183
      DTC_0x114697 (DemEventParameter):
        DemEventKind = DEM_EVENT_KIND_SWC
        DemDTCClassRef = DTCClass_DTC_0x114697
        DemExtendedDataClassRef = ExtendedDataClass_83dcefb7
        DemFreezeFrameClassRef = FreezeFrameClass_5f5b5001
        DemFreezeFrameRecNumClassRef = FreezeFrameRecNumClass_f98c8aa7
        DemEventClass:
          DemAgingAllowed = true
          DemAgingCycleCounterThreshold = 40
          DemEventDestination = DEM_DTC_ORIGIN_PRIMARY_MEMORY
          DemEventPriority = 2
          DemEventSignificance = DEM_EVENT_SIGNIFICANCE_FAULT
          DemEventFailureCycleCounterThreshold = 0
          DemAgingCycleRef = PowerCycle
          DemEnableConditionGroupRef = EnableConditionGroup_b2fa4a09
          DemOperationCycleRef = PowerCycle
          DemDebounceAlgorithmClass
            DemDebounceCounterBased: DemDebounceCounterDecrementStepSize=1, DemDebounceCounterIncrementStepSize=1, DemDebounceCounterJumpDown=false, DemDebounceCounterJumpUp=true
          IndicatorAttribute_WarningIndicator (DemIndicatorAttribute): DemIndicatorFailureCycleSource=DEM_FAILURE_CYCLE_EVENT, DemIndicatorHealingCycleRef=PowerCycle, DemIndicatorRef=WarningIndicator
      DTCClass_DTC_0x114792 (DemDTCClass): DemDTCSeverity=DEM_DTC_SEV_NO_SEVERITY, DemUdsDTC=1132434
      DTC_0x114792 (DemEventParameter):
        DemEventKind = DEM_EVENT_KIND_SWC
        DemDTCClassRef = DTCClass_DTC_0x114792
        DemExtendedDataClassRef = ExtendedDataClass_83dcefb7
        DemFreezeFrameClassRef = FreezeFrameClass_5f5b5001
        DemFreezeFrameRecNumClassRef = FreezeFrameRecNumClass_f98c8aa7
        DemEventClass:
          DemAgingAllowed = true
          DemAgingCycleCounterThreshold = 40
          DemEventDestination = DEM_DTC_ORIGIN_PRIMARY_MEMORY
          DemEventPriority = 2
          DemEventSignificance = DEM_EVENT_SIGNIFICANCE_FAULT
          DemEventFailureCycleCounterThreshold = 0
          DemAgingCycleRef = PowerCycle
          DemEnableConditionGroupRef = EnableConditionGroup_b80d94d2
          DemOperationCycleRef = PowerCycle
          DemDebounceAlgorithmClass
            DemDebounceCounterBased: DemDebounceCounterDecrementStepSize=1, DemDebounceCounterIncrementStepSize=1, DemDebounceCounterJumpDown=false, DemDebounceCounterJumpUp=true
          IndicatorAttribute_WarningIndicator (DemIndicatorAttribute): DemIndicatorFailureCycleSource=DEM_FAILURE_CYCLE_EVENT, DemIndicatorHealingCycleRef=PowerCycle, DemIndicatorRef=WarningIndicator
      DTCClass_DTC_0x114892 (DemDTCClass): DemDTCSeverity=DEM_DTC_SEV_NO_SEVERITY, DemUdsDTC=1132690
      DTC_0x114892 (DemEventParameter):
        DemEventKind = DEM_EVENT_KIND_SWC
        DemDTCClassRef = DTCClass_DTC_0x114892
        DemExtendedDataClassRef = ExtendedDataClass_83dcefb7
        DemFreezeFrameClassRef = FreezeFrameClass_c715a583
        DemFreezeFrameRecNumClassRef = FreezeFrameRecNumClass_f98c8aa7
        DemEventClass:
          DemAgingAllowed = true
          DemAgingCycleCounterThreshold = 40
          DemEventDestination = DEM_DTC_ORIGIN_PRIMARY_MEMORY
          DemEventPriority = 2
          DemEventSignificance = DEM_EVENT_SIGNIFICANCE_FAULT
          DemEventFailureCycleCounterThreshold = 0
          DemAgingCycleRef = PowerCycle
          DemEnableConditionGroupRef = EnableConditionGroup_fc6b8fc4
          DemOperationCycleRef = PowerCycle
          DemDebounceAlgorithmClass
            DemDebounceCounterBased: DemDebounceCounterDecrementStepSize=1, DemDebounceCounterIncrementStepSize=1, DemDebounceCounterJumpDown=false, DemDebounceCounterJumpUp=true
          IndicatorAttribute_WarningIndicator (DemIndicatorAttribute): DemIndicatorFailureCycleSource=DEM_FAILURE_CYCLE_EVENT, DemIndicatorHealingCycleRef=PowerCycle, DemIndicatorRef=WarningIndicator
      DTCClass_DTC_0x114992 (DemDTCClass): DemDTCSeverity=DEM_DTC_SEV_NO_SEVERITY, DemUdsDTC=1132946
      DTC_0x114992 (DemEventParameter):
        DemEventKind = DEM_EVENT_KIND_SWC
        DemDTCClassRef = DTCClass_DTC_0x114992
        DemExtendedDataClassRef = ExtendedDataClass_83dcefb7
        DemFreezeFrameClassRef = FreezeFrameClass_5f5b5001
        DemFreezeFrameRecNumClassRef = FreezeFrameRecNumClass_f98c8aa7
        DemEventClass:
          DemAgingAllowed = true
          DemAgingCycleCounterThreshold = 40
          DemEventDestination = DEM_DTC_ORIGIN_PRIMARY_MEMORY
          DemEventPriority = 2
          DemEventSignificance = DEM_EVENT_SIGNIFICANCE_FAULT
          DemEventFailureCycleCounterThreshold = 0
          DemAgingCycleRef = PowerCycle
          DemEnableConditionGroupRef = EnableConditionGroup_54eb9fcb
          DemOperationCycleRef = PowerCycle
          DemDebounceAlgorithmClass
            DemDebounceCounterBased: DemDebounceCounterDecrementStepSize=1, DemDebounceCounterIncrementStepSize=1, DemDebounceCounterJumpDown=false, DemDebounceCounterJumpUp=true
          IndicatorAttribute_WarningIndicator (DemIndicatorAttribute): DemIndicatorFailureCycleSource=DEM_FAILURE_CYCLE_EVENT, DemIndicatorHealingCycleRef=PowerCycle, DemIndicatorRef=WarningIndicator
      DTCClass_DTC_0x115092 (DemDTCClass): DemDTCSeverity=DEM_DTC_SEV_NO_SEVERITY, DemUdsDTC=1134738
      DTC_0x115092 (DemEventParameter):
        DemEventKind = DEM_EVENT_KIND_SWC
        DemDTCClassRef = DTCClass_DTC_0x115092
        DemExtendedDataClassRef = ExtendedDataClass_83dcefb7
        DemFreezeFrameClassRef = FreezeFrameClass_5f5b5001
        DemFreezeFrameRecNumClassRef = FreezeFrameRecNumClass_f98c8aa7
        DemEventClass:
          DemAgingAllowed = true
          DemAgingCycleCounterThreshold = 40
          DemEventDestination = DEM_DTC_ORIGIN_PRIMARY_MEMORY
          DemEventPriority = 2
          DemEventSignificance = DEM_EVENT_SIGNIFICANCE_FAULT
          DemEventFailureCycleCounterThreshold = 0
          DemAgingCycleRef = PowerCycle
          DemEnableConditionGroupRef = EnableConditionGroup_3c74cb75
          DemOperationCycleRef = PowerCycle
          DemDebounceAlgorithmClass
            DemDebounceCounterBased: DemDebounceCounterDecrementStepSize=1, DemDebounceCounterIncrementStepSize=1, DemDebounceCounterJumpDown=false, DemDebounceCounterJumpUp=true
          IndicatorAttribute_WarningIndicator (DemIndicatorAttribute): DemIndicatorFailureCycleSource=DEM_FAILURE_CYCLE_EVENT, DemIndicatorHealingCycleRef=PowerCycle, DemIndicatorRef=WarningIndicator
      DTCClass_DTC_0x115192 (DemDTCClass): DemDTCSeverity=DEM_DTC_SEV_NO_SEVERITY, DemUdsDTC=1134994
      DTC_0x115192 (DemEventParameter):
        DemEventKind = DEM_EVENT_KIND_SWC
        DemDTCClassRef = DTCClass_DTC_0x115192
        DemExtendedDataClassRef = ExtendedDataClass_83dcefb7
        DemFreezeFrameClassRef = FreezeFrameClass_5f5b5001
        DemFreezeFrameRecNumClassRef = FreezeFrameRecNumClass_f98c8aa7
        DemEventClass:
          DemAgingAllowed = true
          DemAgingCycleCounterThreshold = 40
          DemEventDestination = DEM_DTC_ORIGIN_PRIMARY_MEMORY
          DemEventPriority = 2
          DemEventSignificance = DEM_EVENT_SIGNIFICANCE_FAULT
          DemEventFailureCycleCounterThreshold = 0
          DemAgingCycleRef = PowerCycle
          DemEnableConditionGroupRef = EnableConditionGroup_a88e97b7
          DemOperationCycleRef = PowerCycle
          DemDebounceAlgorithmClass
            DemDebounceCounterBased: DemDebounceCounterDecrementStepSize=1, DemDebounceCounterIncrementStepSize=1, DemDebounceCounterJumpDown=false, DemDebounceCounterJumpUp=true
          IndicatorAttribute_WarningIndicator (DemIndicatorAttribute): DemIndicatorFailureCycleSource=DEM_FAILURE_CYCLE_EVENT, DemIndicatorHealingCycleRef=PowerCycle, DemIndicatorRef=WarningIndicator
      DTCClass_DTC_0x115292 (DemDTCClass): DemDTCSeverity=DEM_DTC_SEV_NO_SEVERITY, DemUdsDTC=1135250
      DTC_0x115292 (DemEventParameter):
        DemEventKind = DEM_EVENT_KIND_SWC
        DemDTCClassRef = DTCClass_DTC_0x115292
        DemExtendedDataClassRef = ExtendedDataClass_83dcefb7
        DemFreezeFrameClassRef = FreezeFrameClass_c715a583
        DemFreezeFrameRecNumClassRef = FreezeFrameRecNumClass_f98c8aa7
        DemEventClass:
          DemAgingAllowed = true
          DemAgingCycleCounterThreshold = 40
          DemEventDestination = DEM_DTC_ORIGIN_PRIMARY_MEMORY
          DemEventPriority = 2
          DemEventSignificance = DEM_EVENT_SIGNIFICANCE_FAULT
          DemEventFailureCycleCounterThreshold = 0
          DemAgingCycleRef = PowerCycle
          DemEnableConditionGroupRef = EnableConditionGroup_fd6c7f9e
          DemOperationCycleRef = PowerCycle
          DemDebounceAlgorithmClass
            DemDebounceCounterBased: DemDebounceCounterDecrementStepSize=1, DemDebounceCounterIncrementStepSize=1, DemDebounceCounterJumpDown=false, DemDebounceCounterJumpUp=true
          IndicatorAttribute_WarningIndicator (DemIndicatorAttribute): DemIndicatorFailureCycleSource=DEM_FAILURE_CYCLE_EVENT, DemIndicatorHealingCycleRef=PowerCycle, DemIndicatorRef=WarningIndicator
      DTCClass_DTC_0x115392 (DemDTCClass): DemDTCSeverity=DEM_DTC_SEV_NO_SEVERITY, DemUdsDTC=1135506
      DTC_0x115392 (DemEventParameter):
        DemEventKind = DEM_EVENT_KIND_SWC
        DemDTCClassRef = DTCClass_DTC_0x115392
        DemExtendedDataClassRef = ExtendedDataClass_83dcefb7
        DemFreezeFrameClassRef = FreezeFrameClass_5f5b5001
        DemFreezeFrameRecNumClassRef = FreezeFrameRecNumClass_f98c8aa7
        DemEventClass:
          DemAgingAllowed = true
          DemAgingCycleCounterThreshold = 40
          DemEventDestination = DEM_DTC_ORIGIN_PRIMARY_MEMORY
          DemEventPriority = 2
          DemEventSignificance = DEM_EVENT_SIGNIFICANCE_FAULT
          DemEventFailureCycleCounterThreshold = 0
          DemAgingCycleRef = PowerCycle
          DemEnableConditionGroupRef = EnableConditionGroup_81b679fb
          DemOperationCycleRef = PowerCycle
          DemDebounceAlgorithmClass
            DemDebounceCounterBased: DemDebounceCounterDecrementStepSize=1, DemDebounceCounterIncrementStepSize=1, DemDebounceCounterJumpDown=false, DemDebounceCounterJumpUp=true
          IndicatorAttribute_WarningIndicator (DemIndicatorAttribute): DemIndicatorFailureCycleSource=DEM_FAILURE_CYCLE_EVENT, DemIndicatorHealingCycleRef=PowerCycle, DemIndicatorRef=WarningIndicator
      DTCClass_DTC_0x115492 (DemDTCClass): DemDTCSeverity=DEM_DTC_SEV_NO_SEVERITY, DemUdsDTC=1135762
      DTC_0x115492 (DemEventParameter):
        DemEventKind = DEM_EVENT_KIND_SWC
        DemDTCClassRef = DTCClass_DTC_0x115492
        DemExtendedDataClassRef = ExtendedDataClass_83dcefb7
        DemFreezeFrameClassRef = FreezeFrameClass_5f5b5001
        DemFreezeFrameRecNumClassRef = FreezeFrameRecNumClass_f98c8aa7
        DemEventClass:
          DemAgingAllowed = true
          DemAgingCycleCounterThreshold = 40
          DemEventDestination = DEM_DTC_ORIGIN_PRIMARY_MEMORY
          DemEventPriority = 2
          DemEventSignificance = DEM_EVENT_SIGNIFICANCE_FAULT
          DemEventFailureCycleCounterThreshold = 0
          DemAgingCycleRef = PowerCycle
          DemEnableConditionGroupRef = EnableConditionGroup_4392d02e
          DemOperationCycleRef = PowerCycle
          DemDebounceAlgorithmClass
            DemDebounceCounterBased: DemDebounceCounterDecrementStepSize=1, DemDebounceCounterIncrementStepSize=1, DemDebounceCounterJumpDown=false, DemDebounceCounterJumpUp=true
          IndicatorAttribute_WarningIndicator (DemIndicatorAttribute): DemIndicatorFailureCycleSource=DEM_FAILURE_CYCLE_EVENT, DemIndicatorHealingCycleRef=PowerCycle, DemIndicatorRef=WarningIndicator
      DTCClass_DTC_0x115592 (DemDTCClass): DemDTCSeverity=DEM_DTC_SEV_NO_SEVERITY, DemUdsDTC=1136018
      DTC_0x115592 (DemEventParameter):
        DemEventKind = DEM_EVENT_KIND_SWC
        DemDTCClassRef = DTCClass_DTC_0x115592
        DemExtendedDataClassRef = ExtendedDataClass_83dcefb7
        DemFreezeFrameClassRef = FreezeFrameClass_5f5b5001
        DemFreezeFrameRecNumClassRef = FreezeFrameRecNumClass_f98c8aa7
        DemEventClass:
          DemAgingAllowed = true
          DemAgingCycleCounterThreshold = 40
          DemEventDestination = DEM_DTC_ORIGIN_PRIMARY_MEMORY
          DemEventPriority = 2
          DemEventSignificance = DEM_EVENT_SIGNIFICANCE_FAULT
          DemEventFailureCycleCounterThreshold = 0
          DemAgingCycleRef = PowerCycle
          DemEnableConditionGroupRef = EnableConditionGroup_0e120735
          DemOperationCycleRef = PowerCycle
          DemDebounceAlgorithmClass
            DemDebounceCounterBased: DemDebounceCounterDecrementStepSize=1, DemDebounceCounterIncrementStepSize=1, DemDebounceCounterJumpDown=false, DemDebounceCounterJumpUp=true
          IndicatorAttribute_WarningIndicator (DemIndicatorAttribute): DemIndicatorFailureCycleSource=DEM_FAILURE_CYCLE_EVENT, DemIndicatorHealingCycleRef=PowerCycle, DemIndicatorRef=WarningIndicator
      DTCClass_DTC_0x115692 (DemDTCClass): DemDTCSeverity=DEM_DTC_SEV_NO_SEVERITY, DemUdsDTC=1136274
      DTC_0x115692 (DemEventParameter):
        DemEventKind = DEM_EVENT_KIND_SWC
        DemDTCClassRef = DTCClass_DTC_0x115692
        DemExtendedDataClassRef = ExtendedDataClass_83dcefb7
        DemFreezeFrameClassRef = FreezeFrameClass_5f5b5001
        DemFreezeFrameRecNumClassRef = FreezeFrameRecNumClass_f98c8aa7
        DemEventClass:
          DemAgingAllowed = true
          DemAgingCycleCounterThreshold = 40
          DemEventDestination = DEM_DTC_ORIGIN_PRIMARY_MEMORY
          DemEventPriority = 2
          DemEventSignificance = DEM_EVENT_SIGNIFICANCE_FAULT
          DemEventFailureCycleCounterThreshold = 0
          DemAgingCycleRef = PowerCycle
          DemEnableConditionGroupRef = EnableConditionGroup_171dbb3c
          DemOperationCycleRef = PowerCycle
          DemDebounceAlgorithmClass
            DemDebounceCounterBased: DemDebounceCounterDecrementStepSize=1, DemDebounceCounterIncrementStepSize=1, DemDebounceCounterJumpDown=false, DemDebounceCounterJumpUp=true
          IndicatorAttribute_WarningIndicator (DemIndicatorAttribute): DemIndicatorFailureCycleSource=DEM_FAILURE_CYCLE_EVENT, DemIndicatorHealingCycleRef=PowerCycle, DemIndicatorRef=WarningIndicator
      DTCClass_DTC_0x11571e (DemDTCClass): DemDTCSeverity=DEM_DTC_SEV_NO_SEVERITY, DemUdsDTC=1136414
      DTC_0x11571e (DemEventParameter):
        DemEventKind = DEM_EVENT_KIND_SWC
        DemDTCClassRef = DTCClass_DTC_0x11571e
        DemExtendedDataClassRef = ExtendedDataClass_83dcefb7
        DemFreezeFrameClassRef = FreezeFrameClass_de0e94c2
        DemFreezeFrameRecNumClassRef = FreezeFrameRecNumClass_f98c8aa7
        DemEventClass:
          DemAgingAllowed = true
          DemAgingCycleCounterThreshold = 40
          DemEventDestination = DEM_DTC_ORIGIN_PRIMARY_MEMORY
          DemEventPriority = 2
          DemEventSignificance = DEM_EVENT_SIGNIFICANCE_FAULT
          DemEventFailureCycleCounterThreshold = 0
          DemAgingCycleRef = PowerCycle
          DemEnableConditionGroupRef = EnableConditionGroup_048c220e
          DemOperationCycleRef = PowerCycle
          DemDebounceAlgorithmClass
            DemDebounceCounterBased: DemDebounceCounterDecrementStepSize=1, DemDebounceCounterIncrementStepSize=1, DemDebounceCounterJumpDown=false, DemDebounceCounterJumpUp=true
          IndicatorAttribute_WarningIndicator (DemIndicatorAttribute): DemIndicatorFailureCycleSource=DEM_FAILURE_CYCLE_EVENT, DemIndicatorHealingCycleRef=PowerCycle, DemIndicatorRef=WarningIndicator
      DTCClass_DTC_0x115816 (DemDTCClass): DemDTCSeverity=DEM_DTC_SEV_NO_SEVERITY, DemUdsDTC=1136662
      DTC_0x115816 (DemEventParameter):
        DemEventKind = DEM_EVENT_KIND_SWC
        DemDTCClassRef = DTCClass_DTC_0x115816
        DemExtendedDataClassRef = ExtendedDataClass_83dcefb7
        DemFreezeFrameClassRef = FreezeFrameClass_d96350db
        DemFreezeFrameRecNumClassRef = FreezeFrameRecNumClass_f98c8aa7
        DemEventClass:
          DemAgingAllowed = true
          DemAgingCycleCounterThreshold = 40
          DemEventDestination = DEM_DTC_ORIGIN_PRIMARY_MEMORY
          DemEventPriority = 2
          DemEventSignificance = DEM_EVENT_SIGNIFICANCE_FAULT
          DemEventFailureCycleCounterThreshold = 0
          DemAgingCycleRef = PowerCycle
          DemEnableConditionGroupRef = EnableConditionGroup_f1606167
          DemOperationCycleRef = PowerCycle
          DemDebounceAlgorithmClass
            DemDebounceCounterBased: DemDebounceCounterDecrementStepSize=1, DemDebounceCounterIncrementStepSize=1, DemDebounceCounterJumpDown=false, DemDebounceCounterJumpUp=true
          IndicatorAttribute_WarningIndicator (DemIndicatorAttribute): DemIndicatorFailureCycleSource=DEM_FAILURE_CYCLE_EVENT, DemIndicatorHealingCycleRef=PowerCycle, DemIndicatorRef=WarningIndicator
      DTCClass_DTC_0x11591e (DemDTCClass): DemDTCSeverity=DEM_DTC_SEV_NO_SEVERITY, DemUdsDTC=1136926
      DTC_0x11591e (DemEventParameter):
        DemEventKind = DEM_EVENT_KIND_SWC
        DemDTCClassRef = DTCClass_DTC_0x11591e
        DemExtendedDataClassRef = ExtendedDataClass_83dcefb7
        DemFreezeFrameClassRef = FreezeFrameClass_de0e94c2
        DemFreezeFrameRecNumClassRef = FreezeFrameRecNumClass_f98c8aa7
        DemEventClass:
          DemAgingAllowed = true
          DemAgingCycleCounterThreshold = 40
          DemEventDestination = DEM_DTC_ORIGIN_PRIMARY_MEMORY
          DemEventPriority = 2
          DemEventSignificance = DEM_EVENT_SIGNIFICANCE_FAULT
          DemEventFailureCycleCounterThreshold = 0
          DemAgingCycleRef = PowerCycle
          DemEnableConditionGroupRef = EnableConditionGroup_5feb31f0
          DemOperationCycleRef = PowerCycle
          DemDebounceAlgorithmClass
            DemDebounceCounterBased: DemDebounceCounterDecrementStepSize=1, DemDebounceCounterIncrementStepSize=1, DemDebounceCounterJumpDown=false, DemDebounceCounterJumpUp=true
          IndicatorAttribute_WarningIndicator (DemIndicatorAttribute): DemIndicatorFailureCycleSource=DEM_FAILURE_CYCLE_EVENT, DemIndicatorHealingCycleRef=PowerCycle, DemIndicatorRef=WarningIndicator
      DTCClass_DTC_0x908017 (DemDTCClass): DemDTCSeverity=DEM_DTC_SEV_NO_SEVERITY, DemUdsDTC=9469975
      DTC_0x908017 (DemEventParameter):
        DemEventKind = DEM_EVENT_KIND_SWC
        DemDTCClassRef = DTCClass_DTC_0x908017
        DemExtendedDataClassRef = ExtendedDataClass_83dcefb7
        DemFreezeFrameClassRef = FreezeFrameClass_5f5b5001
        DemFreezeFrameRecNumClassRef = FreezeFrameRecNumClass_f98c8aa7
        DemEventClass:
          DemAgingAllowed = true
          DemAgingCycleCounterThreshold = 40
          DemEventDestination = DEM_DTC_ORIGIN_PRIMARY_MEMORY
          DemEventPriority = 2
          DemEventSignificance = DEM_EVENT_SIGNIFICANCE_FAULT
          DemEventFailureCycleCounterThreshold = 0
          DemAgingCycleRef = PowerCycle
          DemEnableConditionGroupRef = EnableConditionGroup_93df7d19
          DemOperationCycleRef = PowerCycle
          DemDebounceAlgorithmClass
            DemDebounceCounterBased: DemDebounceCounterDecrementStepSize=1, DemDebounceCounterIncrementStepSize=1, DemDebounceCounterJumpDown=false, DemDebounceCounterJumpUp=true
          IndicatorAttribute_WarningIndicator (DemIndicatorAttribute): DemIndicatorFailureCycleSource=DEM_FAILURE_CYCLE_EVENT, DemIndicatorHealingCycleRef=PowerCycle, DemIndicatorRef=WarningIndicator
      DTCClass_DTC_0x908116 (DemDTCClass): DemDTCSeverity=DEM_DTC_SEV_NO_SEVERITY, DemUdsDTC=9470230
      DTC_0x908116 (DemEventParameter):
        DemEventKind = DEM_EVENT_KIND_SWC
        DemDTCClassRef = DTCClass_DTC_0x908116
        DemExtendedDataClassRef = ExtendedDataClass_83dcefb7
        DemFreezeFrameClassRef = FreezeFrameClass_5f5b5001
        DemFreezeFrameRecNumClassRef = FreezeFrameRecNumClass_f98c8aa7
        DemEventClass:
          DemAgingAllowed = true
          DemAgingCycleCounterThreshold = 40
          DemEventDestination = DEM_DTC_ORIGIN_PRIMARY_MEMORY
          DemEventPriority = 2
          DemEventSignificance = DEM_EVENT_SIGNIFICANCE_FAULT
          DemEventFailureCycleCounterThreshold = 0
          DemAgingCycleRef = PowerCycle
          DemEnableConditionGroupRef = EnableConditionGroup_93df7d19
          DemOperationCycleRef = PowerCycle
          DemDebounceAlgorithmClass
            DemDebounceCounterBased: DemDebounceCounterDecrementStepSize=1, DemDebounceCounterIncrementStepSize=1, DemDebounceCounterJumpDown=false, DemDebounceCounterJumpUp=true
          IndicatorAttribute_WarningIndicator (DemIndicatorAttribute): DemIndicatorFailureCycleSource=DEM_FAILURE_CYCLE_EVENT, DemIndicatorHealingCycleRef=PowerCycle, DemIndicatorRef=WarningIndicator
      DTCClass_DTC_0xc07388 (DemDTCClass): DemDTCSeverity=DEM_DTC_SEV_NO_SEVERITY, DemUdsDTC=12612488
      DTC_0xc07388 (DemEventParameter):
        DemEventKind = DEM_EVENT_KIND_SWC
        DemDTCClassRef = DTCClass_DTC_0xc07388
        DemExtendedDataClassRef = ExtendedDataClass_83dcefb7
        DemFreezeFrameClassRef = FreezeFrameClass_5f5b5001
        DemFreezeFrameRecNumClassRef = FreezeFrameRecNumClass_f98c8aa7
        DemEventClass:
          DemAgingAllowed = true
          DemAgingCycleCounterThreshold = 40
          DemEventDestination = DEM_DTC_ORIGIN_PRIMARY_MEMORY
          DemEventPriority = 2
          DemEventSignificance = DEM_EVENT_SIGNIFICANCE_FAULT
          DemEventFailureCycleCounterThreshold = 0
          DemAgingCycleRef = PowerCycle
          DemEnableConditionGroupRef = EnableConditionGroup_d1c785ea
          DemOperationCycleRef = PowerCycle
          DemDebounceAlgorithmClass
            DemDebounceCounterBased: DemDebounceCounterDecrementStepSize=1, DemDebounceCounterIncrementStepSize=1, DemDebounceCounterJumpDown=false, DemDebounceCounterJumpUp=true
          IndicatorAttribute_WarningIndicator (DemIndicatorAttribute): DemIndicatorFailureCycleSource=DEM_FAILURE_CYCLE_EVENT, DemIndicatorHealingCycleRef=PowerCycle, DemIndicatorRef=WarningIndicator
      DTCClass_DTC_0xc07488 (DemDTCClass): DemDTCSeverity=DEM_DTC_SEV_NO_SEVERITY, DemUdsDTC=12612744
      DTC_0xc07488 (DemEventParameter):
        DemEventKind = DEM_EVENT_KIND_SWC
        DemDTCClassRef = DTCClass_DTC_0xc07488
        DemExtendedDataClassRef = ExtendedDataClass_83dcefb7
        DemFreezeFrameClassRef = FreezeFrameClass_5f5b5001
        DemFreezeFrameRecNumClassRef = FreezeFrameRecNumClass_f98c8aa7
        DemEventClass:
          DemAgingAllowed = true
          DemAgingCycleCounterThreshold = 40
          DemEventDestination = DEM_DTC_ORIGIN_PRIMARY_MEMORY
          DemEventPriority = 2
          DemEventSignificance = DEM_EVENT_SIGNIFICANCE_FAULT
          DemEventFailureCycleCounterThreshold = 0
          DemAgingCycleRef = PowerCycle
          DemEnableConditionGroupRef = EnableConditionGroup_d1c785ea
          DemOperationCycleRef = PowerCycle
          DemDebounceAlgorithmClass
            DemDebounceCounterBased: DemDebounceCounterDecrementStepSize=1, DemDebounceCounterIncrementStepSize=1, DemDebounceCounterJumpDown=false, DemDebounceCounterJumpUp=true
          IndicatorAttribute_WarningIndicator (DemIndicatorAttribute): DemIndicatorFailureCycleSource=DEM_FAILURE_CYCLE_EVENT, DemIndicatorHealingCycleRef=PowerCycle, DemIndicatorRef=WarningIndicator
      DTCClass_DTC_0xc10387 (DemDTCClass): DemDTCSeverity=DEM_DTC_SEV_NO_SEVERITY, DemUdsDTC=12649351
      DTC_0xc10387 (DemEventParameter):
        DemEventKind = DEM_EVENT_KIND_SWC
        DemDTCClassRef = DTCClass_DTC_0xc10387
        DemExtendedDataClassRef = ExtendedDataClass_83dcefb7
        DemFreezeFrameClassRef = FreezeFrameClass_5f5b5001
        DemFreezeFrameRecNumClassRef = FreezeFrameRecNumClass_f98c8aa7
        DemEventClass:
          DemAgingAllowed = true
          DemAgingCycleCounterThreshold = 40
          DemEventDestination = DEM_DTC_ORIGIN_PRIMARY_MEMORY
          DemEventPriority = 2
          DemEventSignificance = DEM_EVENT_SIGNIFICANCE_FAULT
          DemEventFailureCycleCounterThreshold = 0
          DemAgingCycleRef = PowerCycle
          DemEnableConditionGroupRef = EnableConditionGroup_9ac8c945
          DemOperationCycleRef = PowerCycle
          DemDebounceAlgorithmClass
            DemDebounceCounterBased: DemDebounceCounterDecrementStepSize=1, DemDebounceCounterIncrementStepSize=1, DemDebounceCounterJumpDown=false, DemDebounceCounterJumpUp=true
          IndicatorAttribute_WarningIndicator (DemIndicatorAttribute): DemIndicatorFailureCycleSource=DEM_FAILURE_CYCLE_EVENT, DemIndicatorHealingCycleRef=PowerCycle, DemIndicatorRef=WarningIndicator
      DTCClass_DTC_0xc11087 (DemDTCClass): DemDTCSeverity=DEM_DTC_SEV_NO_SEVERITY, DemUdsDTC=12652679
      DTC_0xc11087 (DemEventParameter):
        DemEventKind = DEM_EVENT_KIND_SWC
        DemDTCClassRef = DTCClass_DTC_0xc11087
        DemExtendedDataClassRef = ExtendedDataClass_83dcefb7
        DemFreezeFrameClassRef = FreezeFrameClass_5f5b5001
        DemFreezeFrameRecNumClassRef = FreezeFrameRecNumClass_f98c8aa7
        DemEventClass:
          DemAgingAllowed = true
          DemAgingCycleCounterThreshold = 40
          DemEventDestination = DEM_DTC_ORIGIN_PRIMARY_MEMORY
          DemEventPriority = 2
          DemEventSignificance = DEM_EVENT_SIGNIFICANCE_FAULT
          DemEventFailureCycleCounterThreshold = 0
          DemAgingCycleRef = PowerCycle
          DemEnableConditionGroupRef = EnableConditionGroup_c779eeed
          DemOperationCycleRef = PowerCycle
          DemDebounceAlgorithmClass
            DemDebounceCounterBased: DemDebounceCounterDecrementStepSize=1, DemDebounceCounterIncrementStepSize=1, DemDebounceCounterJumpDown=false, DemDebounceCounterJumpUp=true
          IndicatorAttribute_WarningIndicator (DemIndicatorAttribute): DemIndicatorFailureCycleSource=DEM_FAILURE_CYCLE_EVENT, DemIndicatorHealingCycleRef=PowerCycle, DemIndicatorRef=WarningIndicator
      DTCClass_DTC_0xc11187 (DemDTCClass): DemDTCSeverity=DEM_DTC_SEV_NO_SEVERITY, DemUdsDTC=12652935
      DTC_0xc11187 (DemEventParameter):
        DemEventKind = DEM_EVENT_KIND_SWC
        DemDTCClassRef = DTCClass_DTC_0xc11187
        DemExtendedDataClassRef = ExtendedDataClass_83dcefb7
        DemFreezeFrameClassRef = FreezeFrameClass_5f5b5001
        DemFreezeFrameRecNumClassRef = FreezeFrameRecNumClass_f98c8aa7
        DemEventClass:
          DemAgingAllowed = true
          DemAgingCycleCounterThreshold = 40
          DemEventDestination = DEM_DTC_ORIGIN_PRIMARY_MEMORY
          DemEventPriority = 2
          DemEventSignificance = DEM_EVENT_SIGNIFICANCE_FAULT
          DemEventFailureCycleCounterThreshold = 0
          DemAgingCycleRef = PowerCycle
          DemEnableConditionGroupRef = EnableConditionGroup_71a7c053
          DemOperationCycleRef = PowerCycle
          DemDebounceAlgorithmClass
            DemDebounceCounterBased: DemDebounceCounterDecrementStepSize=1, DemDebounceCounterIncrementStepSize=1, DemDebounceCounterJumpDown=false, DemDebounceCounterJumpUp=true
          IndicatorAttribute_WarningIndicator (DemIndicatorAttribute): DemIndicatorFailureCycleSource=DEM_FAILURE_CYCLE_EVENT, DemIndicatorHealingCycleRef=PowerCycle, DemIndicatorRef=WarningIndicator
      DTCClass_DTC_0xc11d87 (DemDTCClass): DemDTCSeverity=DEM_DTC_SEV_NO_SEVERITY, DemUdsDTC=12656007
      DTC_0xc11d87 (DemEventParameter):
        DemEventKind = DEM_EVENT_KIND_SWC
        DemDTCClassRef = DTCClass_DTC_0xc11d87
        DemExtendedDataClassRef = ExtendedDataClass_83dcefb7
        DemFreezeFrameClassRef = FreezeFrameClass_5f5b5001
        DemFreezeFrameRecNumClassRef = FreezeFrameRecNumClass_f98c8aa7
        DemEventClass:
          DemAgingAllowed = true
          DemAgingCycleCounterThreshold = 40
          DemEventDestination = DEM_DTC_ORIGIN_PRIMARY_MEMORY
          DemEventPriority = 2
          DemEventSignificance = DEM_EVENT_SIGNIFICANCE_FAULT
          DemEventFailureCycleCounterThreshold = 0
          DemAgingCycleRef = PowerCycle
          DemEnableConditionGroupRef = EnableConditionGroup_9ac8c945
          DemOperationCycleRef = PowerCycle
          DemDebounceAlgorithmClass
            DemDebounceCounterBased: DemDebounceCounterDecrementStepSize=1, DemDebounceCounterIncrementStepSize=1, DemDebounceCounterJumpDown=false, DemDebounceCounterJumpUp=true
          IndicatorAttribute_WarningIndicator (DemIndicatorAttribute): DemIndicatorFailureCycleSource=DEM_FAILURE_CYCLE_EVENT, DemIndicatorHealingCycleRef=PowerCycle, DemIndicatorRef=WarningIndicator
      DTCClass_DTC_0xc12187 (DemDTCClass): DemDTCSeverity=DEM_DTC_SEV_NO_SEVERITY, DemUdsDTC=12657031
      DTC_0xc12187 (DemEventParameter):
        DemEventKind = DEM_EVENT_KIND_SWC
        DemDTCClassRef = DTCClass_DTC_0xc12187
        DemExtendedDataClassRef = ExtendedDataClass_83dcefb7
        DemFreezeFrameClassRef = FreezeFrameClass_5f5b5001
        DemFreezeFrameRecNumClassRef = FreezeFrameRecNumClass_f98c8aa7
        DemEventClass:
          DemAgingAllowed = true
          DemAgingCycleCounterThreshold = 40
          DemEventDestination = DEM_DTC_ORIGIN_PRIMARY_MEMORY
          DemEventPriority = 2
          DemEventSignificance = DEM_EVENT_SIGNIFICANCE_FAULT
          DemEventFailureCycleCounterThreshold = 0
          DemAgingCycleRef = PowerCycle
          DemEnableConditionGroupRef = EnableConditionGroup_be914dc6
          DemOperationCycleRef = PowerCycle
          DemDebounceAlgorithmClass
            DemDebounceCounterBased: DemDebounceCounterDecrementStepSize=1, DemDebounceCounterIncrementStepSize=1, DemDebounceCounterJumpDown=false, DemDebounceCounterJumpUp=true
          IndicatorAttribute_WarningIndicator (DemIndicatorAttribute): DemIndicatorFailureCycleSource=DEM_FAILURE_CYCLE_EVENT, DemIndicatorHealingCycleRef=PowerCycle, DemIndicatorRef=WarningIndicator
      DTCClass_DTC_0xc12387 (DemDTCClass): DemDTCSeverity=DEM_DTC_SEV_NO_SEVERITY, DemUdsDTC=12657543
      DTC_0xc12387 (DemEventParameter):
        DemEventKind = DEM_EVENT_KIND_SWC
        DemDTCClassRef = DTCClass_DTC_0xc12387
        DemExtendedDataClassRef = ExtendedDataClass_83dcefb7
        DemFreezeFrameClassRef = FreezeFrameClass_5f5b5001
        DemFreezeFrameRecNumClassRef = FreezeFrameRecNumClass_f98c8aa7
        DemEventClass:
          DemAgingAllowed = true
          DemAgingCycleCounterThreshold = 40
          DemEventDestination = DEM_DTC_ORIGIN_PRIMARY_MEMORY
          DemEventPriority = 2
          DemEventSignificance = DEM_EVENT_SIGNIFICANCE_FAULT
          DemEventFailureCycleCounterThreshold = 0
          DemAgingCycleRef = PowerCycle
          DemEnableConditionGroupRef = EnableConditionGroup_9ac8c945
          DemOperationCycleRef = PowerCycle
          DemDebounceAlgorithmClass
            DemDebounceCounterBased: DemDebounceCounterDecrementStepSize=1, DemDebounceCounterIncrementStepSize=1, DemDebounceCounterJumpDown=false, DemDebounceCounterJumpUp=true
          IndicatorAttribute_WarningIndicator (DemIndicatorAttribute): DemIndicatorFailureCycleSource=DEM_FAILURE_CYCLE_EVENT, DemIndicatorHealingCycleRef=PowerCycle, DemIndicatorRef=WarningIndicator
      DTCClass_DTC_0xc12987 (DemDTCClass): DemDTCSeverity=DEM_DTC_SEV_NO_SEVERITY, DemUdsDTC=12659079
      DTC_0xc12987 (DemEventParameter):
        DemEventKind = DEM_EVENT_KIND_SWC
        DemDTCClassRef = DTCClass_DTC_0xc12987
        DemExtendedDataClassRef = ExtendedDataClass_83dcefb7
        DemFreezeFrameClassRef = FreezeFrameClass_5f5b5001
        DemFreezeFrameRecNumClassRef = FreezeFrameRecNumClass_f98c8aa7
        DemEventClass:
          DemAgingAllowed = true
          DemAgingCycleCounterThreshold = 40
          DemEventDestination = DEM_DTC_ORIGIN_PRIMARY_MEMORY
          DemEventPriority = 2
          DemEventSignificance = DEM_EVENT_SIGNIFICANCE_FAULT
          DemEventFailureCycleCounterThreshold = 0
          DemAgingCycleRef = PowerCycle
          DemEnableConditionGroupRef = EnableConditionGroup_be914dc6
          DemOperationCycleRef = PowerCycle
          DemDebounceAlgorithmClass
            DemDebounceCounterBased: DemDebounceCounterDecrementStepSize=1, DemDebounceCounterIncrementStepSize=1, DemDebounceCounterJumpDown=false, DemDebounceCounterJumpUp=true
          IndicatorAttribute_WarningIndicator (DemIndicatorAttribute): DemIndicatorFailureCycleSource=DEM_FAILURE_CYCLE_EVENT, DemIndicatorHealingCycleRef=PowerCycle, DemIndicatorRef=WarningIndicator
      DTCClass_DTC_0xc14087 (DemDTCClass): DemDTCSeverity=DEM_DTC_SEV_NO_SEVERITY, DemUdsDTC=12664967
      DTC_0xc14087 (DemEventParameter):
        DemEventKind = DEM_EVENT_KIND_SWC
        DemDTCClassRef = DTCClass_DTC_0xc14087
        DemExtendedDataClassRef = ExtendedDataClass_83dcefb7
        DemFreezeFrameClassRef = FreezeFrameClass_5f5b5001
        DemFreezeFrameRecNumClassRef = FreezeFrameRecNumClass_f98c8aa7
        DemEventClass:
          DemAgingAllowed = true
          DemAgingCycleCounterThreshold = 40
          DemEventDestination = DEM_DTC_ORIGIN_PRIMARY_MEMORY
          DemEventPriority = 2
          DemEventSignificance = DEM_EVENT_SIGNIFICANCE_FAULT
          DemEventFailureCycleCounterThreshold = 0
          DemAgingCycleRef = PowerCycle
          DemEnableConditionGroupRef = EnableConditionGroup_5ad0cd2d
          DemOperationCycleRef = PowerCycle
          DemDebounceAlgorithmClass
            DemDebounceCounterBased: DemDebounceCounterDecrementStepSize=1, DemDebounceCounterIncrementStepSize=1, DemDebounceCounterJumpDown=false, DemDebounceCounterJumpUp=true
          IndicatorAttribute_WarningIndicator (DemIndicatorAttribute): DemIndicatorFailureCycleSource=DEM_FAILURE_CYCLE_EVENT, DemIndicatorHealingCycleRef=PowerCycle, DemIndicatorRef=WarningIndicator
      DTCClass_DTC_0xc14787 (DemDTCClass): DemDTCSeverity=DEM_DTC_SEV_NO_SEVERITY, DemUdsDTC=12666759
      DTC_0xc14787 (DemEventParameter):
        DemEventKind = DEM_EVENT_KIND_SWC
        DemDTCClassRef = DTCClass_DTC_0xc14787
        DemExtendedDataClassRef = ExtendedDataClass_83dcefb7
        DemFreezeFrameClassRef = FreezeFrameClass_5f5b5001
        DemFreezeFrameRecNumClassRef = FreezeFrameRecNumClass_f98c8aa7
        DemEventClass:
          DemAgingAllowed = true
          DemAgingCycleCounterThreshold = 40
          DemEventDestination = DEM_DTC_ORIGIN_PRIMARY_MEMORY
          DemEventPriority = 2
          DemEventSignificance = DEM_EVENT_SIGNIFICANCE_FAULT
          DemEventFailureCycleCounterThreshold = 0
          DemAgingCycleRef = PowerCycle
          DemEnableConditionGroupRef = EnableConditionGroup_5ad0cd2d
          DemOperationCycleRef = PowerCycle
          DemDebounceAlgorithmClass
            DemDebounceCounterBased: DemDebounceCounterDecrementStepSize=1, DemDebounceCounterIncrementStepSize=1, DemDebounceCounterJumpDown=false, DemDebounceCounterJumpUp=true
          IndicatorAttribute_WarningIndicator (DemIndicatorAttribute): DemIndicatorFailureCycleSource=DEM_FAILURE_CYCLE_EVENT, DemIndicatorHealingCycleRef=PowerCycle, DemIndicatorRef=WarningIndicator
      DTCClass_DTC_0xc16687 (DemDTCClass): DemDTCSeverity=DEM_DTC_SEV_NO_SEVERITY, DemUdsDTC=12674695
      DTC_0xc16687 (DemEventParameter):
        DemEventKind = DEM_EVENT_KIND_SWC
        DemDTCClassRef = DTCClass_DTC_0xc16687
        DemExtendedDataClassRef = ExtendedDataClass_83dcefb7
        DemFreezeFrameClassRef = FreezeFrameClass_5f5b5001
        DemFreezeFrameRecNumClassRef = FreezeFrameRecNumClass_f98c8aa7
        DemEventClass:
          DemAgingAllowed = true
          DemAgingCycleCounterThreshold = 40
          DemEventDestination = DEM_DTC_ORIGIN_PRIMARY_MEMORY
          DemEventPriority = 2
          DemEventSignificance = DEM_EVENT_SIGNIFICANCE_FAULT
          DemEventFailureCycleCounterThreshold = 0
          DemAgingCycleRef = PowerCycle
          DemEnableConditionGroupRef = EnableConditionGroup_cca67fec
          DemOperationCycleRef = PowerCycle
          DemDebounceAlgorithmClass
            DemDebounceCounterBased: DemDebounceCounterDecrementStepSize=1, DemDebounceCounterIncrementStepSize=1, DemDebounceCounterJumpDown=false, DemDebounceCounterJumpUp=true
          IndicatorAttribute_WarningIndicator (DemIndicatorAttribute): DemIndicatorFailureCycleSource=DEM_FAILURE_CYCLE_EVENT, DemIndicatorHealingCycleRef=PowerCycle, DemIndicatorRef=WarningIndicator
      DTCClass_DTC_0xc19687 (DemDTCClass): DemDTCSeverity=DEM_DTC_SEV_NO_SEVERITY, DemUdsDTC=12686983
      DTC_0xc19687 (DemEventParameter):
        DemEventKind = DEM_EVENT_KIND_SWC
        DemDTCClassRef = DTCClass_DTC_0xc19687
        DemExtendedDataClassRef = ExtendedDataClass_83dcefb7
        DemFreezeFrameClassRef = FreezeFrameClass_5f5b5001
        DemFreezeFrameRecNumClassRef = FreezeFrameRecNumClass_f98c8aa7
        DemEventClass:
          DemAgingAllowed = true
          DemAgingCycleCounterThreshold = 40
          DemEventDestination = DEM_DTC_ORIGIN_PRIMARY_MEMORY
          DemEventPriority = 2
          DemEventSignificance = DEM_EVENT_SIGNIFICANCE_FAULT
          DemEventFailureCycleCounterThreshold = 0
          DemAgingCycleRef = PowerCycle
          DemEnableConditionGroupRef = EnableConditionGroup_eb032f9a
          DemOperationCycleRef = PowerCycle
          DemDebounceAlgorithmClass
            DemDebounceCounterBased: DemDebounceCounterDecrementStepSize=1, DemDebounceCounterIncrementStepSize=1, DemDebounceCounterJumpDown=false, DemDebounceCounterJumpUp=true
          IndicatorAttribute_WarningIndicator (DemIndicatorAttribute): DemIndicatorFailureCycleSource=DEM_FAILURE_CYCLE_EVENT, DemIndicatorHealingCycleRef=PowerCycle, DemIndicatorRef=WarningIndicator
      DTCClass_DTC_0xc19987 (DemDTCClass): DemDTCSeverity=DEM_DTC_SEV_NO_SEVERITY, DemUdsDTC=12687751
      DTC_0xc19987 (DemEventParameter):
        DemEventKind = DEM_EVENT_KIND_SWC
        DemDTCClassRef = DTCClass_DTC_0xc19987
        DemExtendedDataClassRef = ExtendedDataClass_83dcefb7
        DemFreezeFrameClassRef = FreezeFrameClass_5f5b5001
        DemFreezeFrameRecNumClassRef = FreezeFrameRecNumClass_f98c8aa7
        DemEventClass:
          DemAgingAllowed = true
          DemAgingCycleCounterThreshold = 40
          DemEventDestination = DEM_DTC_ORIGIN_PRIMARY_MEMORY
          DemEventPriority = 2
          DemEventSignificance = DEM_EVENT_SIGNIFICANCE_FAULT
          DemEventFailureCycleCounterThreshold = 0
          DemAgingCycleRef = PowerCycle
          DemEnableConditionGroupRef = EnableConditionGroup_9ac8c945
          DemOperationCycleRef = PowerCycle
          DemDebounceAlgorithmClass
            DemDebounceCounterBased: DemDebounceCounterDecrementStepSize=1, DemDebounceCounterIncrementStepSize=1, DemDebounceCounterJumpDown=false, DemDebounceCounterJumpUp=true
          IndicatorAttribute_WarningIndicator (DemIndicatorAttribute): DemIndicatorFailureCycleSource=DEM_FAILURE_CYCLE_EVENT, DemIndicatorHealingCycleRef=PowerCycle, DemIndicatorRef=WarningIndicator
      DTCClass_DTC_0xc19b87 (DemDTCClass): DemDTCSeverity=DEM_DTC_SEV_NO_SEVERITY, DemUdsDTC=12688263
      DTC_0xc19b87 (DemEventParameter):
        DemEventKind = DEM_EVENT_KIND_SWC
        DemDTCClassRef = DTCClass_DTC_0xc19b87
        DemExtendedDataClassRef = ExtendedDataClass_83dcefb7
        DemFreezeFrameClassRef = FreezeFrameClass_5f5b5001
        DemFreezeFrameRecNumClassRef = FreezeFrameRecNumClass_f98c8aa7
        DemEventClass:
          DemAgingAllowed = true
          DemAgingCycleCounterThreshold = 40
          DemEventDestination = DEM_DTC_ORIGIN_PRIMARY_MEMORY
          DemEventPriority = 2
          DemEventSignificance = DEM_EVENT_SIGNIFICANCE_FAULT
          DemEventFailureCycleCounterThreshold = 0
          DemAgingCycleRef = PowerCycle
          DemEnableConditionGroupRef = EnableConditionGroup_c779eeed
          DemOperationCycleRef = PowerCycle
          DemDebounceAlgorithmClass
            DemDebounceCounterBased: DemDebounceCounterDecrementStepSize=1, DemDebounceCounterIncrementStepSize=1, DemDebounceCounterJumpDown=false, DemDebounceCounterJumpUp=true
          IndicatorAttribute_WarningIndicator (DemIndicatorAttribute): DemIndicatorFailureCycleSource=DEM_FAILURE_CYCLE_EVENT, DemIndicatorHealingCycleRef=PowerCycle, DemIndicatorRef=WarningIndicator
      DTCClass_DTC_0xc29887 (DemDTCClass): DemDTCSeverity=DEM_DTC_SEV_NO_SEVERITY, DemUdsDTC=12753031
      DTC_0xc29887 (DemEventParameter):
        DemEventKind = DEM_EVENT_KIND_SWC
        DemDTCClassRef = DTCClass_DTC_0xc29887
        DemExtendedDataClassRef = ExtendedDataClass_83dcefb7
        DemFreezeFrameClassRef = FreezeFrameClass_5f5b5001
        DemFreezeFrameRecNumClassRef = FreezeFrameRecNumClass_f98c8aa7
        DemEventClass:
          DemAgingAllowed = true
          DemAgingCycleCounterThreshold = 40
          DemEventDestination = DEM_DTC_ORIGIN_PRIMARY_MEMORY
          DemEventPriority = 2
          DemEventSignificance = DEM_EVENT_SIGNIFICANCE_FAULT
          DemEventFailureCycleCounterThreshold = 0
          DemAgingCycleRef = PowerCycle
          DemEnableConditionGroupRef = EnableConditionGroup_c779eeed
          DemOperationCycleRef = PowerCycle
          DemDebounceAlgorithmClass
            DemDebounceCounterBased: DemDebounceCounterDecrementStepSize=1, DemDebounceCounterIncrementStepSize=1, DemDebounceCounterJumpDown=false, DemDebounceCounterJumpUp=true
          IndicatorAttribute_WarningIndicator (DemIndicatorAttribute): DemIndicatorFailureCycleSource=DEM_FAILURE_CYCLE_EVENT, DemIndicatorHealingCycleRef=PowerCycle, DemIndicatorRef=WarningIndicator
      DTCClass_DTC_0xd10587 (DemDTCClass): DemDTCSeverity=DEM_DTC_SEV_NO_SEVERITY, DemUdsDTC=13698439
      DTC_0xd10587 (DemEventParameter):
        DemEventKind = DEM_EVENT_KIND_SWC
        DemDTCClassRef = DTCClass_DTC_0xd10587
        DemExtendedDataClassRef = ExtendedDataClass_83dcefb7
        DemFreezeFrameClassRef = FreezeFrameClass_5f5b5001
        DemFreezeFrameRecNumClassRef = FreezeFrameRecNumClass_f98c8aa7
        DemEventClass:
          DemAgingAllowed = true
          DemAgingCycleCounterThreshold = 40
          DemEventDestination = DEM_DTC_ORIGIN_PRIMARY_MEMORY
          DemEventPriority = 2
          DemEventSignificance = DEM_EVENT_SIGNIFICANCE_FAULT
          DemEventFailureCycleCounterThreshold = 0
          DemAgingCycleRef = PowerCycle
          DemEnableConditionGroupRef = EnableConditionGroup_d73be567
          DemOperationCycleRef = PowerCycle
          DemDebounceAlgorithmClass
            DemDebounceCounterBased: DemDebounceCounterDecrementStepSize=1, DemDebounceCounterIncrementStepSize=1, DemDebounceCounterJumpDown=false, DemDebounceCounterJumpUp=true
          IndicatorAttribute_WarningIndicator (DemIndicatorAttribute): DemIndicatorFailureCycleSource=DEM_FAILURE_CYCLE_EVENT, DemIndicatorHealingCycleRef=PowerCycle, DemIndicatorRef=WarningIndicator
    DemGeneral:
      DemAgingCycleCounterProcessing = DEM_PROCESS_AGINGCTR_INTERN
      DemDebounceCounterBasedSupport = true
      DemEnableConditionSupport = true
      DemPTOSupport = false
      DemDtcStatusAvailabilityMask = 9
      DemTypeOfFreezeFrameRecordNumeration = DEM_FF_RECNUM_CONFIGURED
      14 x DemDidClass:
        VCU_AccPealparameter: DemDidIdentifier=7425, DemDidDataClassRef=DID_0x1d01_VCU_VehicleSpeed, DemDidDataClassRef=DID_0x1d01_Accelerator_pedal_sensor_1_voltage, DemDidDataClassRef=DID_0x1d01_Accelerator_pedal_sensor_2_voltage, DemDidDataClassRef=DID_0x1d01_VCU_AccelerationPedal
        AC_charging_parameter: DemDidIdentifier=7429, DemDidDataClassRef=DID_0x1d05_POD_OBC_InputACVoltage, DemDidDataClassRef=DID_0x1d05_VCU_OBC_ChargeCurrentCommand, DemDidDataClassRef=DID_0x1d05_POD_OBC_OutputDCChargeCurrent, DemDidDataClassRef=DID_0x1d05_POD_OBC_OutputDCChargeVoltage
        Electronic_lock_state: DemDidIdentifier=7431, DemDidDataClassRef=DID_0x1d07_Electronic_lock_state
        VCU_HV_InterLock_PWM_pfrequency: DemDidIdentifier=7432, DemDidDataClassRef=DID_0x1d08_VCU_HVIL
        S2_status: DemDidIdentifier=7433, DemDidDataClassRef=DID_0x1d09_New_Bit_Field
        VCU_control_main_relay: DemDidIdentifier=7441, DemDidDataClassRef=DID_0x1d11_Mainrealy1, DemDidDataClassRef=DID_0x1d11_Mainrelay2
        Ignition_Switch_Signal: DemDidIdentifier=61856, DemDidDataClassRef=DID_0xf1a0_Ignition_Switch_Signal
        Battery_Voltage: DemDidIdentifier=61857, DemDidDataClassRef=DID_0xf1a1_Battery_Voltage
        Total_Odometer: DemDidIdentifier=61858, DemDidDataClassRef=DID_0xf1a2_Total_Odometer
        Vehicle_speed: DemDidIdentifier=61859, DemDidDataClassRef=DID_0xf1a3_Vehicle_speed
        Date_And_Time: DemDidIdentifier=61860, DemDidDataClassRef=DID_0xf1a4_Date_And_Time_Second, DemDidDataClassRef=DID_0xf1a4_Date_And_Time_Minute, DemDidDataClassRef=DID_0xf1a4_Date_And_Time_Hour, DemDidDataClassRef=DID_0xf1a4_Date_And_Time_Day, DemDidDataClassRef=DID_0xf1a4_Date_And_Time_Month, DemDidDataClassRef=DID_0xf1a4_Date_And_Time_Year
        VCU_HVStatus: DemDidIdentifier=61861, DemDidDataClassRef=DID_0xf1a5_VCU_HVStatus
        SOC: DemDidIdentifier=61862, DemDidDataClassRef=DID_0xf1a6_SOC
        Gear: DemDidIdentifier=61863, DemDidDataClassRef=DID_0xf1a7_Gear
      176 x DemEnableCondition:
        ms
        after
        being
        waked
        up
        The
        battery
        voltage
        is
        normal
        V
        to
        or
        recovers
        from
        the_001
        abnormal
        for
        No
        active
        service
        Note
        If
        any
        of
        enable
        conditions
        trigger
        not
        met
        during
        fault
        confirmation
        process
        diagnosis
        shall
        be
        completed
        When
        all
        are
        performed
        again
        AC
        guns
        POD_OBC_CCStatus
        x2
        Ohm
        x{3..5}
        VCU
        requests
        OBC
        Close
        electronic
        lock
        VCU_OBC_Control_of_em_lock
        x1
        S2
        switch
        closed
        POD_OBC_VCU_S2_State
        On
        charging
        status
        charge
        function
        Enable_001
        VCU_EnableOBC
        Non
        preheating
        BMS_ChargeStatus
        Heat
        only
        Charging_001
        VCU_ChargeStatus
        Plug
        Detected
        DC
        BMS
        disconnect
        main
        negative
        relay
        VCU_BMS_Control_of_NegRelay
        Open
        positive
        detected_001
        Chargestatus
        High
        Power
        BMS_status
        request
        POD
        close_001
        VCU_Enable_DC_Relay
        Request_001
        sends
        BHM
        message
        BRM
        x0
        KL15eWakeUp
        ON_001
        VCU_Hvstatus_001
        Init
        VCU_RequestedModeBMS
        HVActive
        MCU_VCUWorkMode
        Standby
        VCU_MCURequestedState
        Ready
        Disable
        VCU_
        ModeRequestDCDC
        VCU_RequestedModeTCU
        InActive
        TrqCtrl
        Torque
        Control
        VCU_ModeRequestDCDC
        Buck
        serviceNote
        Accelerator
        pedal
        pin1
        restored
        v_001
        and
        accelerator_001
        pin2
        opening
        signal
        pin
        times
        s
        All_001
        following
        simultaneously
        last
        T_Delay
        Being_001
        condition
        in
        Conditions_001
        does
        meet
        requirements
        reset
        start
        timing
        In_001
        Confirmed
        DTC
        criteria
        timer
        if_001
        do
        recovered
        Reset_001
        Busoff
        Lan
        PNC0
        KL15e
        PNC03
        PNC04
        PNC{13..16}
        PNC18
        KL15E_001
        PNC25
        PNC31
        LAN_001
      ExtendedDataClass_83dcefb7 (DemExtendedDataClass): DemExtendedDataRecordClassRef=ExtendedData
      35 x DemEnableConditionGroup, all with DemEnableConditionRef=If, DemEnableConditionRef=are, DemEnableConditionRef=process:
        EnableConditionGroup_171dbb3c: DemEnableConditionRef=Enable_001, DemEnableConditionRef=No, DemEnableConditionRef=The, DemEnableConditionRef=V, DemEnableConditionRef=V, DemEnableConditionRef=VCU_RequestedModeTCU, DemEnableConditionRef=When, DemEnableConditionRef=abnormal, DemEnableConditionRef=active, DemEnableConditionRef=after, DemEnableConditionRef=again, DemEnableConditionRef=all, DemEnableConditionRef=any, DemEnableConditionRef=battery, DemEnableConditionRef=be, DemEnableConditionRef=being, DemEnableConditionRef=completed, DemEnableConditionRef=conditions, DemEnableConditionRef=conditions, DemEnableConditionRef=conditions, DemEnableConditionRef=confirmation, DemEnableConditionRef=diagnosis, DemEnableConditionRef=diagnosis, DemEnableConditionRef=during, DemEnableConditionRef=enable, DemEnableConditionRef=fault, DemEnableConditionRef=fault, DemEnableConditionRef=fault, DemEnableConditionRef=for, DemEnableConditionRef=from, DemEnableConditionRef=is, DemEnableConditionRef=is, DemEnableConditionRef=is, DemEnableConditionRef=met, DemEnableConditionRef=met, DemEnableConditionRef=ms, DemEnableConditionRef=ms, DemEnableConditionRef=normal, DemEnableConditionRef=not, DemEnableConditionRef=of, DemEnableConditionRef=or, DemEnableConditionRef=or, DemEnableConditionRef=performed, DemEnableConditionRef=recovers, DemEnableConditionRef=serviceNote, DemEnableConditionRef=shall, DemEnableConditionRef=the_001, DemEnableConditionRef=the_001, DemEnableConditionRef=the_001, DemEnableConditionRef=the_001, DemEnableConditionRef=the_001, DemEnableConditionRef=the_001, DemEnableConditionRef=to, DemEnableConditionRef=trigger, DemEnableConditionRef=up, DemEnableConditionRef=voltage, DemEnableConditionRef=voltage, DemEnableConditionRef=waked, DemEnableConditionRef=x3
        EnableConditionGroup_2261a858: DemEnableConditionRef=AC, DemEnableConditionRef=Close, DemEnableConditionRef=Close, DemEnableConditionRef=No, DemEnableConditionRef=Note, DemEnableConditionRef=OBC, DemEnableConditionRef=Ohm, DemEnableConditionRef=Ohm, DemEnableConditionRef=Ohm, DemEnableConditionRef=Ohm, DemEnableConditionRef=POD_OBC_CCStatus, DemEnableConditionRef=The, DemEnableConditionRef=V, DemEnableConditionRef=V, DemEnableConditionRef=VCU, DemEnableConditionRef=VCU_OBC_Control_of_em_lock, DemEnableConditionRef=When, DemEnableConditionRef=abnormal, DemEnableConditionRef=active, DemEnableConditionRef=active, DemEnableConditionRef=again, DemEnableConditionRef=all, DemEnableConditionRef=any, DemEnableConditionRef=battery, DemEnableConditionRef=be, DemEnableConditionRef=completed, DemEnableConditionRef=conditions, DemEnableConditionRef=conditions, DemEnableConditionRef=conditions, DemEnableConditionRef=confirmation, DemEnableConditionRef=diagnosis, DemEnableConditionRef=diagnosis, DemEnableConditionRef=during, DemEnableConditionRef=electronic, DemEnableConditionRef=enable, DemEnableConditionRef=fault, DemEnableConditionRef=fault, DemEnableConditionRef=fault, DemEnableConditionRef=for, DemEnableConditionRef=from, DemEnableConditionRef=guns, DemEnableConditionRef=is, DemEnableConditionRef=is, DemEnableConditionRef=is, DemEnableConditionRef=is, DemEnableConditionRef=lock, DemEnableConditionRef=met, DemEnableConditionRef=met, DemEnableConditionRef=ms, DemEnableConditionRef=normal, DemEnableConditionRef=not, DemEnableConditionRef=of, DemEnableConditionRef=or, DemEnableConditionRef=or, DemEnableConditionRef=performed, DemEnableConditionRef=recovers, DemEnableConditionRef=requests, DemEnableConditionRef=service, DemEnableConditionRef=shall, DemEnableConditionRef=the_001, DemEnableConditionRef=the_001, DemEnableConditionRef=the_001, DemEnableConditionRef=the_001, DemEnableConditionRef=the_001, DemEnableConditionRef=the_001, DemEnableConditionRef=the_001, DemEnableConditionRef=to, DemEnableConditionRef=to, DemEnableConditionRef=trigger, DemEnableConditionRef=voltage, DemEnableConditionRef=voltage, DemEnableConditionRef=x1, DemEnableConditionRef=x2, DemEnableConditionRef=x3, DemEnableConditionRef=x4, DemEnableConditionRef=x5
        EnableConditionGroup_63ddaef5: DemEnableConditionRef=BMS, DemEnableConditionRef=BMS_status, DemEnableConditionRef=DemGeneral/Chargestatus, DemEnableConditionRef=Close, DemEnableConditionRef=DC, DemEnableConditionRef=DC, DemEnableConditionRef=DC, DemEnableConditionRef=DC, DemEnableConditionRef=DC, DemEnableConditionRef=Detected, DemEnableConditionRef=High, DemEnableConditionRef=Note, DemEnableConditionRef=On, DemEnableConditionRef=POD, DemEnableConditionRef=Plug, DemEnableConditionRef=Plug, DemEnableConditionRef=Power, DemEnableConditionRef=Request_001, DemEnableConditionRef=VCU, DemEnableConditionRef=VCU, DemEnableConditionRef=VCU_Enable_DC_Relay, DemEnableConditionRef=When, DemEnableConditionRef=again, DemEnableConditionRef=all, DemEnableConditionRef=any, DemEnableConditionRef=be, DemEnableConditionRef=charge, DemEnableConditionRef=charge, DemEnableConditionRef=charging, DemEnableConditionRef=close_001, DemEnableConditionRef=completed, DemEnableConditionRef=completed, DemEnableConditionRef=conditions, DemEnableConditionRef=conditions, DemEnableConditionRef=conditions, DemEnableConditionRef=confirmation, DemEnableConditionRef=detected_001, DemEnableConditionRef=diagnosis, DemEnableConditionRef=diagnosis, DemEnableConditionRef=during, DemEnableConditionRef=enable, DemEnableConditionRef=fault, DemEnableConditionRef=fault, DemEnableConditionRef=fault, DemEnableConditionRef=for, DemEnableConditionRef=is, DemEnableConditionRef=is, DemEnableConditionRef=is, DemEnableConditionRef=is, DemEnableConditionRef=met, DemEnableConditionRef=met, DemEnableConditionRef=not, DemEnableConditionRef=of, DemEnableConditionRef=or, DemEnableConditionRef=performed, DemEnableConditionRef=relay, DemEnableConditionRef=request, DemEnableConditionRef=shall, DemEnableConditionRef=the_001, DemEnableConditionRef=the_001, DemEnableConditionRef=the_001, DemEnableConditionRef=the_001, DemEnableConditionRef=the_001, DemEnableConditionRef=to, DemEnableConditionRef=trigger, DemEnableConditionRef=voltage, DemEnableConditionRef=x1, DemEnableConditionRef=x3, DemEnableConditionRef=x3
        EnableConditionGroup_f1606167: DemEnableConditionRef=AC, DemEnableConditionRef=Close, DemEnableConditionRef=No, DemEnableConditionRef=Note, DemEnableConditionRef=Ohm, DemEnableConditionRef=Ohm, DemEnableConditionRef=Ohm, DemEnableConditionRef=Ohm, DemEnableConditionRef=POD_OBC_CCStatus, DemEnableConditionRef=POD_OBC_VCU_S2_State, DemEnableConditionRef=S2, DemEnableConditionRef=The, DemEnableConditionRef=V, DemEnableConditionRef=V, DemEnableConditionRef=When, DemEnableConditionRef=abnormal, DemEnableConditionRef=active, DemEnableConditionRef=active, DemEnableConditionRef=again, DemEnableConditionRef=all, DemEnableConditionRef=any, DemEnableConditionRef=battery, DemEnableConditionRef=be, DemEnableConditionRef=closed, DemEnableConditionRef=completed, DemEnableConditionRef=conditions, DemEnableConditionRef=conditions, DemEnableConditionRef=conditions, DemEnableConditionRef=confirmation, DemEnableConditionRef=diagnosis, DemEnableConditionRef=diagnosis, DemEnableConditionRef=during, DemEnableConditionRef=enable, DemEnableConditionRef=fault, DemEnableConditionRef=fault, DemEnableConditionRef=fault, DemEnableConditionRef=for, DemEnableConditionRef=from, DemEnableConditionRef=guns, DemEnableConditionRef=is, DemEnableConditionRef=is, DemEnableConditionRef=is, DemEnableConditionRef=is, DemEnableConditionRef=is, DemEnableConditionRef=met, DemEnableConditionRef=met, DemEnableConditionRef=ms, DemEnableConditionRef=normal, DemEnableConditionRef=not, DemEnableConditionRef=of, DemEnableConditionRef=or, DemEnableConditionRef=or, DemEnableConditionRef=performed, DemEnableConditionRef=recovers, DemEnableConditionRef=service, DemEnableConditionRef=shall, DemEnableConditionRef=switch, DemEnableConditionRef=the_001, DemEnableConditionRef=the_001, DemEnableConditionRef=the_001, DemEnableConditionRef=the_001, DemEnableConditionRef=the_001, DemEnableConditionRef=the_001, DemEnableConditionRef=to, DemEnableConditionRef=trigger, DemEnableConditionRef=voltage, DemEnableConditionRef=voltage, DemEnableConditionRef=x1, DemEnableConditionRef=x2, DemEnableConditionRef=x3, DemEnableConditionRef=x4, DemEnableConditionRef=x5
        EnableConditionGroup_81b679fb: DemEnableConditionRef=No, DemEnableConditionRef=Note, DemEnableConditionRef=The, DemEnableConditionRef=TrqCtrl, DemEnableConditionRef=V, DemEnableConditionRef=V, DemEnableConditionRef=VCU_MCURequestedState, DemEnableConditionRef=When, DemEnableConditionRef=abnormal, DemEnableConditionRef=active, DemEnableConditionRef=after, DemEnableConditionRef=again, DemEnableConditionRef=all, DemEnableConditionRef=any, DemEnableConditionRef=battery, DemEnableConditionRef=be, DemEnableConditionRef=being, DemEnableConditionRef=completed, DemEnableConditionRef=conditions, DemEnableConditionRef=conditions, DemEnableConditionRef=conditions, DemEnableConditionRef=confirmation, DemEnableConditionRef=diagnosis, DemEnableConditionRef=diagnosis, DemEnableConditionRef=during, DemEnableConditionRef=enable, DemEnableConditionRef=fault, DemEnableConditionRef=fault, DemEnableConditionRef=fault, DemEnableConditionRef=for, DemEnableConditionRef=from, DemEnableConditionRef=is, DemEnableConditionRef=is, DemEnableConditionRef=is, DemEnableConditionRef=met, DemEnableConditionRef=met, DemEnableConditionRef=ms, DemEnableConditionRef=ms, DemEnableConditionRef=normal, DemEnableConditionRef=not, DemEnableConditionRef=of, DemEnableConditionRef=or, DemEnableConditionRef=or, DemEnableConditionRef=performed, DemEnableConditionRef=recovers, DemEnableConditionRef=service, DemEnableConditionRef=shall, DemEnableConditionRef=the_001, DemEnableConditionRef=the_001, DemEnableConditionRef=the_001, DemEnableConditionRef=the_001, DemEnableConditionRef=the_001, DemEnableConditionRef=the_001, DemEnableConditionRef=to, DemEnableConditionRef=trigger, DemEnableConditionRef=up, DemEnableConditionRef=voltage, DemEnableConditionRef=voltage, DemEnableConditionRef=waked, DemEnableConditionRef=x1
        EnableConditionGroup_f26910b9: DemEnableConditionRef=AC, DemEnableConditionRef=AC, DemEnableConditionRef=Close, DemEnableConditionRef=No, DemEnableConditionRef=Note, DemEnableConditionRef=Ohm, DemEnableConditionRef=Ohm, DemEnableConditionRef=Ohm, DemEnableConditionRef=Ohm, DemEnableConditionRef=Ohm, DemEnableConditionRef=Ohm, DemEnableConditionRef=Ohm, DemEnableConditionRef=Ohm, DemEnableConditionRef=On, DemEnableConditionRef=POD_OBC_CCStatus, DemEnableConditionRef=POD_OBC_CCStatus, DemEnableConditionRef=POD_OBC_VCU_S2_State, DemEnableConditionRef=S2, DemEnableConditionRef=The, DemEnableConditionRef=V, DemEnableConditionRef=V, DemEnableConditionRef=When, DemEnableConditionRef=abnormal, DemEnableConditionRef=active, DemEnableConditionRef=active, DemEnableConditionRef=again, DemEnableConditionRef=all, DemEnableConditionRef=any, DemEnableConditionRef=battery, DemEnableConditionRef=be, DemEnableConditionRef=charging, DemEnableConditionRef=closed, DemEnableConditionRef=completed, DemEnableConditionRef=conditions, DemEnableConditionRef=conditions, DemEnableConditionRef=conditions, DemEnableConditionRef=confirmation, DemEnableConditionRef=diagnosis, DemEnableConditionRef=diagnosis, DemEnableConditionRef=during, DemEnableConditionRef=enable, DemEnableConditionRef=fault, DemEnableConditionRef=fault, DemEnableConditionRef=fault, DemEnableConditionRef=for, DemEnableConditionRef=from, DemEnableConditionRef=guns, DemEnableConditionRef=is, DemEnableConditionRef=is, DemEnableConditionRef=is, DemEnableConditionRef=is, DemEnableConditionRef=is, DemEnableConditionRef=met, DemEnableConditionRef=met, DemEnableConditionRef=ms, DemEnableConditionRef=normal, DemEnableConditionRef=not, DemEnableConditionRef=of, DemEnableConditionRef=or, DemEnableConditionRef=or, DemEnableConditionRef=performed, DemEnableConditionRef=recovers, DemEnableConditionRef=service, DemEnableConditionRef=shall, DemEnableConditionRef=status, DemEnableConditionRef=switch, DemEnableConditionRef=the_001, DemEnableConditionRef=the_001, DemEnableConditionRef=the_001, DemEnableConditionRef=the_001, DemEnableConditionRef=the_001, DemEnableConditionRef=the_001, DemEnableConditionRef=the_001, DemEnableConditionRef=to, DemEnableConditionRef=trigger, DemEnableConditionRef=voltage, DemEnableConditionRef=voltage, DemEnableConditionRef=x1, DemEnableConditionRef=x2, DemEnableConditionRef=x2, DemEnableConditionRef=x3, DemEnableConditionRef=x3, DemEnableConditionRef=x4, DemEnableConditionRef=x4, DemEnableConditionRef=x5, DemEnableConditionRef=x5
        EnableConditionGroup_54eb9fcb: DemEnableConditionRef=MCU_VCUWorkMode, DemEnableConditionRef=No, DemEnableConditionRef=Note, DemEnableConditionRef=Ready, DemEnableConditionRef=Standby, DemEnableConditionRef=The, DemEnableConditionRef=V, DemEnableConditionRef=V, DemEnableConditionRef=VCU_MCURequestedState, DemEnableConditionRef=When, DemEnableConditionRef=abnormal, DemEnableConditionRef=active, DemEnableConditionRef=after, DemEnableConditionRef=again, DemEnableConditionRef=all, DemEnableConditionRef=any, DemEnableConditionRef=battery, DemEnableConditionRef=be, DemEnableConditionRef=being, DemEnableConditionRef=completed, DemEnableConditionRef=conditions, DemEnableConditionRef=conditions, DemEnableConditionRef=conditions, DemEnableConditionRef=confirmation, DemEnableConditionRef=diagnosis, DemEnableConditionRef=diagnosis, DemEnableConditionRef=during, DemEnableConditionRef=enable, DemEnableConditionRef=fault, DemEnableConditionRef=fault, DemEnableConditionRef=fault, DemEnableConditionRef=for, DemEnableConditionRef=from, DemEnableConditionRef=is, DemEnableConditionRef=is, DemEnableConditionRef=is, DemEnableConditionRef=met, DemEnableConditionRef=met, DemEnableConditionRef=ms, DemEnableConditionRef=ms, DemEnableConditionRef=normal, DemEnableConditionRef=not, DemEnableConditionRef=of, DemEnableConditionRef=or, DemEnableConditionRef=or, DemEnableConditionRef=performed, DemEnableConditionRef=recovers, DemEnableConditionRef=service, DemEnableConditionRef=shall, DemEnableConditionRef=the_001, DemEnableConditionRef=the_001, DemEnableConditionRef=the_001, DemEnableConditionRef=the_001, DemEnableConditionRef=the_001, DemEnableConditionRef=the_001, DemEnableConditionRef=to, DemEnableConditionRef=trigger, DemEnableConditionRef=up, DemEnableConditionRef=voltage, DemEnableConditionRef=voltage, DemEnableConditionRef=waked, DemEnableConditionRef=x0, DemEnableConditionRef=x1
        EnableConditionGroup_4392d02e: DemEnableConditionRef=Control, DemEnableConditionRef=MCU_VCUWorkMode, DemEnableConditionRef=No, DemEnableConditionRef=Note, DemEnableConditionRef=Ready, DemEnableConditionRef=The, DemEnableConditionRef=Torque, DemEnableConditionRef=V, DemEnableConditionRef=V, DemEnableConditionRef=VCU_MCURequestedState, DemEnableConditionRef=When, DemEnableConditionRef=abnormal, DemEnableConditionRef=active, DemEnableConditionRef=after, DemEnableConditionRef=again, DemEnableConditionRef=all, DemEnableConditionRef=any, DemEnableConditionRef=battery, DemEnableConditionRef=be, DemEnableConditionRef=being, DemEnableConditionRef=completed, DemEnableConditionRef=conditions, DemEnableConditionRef=conditions, DemEnableConditionRef=conditions, DemEnableConditionRef=confirmation, DemEnableConditionRef=diagnosis, DemEnableConditionRef=diagnosis, DemEnableConditionRef=during, DemEnableConditionRef=enable, DemEnableConditionRef=fault, DemEnableConditionRef=fault, DemEnableConditionRef=fault, DemEnableConditionRef=for, DemEnableConditionRef=from, DemEnableConditionRef=is, DemEnableConditionRef=is, DemEnableConditionRef=is, DemEnableConditionRef=met, DemEnableConditionRef=met, DemEnableConditionRef=ms, DemEnableConditionRef=ms, DemEnableConditionRef=normal, DemEnableConditionRef=not, DemEnableConditionRef=of, DemEnableConditionRef=or, DemEnableConditionRef=or, DemEnableConditionRef=performed, DemEnableConditionRef=recovers, DemEnableConditionRef=service, DemEnableConditionRef=shall, DemEnableConditionRef=the_001, DemEnableConditionRef=the_001, DemEnableConditionRef=the_001, DemEnableConditionRef=the_001, DemEnableConditionRef=the_001, DemEnableConditionRef=the_001, DemEnableConditionRef=to, DemEnableConditionRef=trigger, DemEnableConditionRef=up, DemEnableConditionRef=voltage, DemEnableConditionRef=voltage, DemEnableConditionRef=waked, DemEnableConditionRef=x0, DemEnableConditionRef=x3
        EnableConditionGroup_71a7c053: DemEnableConditionRef=All_001, DemEnableConditionRef=Busoff, DemEnableConditionRef=Conditions_001, DemEnableConditionRef=Conditions_001, DemEnableConditionRef=Confirmed, DemEnableConditionRef=Confirmed, DemEnableConditionRef=DTC, DemEnableConditionRef=DTC, DemEnableConditionRef=Enable_001, DemEnableConditionRef=Enable_001, DemEnableConditionRef=In_001, DemEnableConditionRef=Lan, DemEnableConditionRef=No, DemEnableConditionRef=No, DemEnableConditionRef=Note, DemEnableConditionRef=PNC0, DemEnableConditionRef=PNC03, DemEnableConditionRef=PNC04, DemEnableConditionRef=PNC13, DemEnableConditionRef=PNC14, DemEnableConditionRef=PNC15, DemEnableConditionRef=PNC15, DemEnableConditionRef=PNC16, DemEnableConditionRef=PNC18, DemEnableConditionRef=Reset_001, DemEnableConditionRef=T_Delay, DemEnableConditionRef=T_Delay, DemEnableConditionRef=T_Delay, DemEnableConditionRef=The, DemEnableConditionRef=The, DemEnableConditionRef=V, DemEnableConditionRef=V, DemEnableConditionRef=abnormal, DemEnableConditionRef=active, DemEnableConditionRef=again, DemEnableConditionRef=again, DemEnableConditionRef=and, DemEnableConditionRef=and, DemEnableConditionRef=and, DemEnableConditionRef=any, DemEnableConditionRef=any, DemEnableConditionRef=battery, DemEnableConditionRef=condition, DemEnableConditionRef=conditions, DemEnableConditionRef=criteria, DemEnableConditionRef=criteria, DemEnableConditionRef=do, DemEnableConditionRef=does, DemEnableConditionRef=fault, DemEnableConditionRef=following, DemEnableConditionRef=for, DemEnableConditionRef=from, DemEnableConditionRef=if_001, DemEnableConditionRef=in, DemEnableConditionRef=in, DemEnableConditionRef=is, DemEnableConditionRef=is, DemEnableConditionRef=last, DemEnableConditionRef=meet, DemEnableConditionRef=meet, DemEnableConditionRef=met, DemEnableConditionRef=ms, DemEnableConditionRef=normal, DemEnableConditionRef=not, DemEnableConditionRef=not, DemEnableConditionRef=of, DemEnableConditionRef=of, DemEnableConditionRef=or, DemEnableConditionRef=or, DemEnableConditionRef=recovered, DemEnableConditionRef=recovers, DemEnableConditionRef=requirements, DemEnableConditionRef=requirements, DemEnableConditionRef=reset, DemEnableConditionRef=service, DemEnableConditionRef=simultaneously, DemEnableConditionRef=start, DemEnableConditionRef=start, DemEnableConditionRef=status, DemEnableConditionRef=the_001, DemEnableConditionRef=the_001, DemEnableConditionRef=the_001, DemEnableConditionRef=the_001, DemEnableConditionRef=the_001, DemEnableConditionRef=the_001, DemEnableConditionRef=the_001, DemEnableConditionRef=the_001, DemEnableConditionRef=timer, DemEnableConditionRef=timing, DemEnableConditionRef=timing, DemEnableConditionRef=to, DemEnableConditionRef=to, DemEnableConditionRef=to, DemEnableConditionRef=voltage, DemEnableConditionRef=voltage
        EnableConditionGroup_b2fa4a09: DemEnableConditionRef=KL15eWakeUp, DemEnableConditionRef=No, DemEnableConditionRef=Note, DemEnableConditionRef=ON_001, DemEnableConditionRef=The, DemEnableConditionRef=V, DemEnableConditionRef=V, DemEnableConditionRef=When, DemEnableConditionRef=abnormal, DemEnableConditionRef=active, DemEnableConditionRef=after, DemEnableConditionRef=again, DemEnableConditionRef=all, DemEnableConditionRef=any, DemEnableConditionRef=battery, DemEnableConditionRef=be, DemEnableConditionRef=being, DemEnableConditionRef=completed, DemEnableConditionRef=conditions, DemEnableConditionRef=conditions, DemEnableConditionRef=conditions, DemEnableConditionRef=confirmation, DemEnableConditionRef=diagnosis, DemEnableConditionRef=diagnosis, DemEnableConditionRef=during, DemEnableConditionRef=enable, DemEnableConditionRef=fault, DemEnableConditionRef=fault, DemEnableConditionRef=fault, DemEnableConditionRef=for, DemEnableConditionRef=from, DemEnableConditionRef=is, DemEnableConditionRef=is, DemEnableConditionRef=is, DemEnableConditionRef=met, DemEnableConditionRef=met, DemEnableConditionRef=ms, DemEnableConditionRef=ms, DemEnableConditionRef=normal, DemEnableConditionRef=not, DemEnableConditionRef=of, DemEnableConditionRef=or, DemEnableConditionRef=or, DemEnableConditionRef=performed, DemEnableConditionRef=recovers, DemEnableConditionRef=service, DemEnableConditionRef=shall, DemEnableConditionRef=the_001, DemEnableConditionRef=the_001, DemEnableConditionRef=the_001, DemEnableConditionRef=the_001, DemEnableConditionRef=the_001, DemEnableConditionRef=the_001, DemEnableConditionRef=to, DemEnableConditionRef=trigger, DemEnableConditionRef=up, DemEnableConditionRef=voltage, DemEnableConditionRef=voltage, DemEnableConditionRef=waked
        EnableConditionGroup_fd6c7f9e: DemEnableConditionRef=InActive, DemEnableConditionRef=No, DemEnableConditionRef=Note, DemEnableConditionRef=The, DemEnableConditionRef=V, DemEnableConditionRef=V, DemEnableConditionRef=VCU_RequestedModeBMS, DemEnableConditionRef=When, DemEnableConditionRef=abnormal, DemEnableConditionRef=active, DemEnableConditionRef=after, DemEnableConditionRef=again, DemEnableConditionRef=all, DemEnableConditionRef=any, DemEnableConditionRef=battery, DemEnableConditionRef=be, DemEnableConditionRef=being, DemEnableConditionRef=completed, DemEnableConditionRef=conditions, DemEnableConditionRef=conditions, DemEnableConditionRef=conditions, DemEnableConditionRef=confirmation, DemEnableConditionRef=diagnosis, DemEnableConditionRef=diagnosis, DemEnableConditionRef=during, DemEnableConditionRef=enable, DemEnableConditionRef=fault, DemEnableConditionRef=fault, DemEnableConditionRef=fault, DemEnableConditionRef=for, DemEnableConditionRef=from, DemEnableConditionRef=is, DemEnableConditionRef=is, DemEnableConditionRef=is, DemEnableConditionRef=met, DemEnableConditionRef=met, DemEnableConditionRef=ms, DemEnableConditionRef=ms, DemEnableConditionRef=normal, DemEnableConditionRef=not, DemEnableConditionRef=of, DemEnableConditionRef=or, DemEnableConditionRef=or, DemEnableConditionRef=performed, DemEnableConditionRef=recovers, DemEnableConditionRef=service, DemEnableConditionRef=shall, DemEnableConditionRef=the_001, DemEnableConditionRef=the_001, DemEnableConditionRef=the_001, DemEnableConditionRef=the_001, DemEnableConditionRef=the_001, DemEnableConditionRef=the_001, DemEnableConditionRef=to, DemEnableConditionRef=trigger, DemEnableConditionRef=up, DemEnableConditionRef=voltage, DemEnableConditionRef=voltage, DemEnableConditionRef=waked, DemEnableConditionRef=x0
        EnableConditionGroup_9200803a: DemEnableConditionRef=AC, DemEnableConditionRef=BMS_ChargeStatus, DemEnableConditionRef=Charging_001, DemEnableConditionRef=Enable_001, DemEnableConditionRef=Enable_001, DemEnableConditionRef=Heat, DemEnableConditionRef=No, DemEnableConditionRef=Note, DemEnableConditionRef=OBC, DemEnableConditionRef=Ohm, DemEnableConditionRef=Ohm, DemEnableConditionRef=Ohm, DemEnableConditionRef=Ohm, DemEnableConditionRef=POD_OBC_CCStatus, DemEnableConditionRef=The, DemEnableConditionRef=V, DemEnableConditionRef=V, DemEnableConditionRef=VCU, DemEnableConditionRef=VCU_EnableOBC, DemEnableConditionRef=When, DemEnableConditionRef=abnormal, DemEnableConditionRef=active, DemEnableConditionRef=active, DemEnableConditionRef=again, DemEnableConditionRef=all, DemEnableConditionRef=any, DemEnableConditionRef=battery, DemEnableConditionRef=be, DemEnableConditionRef=charge, DemEnableConditionRef=completed, DemEnableConditionRef=conditions, DemEnableConditionRef=conditions, DemEnableConditionRef=conditions, DemEnableConditionRef=confirmation, DemEnableConditionRef=diagnosis, DemEnableConditionRef=diagnosis, DemEnableConditionRef=during, DemEnableConditionRef=enable, DemEnableConditionRef=fault, DemEnableConditionRef=fault, DemEnableConditionRef=fault, DemEnableConditionRef=for, DemEnableConditionRef=from, DemEnableConditionRef=function, DemEnableConditionRef=guns, DemEnableConditionRef=is, DemEnableConditionRef=is, DemEnableConditionRef=is, DemEnableConditionRef=is, DemEnableConditionRef=met, DemEnableConditionRef=met, DemEnableConditionRef=ms, DemEnableConditionRef=normal, DemEnableConditionRef=not, DemEnableConditionRef=of, DemEnableConditionRef=only, DemEnableConditionRef=or, DemEnableConditionRef=or, DemEnableConditionRef=performed, DemEnableConditionRef=preheating, DemEnableConditionRef=recovers, DemEnableConditionRef=requests, DemEnableConditionRef=service, DemEnableConditionRef=shall, DemEnableConditionRef=status, DemEnableConditionRef=the_001, DemEnableConditionRef=the_001, DemEnableConditionRef=the_001, DemEnableConditionRef=the_001, DemEnableConditionRef=the_001, DemEnableConditionRef=the_001, DemEnableConditionRef=the_001, DemEnableConditionRef=the_001, DemEnableConditionRef=to, DemEnableConditionRef=to, DemEnableConditionRef=trigger, DemEnableConditionRef=voltage, DemEnableConditionRef=voltage, DemEnableConditionRef=x1, DemEnableConditionRef=x2, DemEnableConditionRef=x2, DemEnableConditionRef=x3, DemEnableConditionRef=x4, DemEnableConditionRef=x5
        EnableConditionGroup_b2ccc4ca: DemEnableConditionRef=AC, DemEnableConditionRef=BMS, DemEnableConditionRef=Close, DemEnableConditionRef=Close, DemEnableConditionRef=DC, DemEnableConditionRef=Detected, DemEnableConditionRef=Detected, DemEnableConditionRef=No, DemEnableConditionRef=Note, DemEnableConditionRef=Plug, DemEnableConditionRef=Plug, DemEnableConditionRef=The, DemEnableConditionRef=V, DemEnableConditionRef=V, DemEnableConditionRef=VCU, DemEnableConditionRef=VCU_BMS_Control_of_NegRelay, DemEnableConditionRef=VCU_ChargeStatus, DemEnableConditionRef=When, DemEnableConditionRef=abnormal, DemEnableConditionRef=active, DemEnableConditionRef=again, DemEnableConditionRef=all, DemEnableConditionRef=any, DemEnableConditionRef=battery, DemEnableConditionRef=be, DemEnableConditionRef=completed, DemEnableConditionRef=conditions, DemEnableConditionRef=conditions, DemEnableConditionRef=conditions, DemEnableConditionRef=confirmation, DemEnableConditionRef=diagnosis, DemEnableConditionRef=diagnosis, DemEnableConditionRef=during, DemEnableConditionRef=enable, DemEnableConditionRef=fault, DemEnableConditionRef=fault, DemEnableConditionRef=fault, DemEnableConditionRef=for, DemEnableConditionRef=from, DemEnableConditionRef=is, DemEnableConditionRef=is, DemEnableConditionRef=is, DemEnableConditionRef=main, DemEnableConditionRef=met, DemEnableConditionRef=met, DemEnableConditionRef=ms, DemEnableConditionRef=normal, DemEnableConditionRef=not, DemEnableConditionRef=of, DemEnableConditionRef=or, DemEnableConditionRef=or, DemEnableConditionRef=performed, DemEnableConditionRef=positive, DemEnableConditionRef=recovers, DemEnableConditionRef=relay, DemEnableConditionRef=requests, DemEnableConditionRef=service, DemEnableConditionRef=shall, DemEnableConditionRef=the_001, DemEnableConditionRef=the_001, DemEnableConditionRef=the_001, DemEnableConditionRef=the_001, DemEnableConditionRef=the_001, DemEnableConditionRef=the_001, DemEnableConditionRef=the_001, DemEnableConditionRef=the_001, DemEnableConditionRef=to, DemEnableConditionRef=to, DemEnableConditionRef=trigger, DemEnableConditionRef=voltage, DemEnableConditionRef=voltage, DemEnableConditionRef=x2, DemEnableConditionRef=x2, DemEnableConditionRef=x3
        EnableConditionGroup_c8259b58: DemEnableConditionRef=AC, DemEnableConditionRef=Close, DemEnableConditionRef=No, DemEnableConditionRef=Note, DemEnableConditionRef=OBC, DemEnableConditionRef=Ohm, DemEnableConditionRef=Ohm, DemEnableConditionRef=Ohm, DemEnableConditionRef=Ohm, DemEnableConditionRef=Open, DemEnableConditionRef=POD_OBC_CCStatus, DemEnableConditionRef=The, DemEnableConditionRef=V, DemEnableConditionRef=V, DemEnableConditionRef=VCU, DemEnableConditionRef=VCU_OBC_Control_of_em_lock, DemEnableConditionRef=When, DemEnableConditionRef=abnormal, DemEnableConditionRef=active, DemEnableConditionRef=active, DemEnableConditionRef=again, DemEnableConditionRef=all, DemEnableConditionRef=any, DemEnableConditionRef=battery, DemEnableConditionRef=be, DemEnableConditionRef=completed, DemEnableConditionRef=conditions, DemEnableConditionRef=conditions, DemEnableConditionRef=conditions, DemEnableConditionRef=confirmation, DemEnableConditionRef=diagnosis, DemEnableConditionRef=diagnosis, DemEnableConditionRef=during, DemEnableConditionRef=electronic, DemEnableConditionRef=enable, DemEnableConditionRef=fault, DemEnableConditionRef=fault, DemEnableConditionRef=fault, DemEnableConditionRef=for, DemEnableConditionRef=from, DemEnableConditionRef=guns, DemEnableConditionRef=is, DemEnableConditionRef=is, DemEnableConditionRef=is, DemEnableConditionRef=is, DemEnableConditionRef=lock, DemEnableConditionRef=met, DemEnableConditionRef=met, DemEnableConditionRef=ms, DemEnableConditionRef=normal, DemEnableConditionRef=not, DemEnableConditionRef=of, DemEnableConditionRef=or, DemEnableConditionRef=or, DemEnableConditionRef=performed, DemEnableConditionRef=recovers, DemEnableConditionRef=requests, DemEnableConditionRef=service, DemEnableConditionRef=shall, DemEnableConditionRef=the_001, DemEnableConditionRef=the_001, DemEnableConditionRef=the_001, DemEnableConditionRef=the_001, DemEnableConditionRef=the_001, DemEnableConditionRef=the_001, DemEnableConditionRef=the_001, DemEnableConditionRef=to, DemEnableConditionRef=to, DemEnableConditionRef=trigger, DemEnableConditionRef=voltage, DemEnableConditionRef=voltage, DemEnableConditionRef=x0, DemEnableConditionRef=x2, DemEnableConditionRef=x3, DemEnableConditionRef=x4, DemEnableConditionRef=x5
        EnableConditionGroup_b80d94d2: DemEnableConditionRef=Init, DemEnableConditionRef=No, DemEnableConditionRef=Note, DemEnableConditionRef=The, DemEnableConditionRef=V, DemEnableConditionRef=V, DemEnableConditionRef=VCU_Hvstatus_001, DemEnableConditionRef=When, DemEnableConditionRef=abnormal, DemEnableConditionRef=active, DemEnableConditionRef=after, DemEnableConditionRef=again, DemEnableConditionRef=all, DemEnableConditionRef=any, DemEnableConditionRef=battery, DemEnableConditionRef=be, DemEnableConditionRef=being, DemEnableConditionRef=completed, DemEnableConditionRef=conditions, DemEnableConditionRef=conditions, DemEnableConditionRef=conditions, DemEnableConditionRef=confirmation, DemEnableConditionRef=diagnosis, DemEnableConditionRef=diagnosis, DemEnableConditionRef=during, DemEnableConditionRef=enable, DemEnableConditionRef=fault, DemEnableConditionRef=fault, DemEnableConditionRef=fault, DemEnableConditionRef=for, DemEnableConditionRef=from, DemEnableConditionRef=is, DemEnableConditionRef=is, DemEnableConditionRef=is, DemEnableConditionRef=met, DemEnableConditionRef=met, DemEnableConditionRef=ms, DemEnableConditionRef=ms, DemEnableConditionRef=normal, DemEnableConditionRef=not, DemEnableConditionRef=of, DemEnableConditionRef=or, DemEnableConditionRef=or, DemEnableConditionRef=performed, DemEnableConditionRef=recovers, DemEnableConditionRef=service, DemEnableConditionRef=shall, DemEnableConditionRef=the_001, DemEnableConditionRef=the_001, DemEnableConditionRef=the_001, DemEnableConditionRef=the_001, DemEnableConditionRef=the_001, DemEnableConditionRef=the_001, DemEnableConditionRef=to, DemEnableConditionRef=trigger, DemEnableConditionRef=up, DemEnableConditionRef=voltage, DemEnableConditionRef=voltage, DemEnableConditionRef=waked, DemEnableConditionRef=x1
        EnableConditionGroup_9ac8c945: DemEnableConditionRef=All_001, DemEnableConditionRef=Busoff, DemEnableConditionRef=Conditions_001, DemEnableConditionRef=Conditions_001, DemEnableConditionRef=Confirmed, DemEnableConditionRef=Confirmed, DemEnableConditionRef=DTC, DemEnableConditionRef=DTC, DemEnableConditionRef=Enable_001, DemEnableConditionRef=Enable_001, DemEnableConditionRef=In_001, DemEnableConditionRef=Lan, DemEnableConditionRef=No, DemEnableConditionRef=No, DemEnableConditionRef=Note, DemEnableConditionRef=PNC0, DemEnableConditionRef=Reset_001, DemEnableConditionRef=T_Delay, DemEnableConditionRef=T_Delay, DemEnableConditionRef=T_Delay, DemEnableConditionRef=The, DemEnableConditionRef=The, DemEnableConditionRef=V, DemEnableConditionRef=V, DemEnableConditionRef=abnormal, DemEnableConditionRef=active, DemEnableConditionRef=again, DemEnableConditionRef=again, DemEnableConditionRef=and, DemEnableConditionRef=and, DemEnableConditionRef=and, DemEnableConditionRef=any, DemEnableConditionRef=any, DemEnableConditionRef=battery, DemEnableConditionRef=condition, DemEnableConditionRef=conditions, DemEnableConditionRef=criteria, DemEnableConditionRef=criteria, DemEnableConditionRef=do, DemEnableConditionRef=does, DemEnableConditionRef=fault, DemEnableConditionRef=following, DemEnableConditionRef=for, DemEnableConditionRef=from, DemEnableConditionRef=if_001, DemEnableConditionRef=in, DemEnableConditionRef=in, DemEnableConditionRef=is, DemEnableConditionRef=is, DemEnableConditionRef=last, DemEnableConditionRef=meet, DemEnableConditionRef=meet, DemEnableConditionRef=met, DemEnableConditionRef=ms, DemEnableConditionRef=normal, DemEnableConditionRef=not, DemEnableConditionRef=not, DemEnableConditionRef=of, DemEnableConditionRef=of, DemEnableConditionRef=or, DemEnableConditionRef=or, DemEnableConditionRef=recovered, DemEnableConditionRef=recovers, DemEnableConditionRef=requirements, DemEnableConditionRef=requirements, DemEnableConditionRef=reset, DemEnableConditionRef=service, DemEnableConditionRef=simultaneously, DemEnableConditionRef=start, DemEnableConditionRef=start, DemEnableConditionRef=status, DemEnableConditionRef=the_001, DemEnableConditionRef=the_001, DemEnableConditionRef=the_001, DemEnableConditionRef=the_001, DemEnableConditionRef=the_001, DemEnableConditionRef=the_001, DemEnableConditionRef=the_001, DemEnableConditionRef=the_001, DemEnableConditionRef=timer, DemEnableConditionRef=timing, DemEnableConditionRef=timing, DemEnableConditionRef=to, DemEnableConditionRef=to, DemEnableConditionRef=to, DemEnableConditionRef=voltage, DemEnableConditionRef=voltage
        EnableConditionGroup_d73be567: DemEnableConditionRef=All_001, DemEnableConditionRef=Busoff, DemEnableConditionRef=Conditions_001, DemEnableConditionRef=Conditions_001, DemEnableConditionRef=Confirmed, DemEnableConditionRef=Confirmed, DemEnableConditionRef=DTC, DemEnableConditionRef=DTC, DemEnableConditionRef=Enable_001, DemEnableConditionRef=Enable_001, DemEnableConditionRef=In_001, DemEnableConditionRef=LAN_001, DemEnableConditionRef=No, DemEnableConditionRef=No, DemEnableConditionRef=Note, DemEnableConditionRef=PNC0, DemEnableConditionRef=Reset_001, DemEnableConditionRef=T_Delay, DemEnableConditionRef=T_Delay, DemEnableConditionRef=T_Delay, DemEnableConditionRef=The, DemEnableConditionRef=The, DemEnableConditionRef=V, DemEnableConditionRef=V, DemEnableConditionRef=abnormal, DemEnableConditionRef=active, DemEnableConditionRef=again, DemEnableConditionRef=again, DemEnableConditionRef=and, DemEnableConditionRef=and, DemEnableConditionRef=and, DemEnableConditionRef=any, DemEnableConditionRef=any, DemEnableConditionRef=battery, DemEnableConditionRef=condition, DemEnableConditionRef=conditions, DemEnableConditionRef=criteria, DemEnableConditionRef=criteria, DemEnableConditionRef=do, DemEnableConditionRef=does, DemEnableConditionRef=fault, DemEnableConditionRef=following, DemEnableConditionRef=for, DemEnableConditionRef=from, DemEnableConditionRef=if_001, DemEnableConditionRef=in, DemEnableConditionRef=in, DemEnableConditionRef=is, DemEnableConditionRef=is, DemEnableConditionRef=last, DemEnableConditionRef=meet, DemEnableConditionRef=meet, DemEnableConditionRef=met, DemEnableConditionRef=ms, DemEnableConditionRef=normal, DemEnableConditionRef=not, DemEnableConditionRef=not, DemEnableConditionRef=of, DemEnableConditionRef=of, DemEnableConditionRef=or, DemEnableConditionRef=or, DemEnableConditionRef=recovered, DemEnableConditionRef=recovers, DemEnableConditionRef=requirements, DemEnableConditionRef=requirements, DemEnableConditionRef=reset, DemEnableConditionRef=service, DemEnableConditionRef=simultaneously, DemEnableConditionRef=start, DemEnableConditionRef=start, DemEnableConditionRef=status, DemEnableConditionRef=the_001, DemEnableConditionRef=the_001, DemEnableConditionRef=the_001, DemEnableConditionRef=the_001, DemEnableConditionRef=the_001, DemEnableConditionRef=the_001, DemEnableConditionRef=the_001, DemEnableConditionRef=the_001, DemEnableConditionRef=timer, DemEnableConditionRef=timing, DemEnableConditionRef=timing, DemEnableConditionRef=to, DemEnableConditionRef=to, DemEnableConditionRef=to, DemEnableConditionRef=voltage, DemEnableConditionRef=voltage
        EnableConditionGroup_5ad0cd2d: DemEnableConditionRef=All_001, DemEnableConditionRef=Busoff, DemEnableConditionRef=Conditions_001, DemEnableConditionRef=Conditions_001, DemEnableConditionRef=Confirmed, DemEnableConditionRef=Confirmed, DemEnableConditionRef=DTC, DemEnableConditionRef=DTC, DemEnableConditionRef=Enable_001, DemEnableConditionRef=Enable_001, DemEnableConditionRef=In_001, DemEnableConditionRef=Lan, DemEnableConditionRef=No, DemEnableConditionRef=No, DemEnableConditionRef=Note, DemEnableConditionRef=PNC0, DemEnableConditionRef=PNC15, DemEnableConditionRef=PNC25, DemEnableConditionRef=Reset_001, DemEnableConditionRef=T_Delay, DemEnableConditionRef=T_Delay, DemEnableConditionRef=T_Delay, DemEnableConditionRef=The, DemEnableConditionRef=The, DemEnableConditionRef=V, DemEnableConditionRef=V, DemEnableConditionRef=abnormal, DemEnableConditionRef=active, DemEnableConditionRef=again, DemEnableConditionRef=again, DemEnableConditionRef=and, DemEnableConditionRef=and, DemEnableConditionRef=and, DemEnableConditionRef=any, DemEnableConditionRef=any, DemEnableConditionRef=battery, DemEnableConditionRef=condition, DemEnableConditionRef=conditions, DemEnableConditionRef=criteria, DemEnableConditionRef=criteria, DemEnableConditionRef=do, DemEnableConditionRef=does, DemEnableConditionRef=fault, DemEnableConditionRef=following, DemEnableConditionRef=for, DemEnableConditionRef=from, DemEnableConditionRef=if_001, DemEnableConditionRef=in, DemEnableConditionRef=in, DemEnableConditionRef=is, DemEnableConditionRef=is, DemEnableConditionRef=last, DemEnableConditionRef=meet, DemEnableConditionRef=meet, DemEnableConditionRef=met, DemEnableConditionRef=ms, DemEnableConditionRef=normal, DemEnableConditionRef=not, DemEnableConditionRef=not, DemEnableConditionRef=of, DemEnableConditionRef=of, DemEnableConditionRef=or, DemEnableConditionRef=or, DemEnableConditionRef=recovered, DemEnableConditionRef=recovers, DemEnableConditionRef=requirements, DemEnableConditionRef=requirements, DemEnableConditionRef=reset, DemEnableConditionRef=service, DemEnableConditionRef=simultaneously, DemEnableConditionRef=start, DemEnableConditionRef=start, DemEnableConditionRef=status, DemEnableConditionRef=the_001, DemEnableConditionRef=the_001, DemEnableConditionRef=the_001, DemEnableConditionRef=the_001, DemEnableConditionRef=the_001, DemEnableConditionRef=the_001, DemEnableConditionRef=the_001, DemEnableConditionRef=the_001, DemEnableConditionRef=timer, DemEnableConditionRef=timing, DemEnableConditionRef=timing, DemEnableConditionRef=to, DemEnableConditionRef=to, DemEnableConditionRef=to, DemEnableConditionRef=voltage, DemEnableConditionRef=voltage
        EnableConditionGroup_d57a23d8: DemEnableConditionRef=No, DemEnableConditionRef=Note, DemEnableConditionRef=The, DemEnableConditionRef=V, DemEnableConditionRef=V, DemEnableConditionRef=When, DemEnableConditionRef=abnormal, DemEnableConditionRef=active, DemEnableConditionRef=after, DemEnableConditionRef=again, DemEnableConditionRef=all, DemEnableConditionRef=any, DemEnableConditionRef=battery, DemEnableConditionRef=be, DemEnableConditionRef=being, DemEnableConditionRef=completed, DemEnableConditionRef=conditions, DemEnableConditionRef=conditions, DemEnableConditionRef=conditions, DemEnableConditionRef=confirmation, DemEnableConditionRef=diagnosis, DemEnableConditionRef=diagnosis, DemEnableConditionRef=during, DemEnableConditionRef=enable, DemEnableConditionRef=fault, DemEnableConditionRef=fault, DemEnableConditionRef=fault, DemEnableConditionRef=for, DemEnableConditionRef=from, DemEnableConditionRef=is, DemEnableConditionRef=is, DemEnableConditionRef=is, DemEnableConditionRef=met, DemEnableConditionRef=met, DemEnableConditionRef=ms, DemEnableConditionRef=ms, DemEnableConditionRef=normal, DemEnableConditionRef=not, DemEnableConditionRef=of, DemEnableConditionRef=or, DemEnableConditionRef=or, DemEnableConditionRef=performed, DemEnableConditionRef=recovers, DemEnableConditionRef=service, DemEnableConditionRef=shall, DemEnableConditionRef=the_001, DemEnableConditionRef=the_001, DemEnableConditionRef=the_001, DemEnableConditionRef=the_001, DemEnableConditionRef=the_001, DemEnableConditionRef=the_001, DemEnableConditionRef=to, DemEnableConditionRef=trigger, DemEnableConditionRef=up, DemEnableConditionRef=voltage, DemEnableConditionRef=voltage, DemEnableConditionRef=waked
        EnableConditionGroup_c98c13ed: DemEnableConditionRef=AC, DemEnableConditionRef=BMS, DemEnableConditionRef=DC, DemEnableConditionRef=Detected, DemEnableConditionRef=Detected, DemEnableConditionRef=No, DemEnableConditionRef=Note, DemEnableConditionRef=Open, DemEnableConditionRef=Plug, DemEnableConditionRef=Plug, DemEnableConditionRef=The, DemEnableConditionRef=V, DemEnableConditionRef=V, DemEnableConditionRef=VCU, DemEnableConditionRef=VCU_BMS_Control_of_NegRelay, DemEnableConditionRef=VCU_ChargeStatus, DemEnableConditionRef=When, DemEnableConditionRef=abnormal, DemEnableConditionRef=active, DemEnableConditionRef=again, DemEnableConditionRef=all, DemEnableConditionRef=any, DemEnableConditionRef=battery, DemEnableConditionRef=be, DemEnableConditionRef=completed, DemEnableConditionRef=conditions, DemEnableConditionRef=conditions, DemEnableConditionRef=conditions, DemEnableConditionRef=confirmation, DemEnableConditionRef=diagnosis, DemEnableConditionRef=diagnosis, DemEnableConditionRef=disconnect, DemEnableConditionRef=during, DemEnableConditionRef=enable, DemEnableConditionRef=fault, DemEnableConditionRef=fault, DemEnableConditionRef=fault, DemEnableConditionRef=for, DemEnableConditionRef=from, DemEnableConditionRef=is, DemEnableConditionRef=is, DemEnableConditionRef=is, DemEnableConditionRef=main, DemEnableConditionRef=met, DemEnableConditionRef=met, DemEnableConditionRef=ms, DemEnableConditionRef=negative, DemEnableConditionRef=normal, DemEnableConditionRef=not, DemEnableConditionRef=of, DemEnableConditionRef=or, DemEnableConditionRef=or, DemEnableConditionRef=performed, DemEnableConditionRef=recovers, DemEnableConditionRef=relay, DemEnableConditionRef=requests, DemEnableConditionRef=service, DemEnableConditionRef=shall, DemEnableConditionRef=the_001, DemEnableConditionRef=the_001, DemEnableConditionRef=the_001, DemEnableConditionRef=the_001, DemEnableConditionRef=the_001, DemEnableConditionRef=the_001, DemEnableConditionRef=the_001, DemEnableConditionRef=the_001, DemEnableConditionRef=to, DemEnableConditionRef=to, DemEnableConditionRef=trigger, DemEnableConditionRef=voltage, DemEnableConditionRef=voltage, DemEnableConditionRef=x1, DemEnableConditionRef=x2, DemEnableConditionRef=x3
        EnableConditionGroup_5feb31f0: DemEnableConditionRef=Accelerator, DemEnableConditionRef=No, DemEnableConditionRef=Note, DemEnableConditionRef=The, DemEnableConditionRef=The, DemEnableConditionRef=V, DemEnableConditionRef=V, DemEnableConditionRef=V, DemEnableConditionRef=V, DemEnableConditionRef=When, DemEnableConditionRef=abnormal, DemEnableConditionRef=accelerator_001, DemEnableConditionRef=accelerator_001, DemEnableConditionRef=accelerator_001, DemEnableConditionRef=active, DemEnableConditionRef=after, DemEnableConditionRef=again, DemEnableConditionRef=all, DemEnableConditionRef=and, DemEnableConditionRef=any, DemEnableConditionRef=battery, DemEnableConditionRef=be, DemEnableConditionRef=being, DemEnableConditionRef=completed, DemEnableConditionRef=conditions, DemEnableConditionRef=conditions, DemEnableConditionRef=conditions, DemEnableConditionRef=confirmation, DemEnableConditionRef=diagnosis, DemEnableConditionRef=diagnosis, DemEnableConditionRef=during, DemEnableConditionRef=enable, DemEnableConditionRef=fault, DemEnableConditionRef=fault, DemEnableConditionRef=fault, DemEnableConditionRef=for, DemEnableConditionRef=for, DemEnableConditionRef=from, DemEnableConditionRef=is, DemEnableConditionRef=is, DemEnableConditionRef=is, DemEnableConditionRef=is, DemEnableConditionRef=is, DemEnableConditionRef=is, DemEnableConditionRef=met, DemEnableConditionRef=met, DemEnableConditionRef=ms, DemEnableConditionRef=ms, DemEnableConditionRef=normal, DemEnableConditionRef=not, DemEnableConditionRef=not, DemEnableConditionRef=of, DemEnableConditionRef=opening, DemEnableConditionRef=opening, DemEnableConditionRef=or, DemEnableConditionRef=or, DemEnableConditionRef=pedal, DemEnableConditionRef=pedal, DemEnableConditionRef=pedal, DemEnableConditionRef=pedal, DemEnableConditionRef=performed, DemEnableConditionRef=pin, DemEnableConditionRef=pin, DemEnableConditionRef=pin1, DemEnableConditionRef=pin2, DemEnableConditionRef=recovers, DemEnableConditionRef=restored, DemEnableConditionRef=restored, DemEnableConditionRef=s, DemEnableConditionRef=service, DemEnableConditionRef=shall, DemEnableConditionRef=signal, DemEnableConditionRef=signal, DemEnableConditionRef=the_001, DemEnableConditionRef=the_001, DemEnableConditionRef=the_001, DemEnableConditionRef=the_001, DemEnableConditionRef=the_001, DemEnableConditionRef=the_001, DemEnableConditionRef=the_001, DemEnableConditionRef=times, DemEnableConditionRef=to, DemEnableConditionRef=to, DemEnableConditionRef=to, DemEnableConditionRef=trigger, DemEnableConditionRef=up, DemEnableConditionRef=v_001, DemEnableConditionRef=v_001, DemEnableConditionRef=voltage, DemEnableConditionRef=voltage, DemEnableConditionRef=voltage, DemEnableConditionRef=voltage, DemEnableConditionRef=voltage, DemEnableConditionRef=voltage, DemEnableConditionRef=waked
        EnableConditionGroup_a88e97b7: DemEnableConditionRef=DemGeneral/Disable, DemEnableConditionRef=No, DemEnableConditionRef=Note, DemEnableConditionRef=The, DemEnableConditionRef=V, DemEnableConditionRef=V, DemEnableConditionRef=VCU_RequestedModeTCU, DemEnableConditionRef=When, DemEnableConditionRef=abnormal, DemEnableConditionRef=active, DemEnableConditionRef=after, DemEnableConditionRef=again, DemEnableConditionRef=all, DemEnableConditionRef=any, DemEnableConditionRef=battery, DemEnableConditionRef=be, DemEnableConditionRef=being, DemEnableConditionRef=completed, DemEnableConditionRef=conditions, DemEnableConditionRef=conditions, DemEnableConditionRef=conditions, DemEnableConditionRef=confirmation, DemEnableConditionRef=diagnosis, DemEnableConditionRef=diagnosis, DemEnableConditionRef=during, DemEnableConditionRef=enable, DemEnableConditionRef=fault, DemEnableConditionRef=fault, DemEnableConditionRef=fault, DemEnableConditionRef=for, DemEnableConditionRef=from, DemEnableConditionRef=is, DemEnableConditionRef=is, DemEnableConditionRef=is, DemEnableConditionRef=met, DemEnableConditionRef=met, DemEnableConditionRef=ms, DemEnableConditionRef=ms, DemEnableConditionRef=normal, DemEnableConditionRef=not, DemEnableConditionRef=of, DemEnableConditionRef=or, DemEnableConditionRef=or, DemEnableConditionRef=performed, DemEnableConditionRef=recovers, DemEnableConditionRef=service, DemEnableConditionRef=shall, DemEnableConditionRef=the_001, DemEnableConditionRef=the_001, DemEnableConditionRef=the_001, DemEnableConditionRef=the_001, DemEnableConditionRef=the_001, DemEnableConditionRef=the_001, DemEnableConditionRef=to, DemEnableConditionRef=trigger, DemEnableConditionRef=up, DemEnableConditionRef=voltage, DemEnableConditionRef=voltage, DemEnableConditionRef=waked, DemEnableConditionRef=x2
        EnableConditionGroup_ce1c6ac5: DemEnableConditionRef=AC, DemEnableConditionRef=BMS_ChargeStatus, DemEnableConditionRef=Enable_001, DemEnableConditionRef=Enable_001, DemEnableConditionRef=Heat, DemEnableConditionRef=No, DemEnableConditionRef=Non, DemEnableConditionRef=Note, DemEnableConditionRef=OBC, DemEnableConditionRef=Ohm, DemEnableConditionRef=Ohm, DemEnableConditionRef=Ohm, DemEnableConditionRef=Ohm, DemEnableConditionRef=POD_OBC_CCStatus, DemEnableConditionRef=The, DemEnableConditionRef=V, DemEnableConditionRef=V, DemEnableConditionRef=VCU, DemEnableConditionRef=VCU_EnableOBC, DemEnableConditionRef=When, DemEnableConditionRef=abnormal, DemEnableConditionRef=active, DemEnableConditionRef=active, DemEnableConditionRef=again, DemEnableConditionRef=all, DemEnableConditionRef=any, DemEnableConditionRef=battery, DemEnableConditionRef=be, DemEnableConditionRef=charge, DemEnableConditionRef=charging, DemEnableConditionRef=completed, DemEnableConditionRef=conditions, DemEnableConditionRef=conditions, DemEnableConditionRef=conditions, DemEnableConditionRef=confirmation, DemEnableConditionRef=diagnosis, DemEnableConditionRef=diagnosis, DemEnableConditionRef=during, DemEnableConditionRef=enable, DemEnableConditionRef=fault, DemEnableConditionRef=fault, DemEnableConditionRef=fault, DemEnableConditionRef=for, DemEnableConditionRef=from, DemEnableConditionRef=function, DemEnableConditionRef=guns, DemEnableConditionRef=is, DemEnableConditionRef=is, DemEnableConditionRef=is, DemEnableConditionRef=is, DemEnableConditionRef=met, DemEnableConditionRef=met, DemEnableConditionRef=ms, DemEnableConditionRef=normal, DemEnableConditionRef=not, DemEnableConditionRef=of, DemEnableConditionRef=only, DemEnableConditionRef=or, DemEnableConditionRef=or, DemEnableConditionRef=performed, DemEnableConditionRef=preheating, DemEnableConditionRef=recovers, DemEnableConditionRef=requests, DemEnableConditionRef=service, DemEnableConditionRef=shall, DemEnableConditionRef=status, DemEnableConditionRef=the_001, DemEnableConditionRef=the_001, DemEnableConditionRef=the_001, DemEnableConditionRef=the_001, DemEnableConditionRef=the_001, DemEnableConditionRef=the_001, DemEnableConditionRef=the_001, DemEnableConditionRef=the_001, DemEnableConditionRef=to, DemEnableConditionRef=to, DemEnableConditionRef=trigger, DemEnableConditionRef=voltage, DemEnableConditionRef=voltage, DemEnableConditionRef=x1, DemEnableConditionRef=x2, DemEnableConditionRef=x2, DemEnableConditionRef=x3, DemEnableConditionRef=x4, DemEnableConditionRef=x5
        EnableConditionGroup_36bf5180: DemEnableConditionRef=BMS, DemEnableConditionRef=BMS_status, DemEnableConditionRef=BRM, DemEnableConditionRef=DemGeneral/Chargestatus, DemEnableConditionRef=DC, DemEnableConditionRef=DC, DemEnableConditionRef=DC, DemEnableConditionRef=DC, DemEnableConditionRef=Detected, DemEnableConditionRef=High, DemEnableConditionRef=No, DemEnableConditionRef=Note, DemEnableConditionRef=On, DemEnableConditionRef=Plug, DemEnableConditionRef=Plug, DemEnableConditionRef=Power, DemEnableConditionRef=The, DemEnableConditionRef=V, DemEnableConditionRef=V, DemEnableConditionRef=VCU, DemEnableConditionRef=VCU, DemEnableConditionRef=When, DemEnableConditionRef=abnormal, DemEnableConditionRef=active, DemEnableConditionRef=again, DemEnableConditionRef=all, DemEnableConditionRef=any, DemEnableConditionRef=battery, DemEnableConditionRef=be, DemEnableConditionRef=charge, DemEnableConditionRef=charge, DemEnableConditionRef=completed, DemEnableConditionRef=completed, DemEnableConditionRef=conditions, DemEnableConditionRef=conditions, DemEnableConditionRef=conditions, DemEnableConditionRef=confirmation, DemEnableConditionRef=detected_001, DemEnableConditionRef=diagnosis, DemEnableConditionRef=diagnosis, DemEnableConditionRef=during, DemEnableConditionRef=enable, DemEnableConditionRef=fault, DemEnableConditionRef=fault, DemEnableConditionRef=fault, DemEnableConditionRef=for, DemEnableConditionRef=for, DemEnableConditionRef=from, DemEnableConditionRef=is, DemEnableConditionRef=is, DemEnableConditionRef=is, DemEnableConditionRef=is, DemEnableConditionRef=is, DemEnableConditionRef=message, DemEnableConditionRef=met, DemEnableConditionRef=met, DemEnableConditionRef=ms, DemEnableConditionRef=normal, DemEnableConditionRef=not, DemEnableConditionRef=of, DemEnableConditionRef=or, DemEnableConditionRef=or, DemEnableConditionRef=performed, DemEnableConditionRef=recovers, DemEnableConditionRef=sends, DemEnableConditionRef=service, DemEnableConditionRef=shall, DemEnableConditionRef=the_001, DemEnableConditionRef=the_001, DemEnableConditionRef=the_001, DemEnableConditionRef=the_001, DemEnableConditionRef=the_001, DemEnableConditionRef=the_001, DemEnableConditionRef=to, DemEnableConditionRef=trigger, DemEnableConditionRef=voltage, DemEnableConditionRef=voltage, DemEnableConditionRef=voltage, DemEnableConditionRef=x3, DemEnableConditionRef=x3
        EnableConditionGroup_fc6b8fc4: DemEnableConditionRef=HVActive, DemEnableConditionRef=No, DemEnableConditionRef=Note, DemEnableConditionRef=The, DemEnableConditionRef=V, DemEnableConditionRef=V, DemEnableConditionRef=VCU_RequestedModeBMS, DemEnableConditionRef=When, DemEnableConditionRef=abnormal, DemEnableConditionRef=active, DemEnableConditionRef=after, DemEnableConditionRef=again, DemEnableConditionRef=all, DemEnableConditionRef=any, DemEnableConditionRef=battery, DemEnableConditionRef=be, DemEnableConditionRef=being, DemEnableConditionRef=completed, DemEnableConditionRef=conditions, DemEnableConditionRef=conditions, DemEnableConditionRef=conditions, DemEnableConditionRef=confirmation, DemEnableConditionRef=diagnosis, DemEnableConditionRef=diagnosis, DemEnableConditionRef=during, DemEnableConditionRef=enable, DemEnableConditionRef=fault, DemEnableConditionRef=fault, DemEnableConditionRef=fault, DemEnableConditionRef=for, DemEnableConditionRef=from, DemEnableConditionRef=is, DemEnableConditionRef=is, DemEnableConditionRef=is, DemEnableConditionRef=met, DemEnableConditionRef=met, DemEnableConditionRef=ms, DemEnableConditionRef=ms, DemEnableConditionRef=normal, DemEnableConditionRef=not, DemEnableConditionRef=of, DemEnableConditionRef=or, DemEnableConditionRef=or, DemEnableConditionRef=performed, DemEnableConditionRef=recovers, DemEnableConditionRef=service, DemEnableConditionRef=shall, DemEnableConditionRef=the_001, DemEnableConditionRef=the_001, DemEnableConditionRef=the_001, DemEnableConditionRef=the_001, DemEnableConditionRef=the_001, DemEnableConditionRef=the_001, DemEnableConditionRef=to, DemEnableConditionRef=trigger, DemEnableConditionRef=up, DemEnableConditionRef=voltage, DemEnableConditionRef=voltage, DemEnableConditionRef=waked, DemEnableConditionRef=x1
        EnableConditionGroup_3c74cb75: DemEnableConditionRef=DemGeneral/Disable, DemEnableConditionRef=DemGeneral/Disable, DemEnableConditionRef=ModeRequestDCDC, DemEnableConditionRef=No, DemEnableConditionRef=Note, DemEnableConditionRef=The, DemEnableConditionRef=V, DemEnableConditionRef=V, DemEnableConditionRef=VCU_, DemEnableConditionRef=VCU_EnableOBC, DemEnableConditionRef=When, DemEnableConditionRef=abnormal, DemEnableConditionRef=active, DemEnableConditionRef=after, DemEnableConditionRef=again, DemEnableConditionRef=all, DemEnableConditionRef=any, DemEnableConditionRef=battery, DemEnableConditionRef=be, DemEnableConditionRef=being, DemEnableConditionRef=completed, DemEnableConditionRef=conditions, DemEnableConditionRef=conditions, DemEnableConditionRef=conditions, DemEnableConditionRef=confirmation, DemEnableConditionRef=diagnosis, DemEnableConditionRef=diagnosis, DemEnableConditionRef=during, DemEnableConditionRef=enable, DemEnableConditionRef=fault, DemEnableConditionRef=fault, DemEnableConditionRef=fault, DemEnableConditionRef=for, DemEnableConditionRef=from, DemEnableConditionRef=is, DemEnableConditionRef=is, DemEnableConditionRef=is, DemEnableConditionRef=met, DemEnableConditionRef=met, DemEnableConditionRef=ms, DemEnableConditionRef=ms, DemEnableConditionRef=normal, DemEnableConditionRef=not, DemEnableConditionRef=of, DemEnableConditionRef=or, DemEnableConditionRef=or, DemEnableConditionRef=performed, DemEnableConditionRef=recovers, DemEnableConditionRef=service, DemEnableConditionRef=shall, DemEnableConditionRef=the_001, DemEnableConditionRef=the_001, DemEnableConditionRef=the_001, DemEnableConditionRef=the_001, DemEnableConditionRef=the_001, DemEnableConditionRef=the_001, DemEnableConditionRef=to, DemEnableConditionRef=trigger, DemEnableConditionRef=up, DemEnableConditionRef=voltage, DemEnableConditionRef=voltage, DemEnableConditionRef=waked, DemEnableConditionRef=x2, DemEnableConditionRef=x3
        EnableConditionGroup_be914dc6: DemEnableConditionRef=All_001, DemEnableConditionRef=Busoff, DemEnableConditionRef=Conditions_001, DemEnableConditionRef=Conditions_001, DemEnableConditionRef=Confirmed, DemEnableConditionRef=Confirmed, DemEnableConditionRef=DTC, DemEnableConditionRef=DTC, DemEnableConditionRef=Enable_001, DemEnableConditionRef=Enable_001, DemEnableConditionRef=In_001, DemEnableConditionRef=KL15E_001, DemEnableConditionRef=No, DemEnableConditionRef=No, DemEnableConditionRef=Note, DemEnableConditionRef=ON_001, DemEnableConditionRef=Reset_001, DemEnableConditionRef=T_Delay, DemEnableConditionRef=T_Delay, DemEnableConditionRef=T_Delay, DemEnableConditionRef=The, DemEnableConditionRef=V, DemEnableConditionRef=V, DemEnableConditionRef=abnormal, DemEnableConditionRef=active, DemEnableConditionRef=again, DemEnableConditionRef=again, DemEnableConditionRef=and, DemEnableConditionRef=and, DemEnableConditionRef=and, DemEnableConditionRef=any, DemEnableConditionRef=any, DemEnableConditionRef=battery, DemEnableConditionRef=condition, DemEnableConditionRef=conditions, DemEnableConditionRef=criteria, DemEnableConditionRef=criteria, DemEnableConditionRef=do, DemEnableConditionRef=does, DemEnableConditionRef=fault, DemEnableConditionRef=following, DemEnableConditionRef=for, DemEnableConditionRef=from, DemEnableConditionRef=if_001, DemEnableConditionRef=in, DemEnableConditionRef=in, DemEnableConditionRef=is, DemEnableConditionRef=is, DemEnableConditionRef=last, DemEnableConditionRef=meet, DemEnableConditionRef=meet, DemEnableConditionRef=met, DemEnableConditionRef=ms, DemEnableConditionRef=normal, DemEnableConditionRef=not, DemEnableConditionRef=not, DemEnableConditionRef=of, DemEnableConditionRef=of, DemEnableConditionRef=or, DemEnableConditionRef=or, DemEnableConditionRef=recovered, DemEnableConditionRef=recovers, DemEnableConditionRef=requirements, DemEnableConditionRef=requirements, DemEnableConditionRef=reset, DemEnableConditionRef=service, DemEnableConditionRef=simultaneously, DemEnableConditionRef=start, DemEnableConditionRef=start, DemEnableConditionRef=status, DemEnableConditionRef=status, DemEnableConditionRef=the_001, DemEnableConditionRef=the_001, DemEnableConditionRef=the_001, DemEnableConditionRef=the_001, DemEnableConditionRef=the_001, DemEnableConditionRef=the_001, DemEnableConditionRef=the_001, DemEnableConditionRef=the_001, DemEnableConditionRef=timer, DemEnableConditionRef=timing, DemEnableConditionRef=timing, DemEnableConditionRef=to, DemEnableConditionRef=to, DemEnableConditionRef=to, DemEnableConditionRef=voltage, DemEnableConditionRef=voltage
        EnableConditionGroup_0e120735: DemEnableConditionRef=Buck, DemEnableConditionRef=No, DemEnableConditionRef=Note, DemEnableConditionRef=The, DemEnableConditionRef=V, DemEnableConditionRef=V, DemEnableConditionRef=VCU_ModeRequestDCDC, DemEnableConditionRef=When, DemEnableConditionRef=abnormal, DemEnableConditionRef=active, DemEnableConditionRef=after, DemEnableConditionRef=again, DemEnableConditionRef=all, DemEnableConditionRef=any, DemEnableConditionRef=battery, DemEnableConditionRef=be, DemEnableConditionRef=being, DemEnableConditionRef=completed, DemEnableConditionRef=conditions, DemEnableConditionRef=conditions, DemEnableConditionRef=conditions, DemEnableConditionRef=confirmation, DemEnableConditionRef=diagnosis, DemEnableConditionRef=diagnosis, DemEnableConditionRef=during, DemEnableConditionRef=enable, DemEnableConditionRef=fault, DemEnableConditionRef=fault, DemEnableConditionRef=fault, DemEnableConditionRef=for, DemEnableConditionRef=from, DemEnableConditionRef=is, DemEnableConditionRef=is, DemEnableConditionRef=is, DemEnableConditionRef=met, DemEnableConditionRef=met, DemEnableConditionRef=ms, DemEnableConditionRef=ms, DemEnableConditionRef=normal, DemEnableConditionRef=not, DemEnableConditionRef=of, DemEnableConditionRef=or, DemEnableConditionRef=or, DemEnableConditionRef=performed, DemEnableConditionRef=recovers, DemEnableConditionRef=service, DemEnableConditionRef=shall, DemEnableConditionRef=the_001, DemEnableConditionRef=the_001, DemEnableConditionRef=the_001, DemEnableConditionRef=the_001, DemEnableConditionRef=the_001, DemEnableConditionRef=the_001, DemEnableConditionRef=to, DemEnableConditionRef=trigger, DemEnableConditionRef=up, DemEnableConditionRef=voltage, DemEnableConditionRef=voltage, DemEnableConditionRef=waked, DemEnableConditionRef=x1
        EnableConditionGroup_93df7d19: DemEnableConditionRef=No, DemEnableConditionRef=Note, DemEnableConditionRef=When, DemEnableConditionRef=active, DemEnableConditionRef=after, DemEnableConditionRef=again, DemEnableConditionRef=all, DemEnableConditionRef=any, DemEnableConditionRef=be, DemEnableConditionRef=being, DemEnableConditionRef=completed, DemEnableConditionRef=conditions, DemEnableConditionRef=conditions, DemEnableConditionRef=conditions, DemEnableConditionRef=confirmation, DemEnableConditionRef=diagnosis, DemEnableConditionRef=diagnosis, DemEnableConditionRef=during, DemEnableConditionRef=enable, DemEnableConditionRef=fault, DemEnableConditionRef=fault, DemEnableConditionRef=fault, DemEnableConditionRef=is, DemEnableConditionRef=is, DemEnableConditionRef=met, DemEnableConditionRef=met, DemEnableConditionRef=ms, DemEnableConditionRef=not, DemEnableConditionRef=of, DemEnableConditionRef=or, DemEnableConditionRef=performed, DemEnableConditionRef=service, DemEnableConditionRef=shall, DemEnableConditionRef=the_001, DemEnableConditionRef=the_001, DemEnableConditionRef=the_001, DemEnableConditionRef=the_001, DemEnableConditionRef=the_001, DemEnableConditionRef=trigger, DemEnableConditionRef=up, DemEnableConditionRef=waked
        EnableConditionGroup_d1c785ea: DemEnableConditionRef=All_001, DemEnableConditionRef=Being_001, DemEnableConditionRef=Conditions_001, DemEnableConditionRef=Conditions_001, DemEnableConditionRef=Confirmed, DemEnableConditionRef=Confirmed, DemEnableConditionRef=DTC, DemEnableConditionRef=DTC, DemEnableConditionRef=Enable_001, DemEnableConditionRef=Enable_001, DemEnableConditionRef=In_001, DemEnableConditionRef=No, DemEnableConditionRef=Note, DemEnableConditionRef=Reset_001, DemEnableConditionRef=T_Delay, DemEnableConditionRef=T_Delay, DemEnableConditionRef=T_Delay, DemEnableConditionRef=The, DemEnableConditionRef=V, DemEnableConditionRef=V, DemEnableConditionRef=abnormal, DemEnableConditionRef=active, DemEnableConditionRef=again, DemEnableConditionRef=again, DemEnableConditionRef=and, DemEnableConditionRef=and, DemEnableConditionRef=and, DemEnableConditionRef=any, DemEnableConditionRef=any, DemEnableConditionRef=battery, DemEnableConditionRef=condition, DemEnableConditionRef=conditions, DemEnableConditionRef=criteria, DemEnableConditionRef=criteria, DemEnableConditionRef=do, DemEnableConditionRef=does, DemEnableConditionRef=fault, DemEnableConditionRef=following, DemEnableConditionRef=for, DemEnableConditionRef=from, DemEnableConditionRef=if_001, DemEnableConditionRef=in, DemEnableConditionRef=in, DemEnableConditionRef=is, DemEnableConditionRef=last, DemEnableConditionRef=meet, DemEnableConditionRef=meet, DemEnableConditionRef=met, DemEnableConditionRef=ms, DemEnableConditionRef=normal, DemEnableConditionRef=not, DemEnableConditionRef=not, DemEnableConditionRef=of, DemEnableConditionRef=of, DemEnableConditionRef=or, DemEnableConditionRef=or, DemEnableConditionRef=recovered, DemEnableConditionRef=recovers, DemEnableConditionRef=requirements, DemEnableConditionRef=requirements, DemEnableConditionRef=reset, DemEnableConditionRef=service, DemEnableConditionRef=simultaneously, DemEnableConditionRef=start, DemEnableConditionRef=start, DemEnableConditionRef=the_001, DemEnableConditionRef=the_001, DemEnableConditionRef=the_001, DemEnableConditionRef=the_001, DemEnableConditionRef=the_001, DemEnableConditionRef=the_001, DemEnableConditionRef=the_001, DemEnableConditionRef=the_001, DemEnableConditionRef=timer, DemEnableConditionRef=timing, DemEnableConditionRef=timing, DemEnableConditionRef=to, DemEnableConditionRef=to, DemEnableConditionRef=to, DemEnableConditionRef=up, DemEnableConditionRef=voltage, DemEnableConditionRef=voltage, DemEnableConditionRef=waked
        EnableConditionGroup_eb032f9a: DemEnableConditionRef=All_001, DemEnableConditionRef=Busoff, DemEnableConditionRef=Conditions_001, DemEnableConditionRef=Conditions_001, DemEnableConditionRef=Confirmed, DemEnableConditionRef=Confirmed, DemEnableConditionRef=DTC, DemEnableConditionRef=DTC, DemEnableConditionRef=Enable_001, DemEnableConditionRef=Enable_001, DemEnableConditionRef=In_001, DemEnableConditionRef=Lan, DemEnableConditionRef=No, DemEnableConditionRef=No, DemEnableConditionRef=Note, DemEnableConditionRef=PNC0, DemEnableConditionRef=PNC03, DemEnableConditionRef=PNC13, DemEnableConditionRef=PNC14, DemEnableConditionRef=PNC15, DemEnableConditionRef=PNC31, DemEnableConditionRef=Reset_001, DemEnableConditionRef=T_Delay, DemEnableConditionRef=T_Delay, DemEnableConditionRef=T_Delay, DemEnableConditionRef=The, DemEnableConditionRef=The, DemEnableConditionRef=V, DemEnableConditionRef=V, DemEnableConditionRef=abnormal, DemEnableConditionRef=active, DemEnableConditionRef=again, DemEnableConditionRef=again, DemEnableConditionRef=and, DemEnableConditionRef=and, DemEnableConditionRef=and, DemEnableConditionRef=any, DemEnableConditionRef=any, DemEnableConditionRef=battery, DemEnableConditionRef=condition, DemEnableConditionRef=conditions, DemEnableConditionRef=criteria, DemEnableConditionRef=criteria, DemEnableConditionRef=do, DemEnableConditionRef=does, DemEnableConditionRef=fault, DemEnableConditionRef=following, DemEnableConditionRef=for, DemEnableConditionRef=from, DemEnableConditionRef=if_001, DemEnableConditionRef=in, DemEnableConditionRef=in, DemEnableConditionRef=is, DemEnableConditionRef=is, DemEnableConditionRef=last, DemEnableConditionRef=meet, DemEnableConditionRef=meet, DemEnableConditionRef=met, DemEnableConditionRef=ms, DemEnableConditionRef=normal, DemEnableConditionRef=not, DemEnableConditionRef=not, DemEnableConditionRef=of, DemEnableConditionRef=of, DemEnableConditionRef=or, DemEnableConditionRef=or, DemEnableConditionRef=recovered, DemEnableConditionRef=recovers, DemEnableConditionRef=requirements, DemEnableConditionRef=requirements, DemEnableConditionRef=reset, DemEnableConditionRef=service, DemEnableConditionRef=simultaneously, DemEnableConditionRef=start, DemEnableConditionRef=start, DemEnableConditionRef=status, DemEnableConditionRef=the_001, DemEnableConditionRef=the_001, DemEnableConditionRef=the_001, DemEnableConditionRef=the_001, DemEnableConditionRef=the_001, DemEnableConditionRef=the_001, DemEnableConditionRef=the_001, DemEnableConditionRef=the_001, DemEnableConditionRef=timer, DemEnableConditionRef=timing, DemEnableConditionRef=timing, DemEnableConditionRef=to, DemEnableConditionRef=to, DemEnableConditionRef=to, DemEnableConditionRef=voltage, DemEnableConditionRef=voltage
        EnableConditionGroup_048c220e: DemEnableConditionRef=Accelerator, DemEnableConditionRef=No, DemEnableConditionRef=Note, DemEnableConditionRef=The, DemEnableConditionRef=V, DemEnableConditionRef=V, DemEnableConditionRef=V, DemEnableConditionRef=V, DemEnableConditionRef=When, DemEnableConditionRef=abnormal, DemEnableConditionRef=accelerator_001, DemEnableConditionRef=active, DemEnableConditionRef=after, DemEnableConditionRef=again, DemEnableConditionRef=all, DemEnableConditionRef=and, DemEnableConditionRef=any, DemEnableConditionRef=battery, DemEnableConditionRef=be, DemEnableConditionRef=being, DemEnableConditionRef=completed, DemEnableConditionRef=conditions, DemEnableConditionRef=conditions, DemEnableConditionRef=conditions, DemEnableConditionRef=confirmation, DemEnableConditionRef=diagnosis, DemEnableConditionRef=diagnosis, DemEnableConditionRef=during, DemEnableConditionRef=enable, DemEnableConditionRef=fault, DemEnableConditionRef=fault, DemEnableConditionRef=fault, DemEnableConditionRef=for, DemEnableConditionRef=from, DemEnableConditionRef=is, DemEnableConditionRef=is, DemEnableConditionRef=is, DemEnableConditionRef=is, DemEnableConditionRef=is, DemEnableConditionRef=met, DemEnableConditionRef=met, DemEnableConditionRef=ms, DemEnableConditionRef=ms, DemEnableConditionRef=normal, DemEnableConditionRef=not, DemEnableConditionRef=of, DemEnableConditionRef=or, DemEnableConditionRef=or, DemEnableConditionRef=pedal, DemEnableConditionRef=pedal, DemEnableConditionRef=performed, DemEnableConditionRef=pin1, DemEnableConditionRef=pin2, DemEnableConditionRef=recovers, DemEnableConditionRef=restored, DemEnableConditionRef=restored, DemEnableConditionRef=service, DemEnableConditionRef=shall, DemEnableConditionRef=the_001, DemEnableConditionRef=the_001, DemEnableConditionRef=the_001, DemEnableConditionRef=the_001, DemEnableConditionRef=the_001, DemEnableConditionRef=the_001, DemEnableConditionRef=to, DemEnableConditionRef=to, DemEnableConditionRef=to, DemEnableConditionRef=trigger, DemEnableConditionRef=up, DemEnableConditionRef=v_001, DemEnableConditionRef=v_001, DemEnableConditionRef=voltage, DemEnableConditionRef=voltage, DemEnableConditionRef=voltage, DemEnableConditionRef=voltage, DemEnableConditionRef=waked
        EnableConditionGroup_cca67fec: DemEnableConditionRef=All_001, DemEnableConditionRef=Busoff, DemEnableConditionRef=Conditions_001, DemEnableConditionRef=Conditions_001, DemEnableConditionRef=Confirmed, DemEnableConditionRef=Confirmed, DemEnableConditionRef=DTC, DemEnableConditionRef=DTC, DemEnableConditionRef=Enable_001, DemEnableConditionRef=Enable_001, DemEnableConditionRef=In_001, DemEnableConditionRef=Lan, DemEnableConditionRef=No, DemEnableConditionRef=No, DemEnableConditionRef=Note, DemEnableConditionRef=PNC0, DemEnableConditionRef=PNC03, DemEnableConditionRef=PNC04, DemEnableConditionRef=PNC13, DemEnableConditionRef=PNC14, DemEnableConditionRef=PNC15, DemEnableConditionRef=PNC16, DemEnableConditionRef=PNC18, DemEnableConditionRef=Reset_001, DemEnableConditionRef=T_Delay, DemEnableConditionRef=T_Delay, DemEnableConditionRef=T_Delay, DemEnableConditionRef=The, DemEnableConditionRef=The, DemEnableConditionRef=V, DemEnableConditionRef=V, DemEnableConditionRef=abnormal, DemEnableConditionRef=active, DemEnableConditionRef=again, DemEnableConditionRef=again, DemEnableConditionRef=and, DemEnableConditionRef=and, DemEnableConditionRef=and, DemEnableConditionRef=any, DemEnableConditionRef=any, DemEnableConditionRef=battery, DemEnableConditionRef=condition, DemEnableConditionRef=conditions, DemEnableConditionRef=criteria, DemEnableConditionRef=criteria, DemEnableConditionRef=do, DemEnableConditionRef=does, DemEnableConditionRef=fault, DemEnableConditionRef=following, DemEnableConditionRef=for, DemEnableConditionRef=from, DemEnableConditionRef=if_001, DemEnableConditionRef=in, DemEnableConditionRef=in, DemEnableConditionRef=is, DemEnableConditionRef=is, DemEnableConditionRef=last, DemEnableConditionRef=meet, DemEnableConditionRef=meet, DemEnableConditionRef=met, DemEnableConditionRef=ms, DemEnableConditionRef=normal, DemEnableConditionRef=not, DemEnableConditionRef=not, DemEnableConditionRef=of, DemEnableConditionRef=of, DemEnableConditionRef=or, DemEnableConditionRef=or, DemEnableConditionRef=recovered, DemEnableConditionRef=recovers, DemEnableConditionRef=requirements, DemEnableConditionRef=requirements, DemEnableConditionRef=reset, DemEnableConditionRef=service, DemEnableConditionRef=simultaneously, DemEnableConditionRef=start, DemEnableConditionRef=start, DemEnableConditionRef=status, DemEnableConditionRef=the_001, DemEnableConditionRef=the_001, DemEnableConditionRef=the_001, DemEnableConditionRef=the_001, DemEnableConditionRef=the_001, DemEnableConditionRef=the_001, DemEnableConditionRef=the_001, DemEnableConditionRef=the_001, DemEnableConditionRef=timer, DemEnableConditionRef=timing, DemEnableConditionRef=timing, DemEnableConditionRef=to, DemEnableConditionRef=to, DemEnableConditionRef=to, DemEnableConditionRef=voltage, DemEnableConditionRef=voltage
        EnableConditionGroup_c779eeed: DemEnableConditionRef=All_001, DemEnableConditionRef=Busoff, DemEnableConditionRef=Conditions_001, DemEnableConditionRef=Conditions_001, DemEnableConditionRef=Confirmed, DemEnableConditionRef=Confirmed, DemEnableConditionRef=DTC, DemEnableConditionRef=DTC, DemEnableConditionRef=Enable_001, DemEnableConditionRef=Enable_001, DemEnableConditionRef=In_001, DemEnableConditionRef=KL15e, DemEnableConditionRef=No, DemEnableConditionRef=No, DemEnableConditionRef=Note, DemEnableConditionRef=ON_001, DemEnableConditionRef=Reset_001, DemEnableConditionRef=T_Delay, DemEnableConditionRef=T_Delay, DemEnableConditionRef=T_Delay, DemEnableConditionRef=The, DemEnableConditionRef=V, DemEnableConditionRef=V, DemEnableConditionRef=abnormal, DemEnableConditionRef=active, DemEnableConditionRef=again, DemEnableConditionRef=again, DemEnableConditionRef=and, DemEnableConditionRef=and, DemEnableConditionRef=and, DemEnableConditionRef=any, DemEnableConditionRef=any, DemEnableConditionRef=battery, DemEnableConditionRef=condition, DemEnableConditionRef=conditions, DemEnableConditionRef=criteria, DemEnableConditionRef=criteria, DemEnableConditionRef=do, DemEnableConditionRef=does, DemEnableConditionRef=fault, DemEnableConditionRef=following, DemEnableConditionRef=for, DemEnableConditionRef=from, DemEnableConditionRef=if_001, DemEnableConditionRef=in, DemEnableConditionRef=in, DemEnableConditionRef=is, DemEnableConditionRef=is, DemEnableConditionRef=last, DemEnableConditionRef=meet, DemEnableConditionRef=meet, DemEnableConditionRef=met, DemEnableConditionRef=ms, DemEnableConditionRef=normal, DemEnableConditionRef=not, DemEnableConditionRef=not, DemEnableConditionRef=of, DemEnableConditionRef=of, DemEnableConditionRef=or, DemEnableConditionRef=or, DemEnableConditionRef=recovered, DemEnableConditionRef=recovers, DemEnableConditionRef=requirements, DemEnableConditionRef=requirements, DemEnableConditionRef=reset, DemEnableConditionRef=service, DemEnableConditionRef=simultaneously, DemEnableConditionRef=start, DemEnableConditionRef=start, DemEnableConditionRef=status, DemEnableConditionRef=status, DemEnableConditionRef=the_001, DemEnableConditionRef=the_001, DemEnableConditionRef=the_001, DemEnableConditionRef=the_001, DemEnableConditionRef=the_001, DemEnableConditionRef=the_001, DemEnableConditionRef=the_001, DemEnableConditionRef=the_001, DemEnableConditionRef=timer, DemEnableConditionRef=timing, DemEnableConditionRef=timing, DemEnableConditionRef=to, DemEnableConditionRef=to, DemEnableConditionRef=to, DemEnableConditionRef=voltage, DemEnableConditionRef=voltage
        EnableConditionGroup_c828305f: DemEnableConditionRef=BHM, DemEnableConditionRef=BMS, DemEnableConditionRef=BMS_status, DemEnableConditionRef=DemGeneral/Chargestatus, DemEnableConditionRef=DC, DemEnableConditionRef=DC, DemEnableConditionRef=DC, DemEnableConditionRef=DC, DemEnableConditionRef=Detected, DemEnableConditionRef=High, DemEnableConditionRef=No, DemEnableConditionRef=Note, DemEnableConditionRef=On, DemEnableConditionRef=Plug, DemEnableConditionRef=Plug, DemEnableConditionRef=Power, DemEnableConditionRef=The, DemEnableConditionRef=V, DemEnableConditionRef=V, DemEnableConditionRef=VCU, DemEnableConditionRef=VCU, DemEnableConditionRef=When, DemEnableConditionRef=abnormal, DemEnableConditionRef=active, DemEnableConditionRef=again, DemEnableConditionRef=all, DemEnableConditionRef=any, DemEnableConditionRef=battery, DemEnableConditionRef=be, DemEnableConditionRef=charge, DemEnableConditionRef=charge, DemEnableConditionRef=completed, DemEnableConditionRef=completed, DemEnableConditionRef=conditions, DemEnableConditionRef=conditions, DemEnableConditionRef=conditions, DemEnableConditionRef=confirmation, DemEnableConditionRef=detected_001, DemEnableConditionRef=diagnosis, DemEnableConditionRef=diagnosis, DemEnableConditionRef=during, DemEnableConditionRef=enable, DemEnableConditionRef=fault, DemEnableConditionRef=fault, DemEnableConditionRef=fault, DemEnableConditionRef=for, DemEnableConditionRef=for, DemEnableConditionRef=from, DemEnableConditionRef=is, DemEnableConditionRef=is, DemEnableConditionRef=is, DemEnableConditionRef=is, DemEnableConditionRef=is, DemEnableConditionRef=message, DemEnableConditionRef=met, DemEnableConditionRef=met, DemEnableConditionRef=ms, DemEnableConditionRef=normal, DemEnableConditionRef=not, DemEnableConditionRef=of, DemEnableConditionRef=or, DemEnableConditionRef=or, DemEnableConditionRef=performed, DemEnableConditionRef=recovers, DemEnableConditionRef=sends, DemEnableConditionRef=service, DemEnableConditionRef=shall, DemEnableConditionRef=the_001, DemEnableConditionRef=the_001, DemEnableConditionRef=the_001, DemEnableConditionRef=the_001, DemEnableConditionRef=the_001, DemEnableConditionRef=the_001, DemEnableConditionRef=to, DemEnableConditionRef=trigger, DemEnableConditionRef=voltage, DemEnableConditionRef=voltage, DemEnableConditionRef=voltage, DemEnableConditionRef=x3, DemEnableConditionRef=x3
      ExtendedData (DemExtendedDataRecordClass):
        DemExtendedDataRecordNumber = 1
        DemExtendedDataRecordTrigger = DEM_RECORD_TRIGGER_TESTFAILED
        DemExtendedDataRecordUpdate = DEM_UPDATE_RECORD_YES
        DemDataClassRef = ExtendedData_Fault_Ocurrence_Counter
        DemDataClassRef = ExtendedData_Fault_Aged_Counter
        DemDataClassRef = ExtendedData_Fault_Aging_Counter
      7 x DemFreezeFrameClass, all with DemDidClassRef=DemGeneral/Ignition_Switch_Signal, DemDidClassRef=DemGeneral/Battery_Voltage, DemDidClassRef=DemGeneral/Total_Odometer, DemDidClassRef=DemGeneral/Vehicle_speed, DemDidClassRef=DemGeneral/Date_And_Time, DemDidClassRef=DemGeneral/VCU_HVStatus, DemDidClassRef=DemGeneral/SOC, DemDidClassRef=DemGeneral/Gear:
        FreezeFrameClass_376d31f7: DemDidClassRef=DemGeneral/Electronic_lock_state
        FreezeFrameClass_5f5b5001
        FreezeFrameClass_a7d22c66: DemDidClassRef=DemGeneral/VCU_HV_InterLock_PWM_pfrequency
        FreezeFrameClass_c715a583: DemDidClassRef=DemGeneral/VCU_control_main_relay
        FreezeFrameClass_d0d51cf0: DemDidClassRef=DemGeneral/S2_status
        FreezeFrameClass_d96350db: DemDidClassRef=DemGeneral/AC_charging_parameter
        FreezeFrameClass_de0e94c2: DemDidClassRef=DemGeneral/VCU_AccPealparameter
      FreezeFrameRecNumClass_f98c8aa7 (DemFreezeFrameRecNumClass):
        DemFreezeFrameRecordNumber = 1
        DemFreezeFrameRecordTrigger = DEM_RECORD_TRIGGER_TESTFAILED
        DemFreezeFrameRecordUpdate = DEM_UPDATE_RECORD_YES
        DemFreezeFrameRecordNumber = 2
        DemFreezeFrameRecordTrigger = DEM_RECORD_TRIGGER_TESTFAILED
        DemFreezeFrameRecordUpdate = DEM_UPDATE_RECORD_YES
      WarningIndicator (DemIndicator)
      PowerCycle (DemOperationCycle): DemOperationCycleType=DEM_OPCYC_POWER
      29 x DemDataClass, all with DemDataElementUsePort=USE_DATA_CLIENT_SERVER_PORT, DemDataElementStoreNonVolatile=true:
        DID_0x1d01_Accelerator_pedal_sensor_1_voltage: DemDataElementDataSize=1, DemDataElementDataType=UINT8
        DID_0x1d01_Accelerator_pedal_sensor_2_voltage: DemDataElementDataSize=1, DemDataElementDataType=UINT8
        DID_0xf1a4_Date_And_Time_Day: DemDataElementDataSize=1, DemDataElementDataType=UINT8
        DID_0xf1a4_Date_And_Time_Hour: DemDataElementDataSize=1, DemDataElementDataType=UINT8
        DID_0xf1a4_Date_And_Time_Minute: DemDataElementDataSize=1, DemDataElementDataType=UINT8
        DID_0xf1a4_Date_And_Time_Month: DemDataElementDataSize=1, DemDataElementDataType=UINT8
        DID_0xf1a4_Date_And_Time_Second: DemDataElementDataSize=1, DemDataElementDataType=UINT8
        DID_0xf1a4_Date_And_Time_Year: DemDataElementDataSize=1, DemDataElementDataType=UINT8
        DID_0x1d07_Electronic_lock_state: DemDataElementDataSize=1, DemDataElementDataType=UINT8
        ExtendedData_Fault_Aged_Counter: DemDataElementDataSize=1, DemDataElementDataType=UINT8
        ExtendedData_Fault_Aging_Counter: DemDataElementDataSize=1, DemDataElementDataType=UINT8
        ExtendedData_Fault_Ocurrence_Counter: DemDataElementDataSize=1, DemDataElementDataType=UINT8
        DID_0xf1a7_Gear: DemDataElementDataSize=1, DemDataElementDataType=UINT8
        DID_0xf1a0_Ignition_Switch_Signal: DemDataElementDataSize=1, DemDataElementDataType=UINT8
        DID_0x1d11_Mainrealy1: DemDataElementDataSize=1, DemDataElementDataType=UINT8
        DID_0x1d11_Mainrelay2: DemDataElementDataSize=1, DemDataElementDataType=UINT8
        DID_0x1d09_New_Bit_Field: DemDataElementDataSize=1, DemDataElementDataType=UINT8
        DID_0x1d01_VCU_AccelerationPedal: DemDataElementDataSize=1, DemDataElementDataType=UINT8
        DID_0x1d08_VCU_HVIL: DemDataElementDataSize=1, DemDataElementDataType=UINT8
        DID_0xf1a5_VCU_HVStatus: DemDataElementDataSize=1, DemDataElementDataType=UINT8
        DID_0xf1a1_Battery_Voltage: DemDataElementDataSize=2, DemDataElementDataType=UINT16, DemDataElementEndianness=BIG_ENDIAN
        DID_0x1d05_POD_OBC_InputACVoltage: DemDataElementDataSize=2, DemDataElementDataType=UINT16, DemDataElementEndianness=BIG_ENDIAN
        DID_0x1d05_POD_OBC_OutputDCChargeCurrent: DemDataElementDataSize=2, DemDataElementDataType=UINT16, DemDataElementEndianness=BIG_ENDIAN
        DID_0x1d05_POD_OBC_OutputDCChargeVoltage: DemDataElementDataSize=2, DemDataElementDataType=UINT16, DemDataElementEndianness=BIG_ENDIAN
        DID_0xf1a6_SOC: DemDataElementDataSize=2, DemDataElementDataType=UINT16, DemDataElementEndianness=BIG_ENDIAN
        DID_0x1d05_VCU_OBC_ChargeCurrentCommand: DemDataElementDataSize=2, DemDataElementDataType=UINT16, DemDataElementEndianness=BIG_ENDIAN
        DID_0x1d01_VCU_VehicleSpeed: DemDataElementDataSize=2, DemDataElementDataType=UINT16, DemDataElementEndianness=BIG_ENDIAN
        DID_0xf1a3_Vehicle_speed: DemDataElementDataSize=2, DemDataElementDataType=UINT16, DemDataElementEndianness=BIG_ENDIAN
        DID_0xf1a2_Total_Odometer: DemDataElementDataSize=3, DemDataElementDataType=UINT8_N, DemDataElementEndianness=opaque
