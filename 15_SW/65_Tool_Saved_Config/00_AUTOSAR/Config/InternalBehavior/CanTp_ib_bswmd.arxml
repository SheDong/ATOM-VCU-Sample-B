AUTOSAR XML (schema 00048)
package /MICROSAR/CanTp_ib_bswmd/BswModuleDescriptions
  bsw module description CanTp: provided-entrys=CanTp_MainFunction
    bsw internal behavior CanTpBehavior
      exclusive area CANTP_EXCLUSIVE_AREA_0
      bsw schedulable entity CanTp_MainFunction: implemented-entry=CanTp_MainFunction
      bsw timing event CanTp_MainFunctionTimingEvent0: starts-on-event=CanTp_MainFunction, period=0.005
  bsw module entry CanTp_MainFunction: call-type=SCHEDULED, execution-context=TASK
