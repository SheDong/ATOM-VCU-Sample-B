AUTOSAR XML (schema 00048)
standard types defined: boolean, sint16, sint8, uint16, uint32, uint8
package /Predefined_DEV/ImplementationDataTypes
  impl type NvM_RequestResultType: compu {0=NVM_REQ_OK, 1=NVM_REQ_NOT_OK, 2=NVM_REQ_PENDING, 3=NVM_REQ_INTEGRITY_FAILED, 4=NVM_REQ_BLOCK_SKIPPED, 5=NVM_REQ_NV_INVALIDATED, 6=NVM_REQ_CANCELED, 7=NVM_REQ_REDUNDANCY_FAILED, 8=NVM_REQ_RESTORED_FROM_ROM}, implementation-data-type=uint8
  impl type NvM_ServiceIdType: compu {6=NVM_READ_BLOCK, 7=NVM_WRITE_BLOCK, 8=NVM_RESTORE_BLOCK_DEFAULTS, 9=NVM_ERASE_BLOCK, 11=NVM_INVALIDATE_NV_BLOCK, 12=NVM_READ_ALL}, implementation-data-type=uint8
  impl type Dem_UdsStatusByteType: compu {mask 1: 1=DEM_UDS_STATUS_TF, mask 2: 2=DEM_UDS_STATUS_TFTOC, mask 4: 4=DEM_UDS_STATUS_PDTC, mask 8: 8=DEM_UDS_STATUS_CDTC, mask 16: 16=DEM_UDS_STATUS_TNCSLC, mask 32: 32=DEM_UDS_STATUS_TFSLC, mask 64: 64=DEM_UDS_STATUS_TNCTOC, mask 128: 128=DEM_UDS_STATUS_WIR}, range raw 0..255, implementation-data-type=uint8
package /DataType/Constraint
  range DC_APTC_Core1TempSensorFaltStatus: raw 0..3
  range DC_APTC_Core2TempSensorFaltStatus: raw 0..3
  range DC_APTC_DriveFaltStatus: raw 0..1
  range DC_APTC_HeatingFaltStatus: raw 0..1
  range DC_APTC_HVBusVoltage: raw 0..2047
  range DC_APTC_HVPowerUpReq: raw 0..1
  range DC_APTC_IGBTFaltStatus: raw 0..3
  range DC_APTC_LeftCoreTemp: raw 0..255
  range DC_APTC_LostCommuFaltStatus: raw 0..1
  range DC_APTC_PowerConsumption: raw 0..255
  range DC_APTC_RightCoreTemp: raw 0..255
  range DC_BCM_RLHSHumidSensorValue: raw 0..200
  range DC_BCM_RLHSSolarDrvr: raw 0..250
  range DC_BCM_RLHSSolarPass: raw 0..250
  range DC_BCM_RLHSTempDewPoint: raw 0..1600
  range DC_BCM_RLHSTempSensorValue: raw 0..255
  range DC_BMS_AbortAchivesetValue: raw 0..3
  range DC_BMS_AbortAchiveSingleVolt: raw 0..3
  range DC_BMS_AbortAchiveTotalVolt: raw 0..3
  range DC_BMS_AbortErrorCurrent: raw 0..3
  range DC_BMS_AbortErrorVoltage: raw 0..3
  range DC_BMS_AbortFaultBatteryTemp: raw 0..3
  range DC_BMS_AbortFaultBMSTemp: raw 0..3
  range DC_BMS_AllowCellTemperature: raw 0..255
  range DC_BMS_AllowChagCurrent: raw 0..20000
  range DC_BMS_AverageCellTemp: raw 0..255
  range DC_BMS_BalanceCommand: raw 0..1
  range DC_BMS_BalancingStatus: raw 0..1
  range DC_BMS_BatChagSum: raw 0..3000
  range DC_BMS_BatCode{1..6}: raw 0..255
  range DC_BMS_BatCodeFrameLength: raw 0..255
  range DC_BMS_BatCodeFrameNO: raw 0..255
  range DC_BMS_BatProDatDay: raw 0..255
  range DC_BMS_BatProDatMonth: raw 0..255
  range DC_BMS_BatProDatYear: raw 0..-1730
  range DC_BMS_BatProRights: raw 0..1
  range DC_BMS_BatStatus: raw 0..4
  range DC_BMS_BatSupName: raw 0..15
  range DC_BMS_BattCurr: raw 0..20470
  range DC_BMS_BattVolt: raw 0..10000
  range DC_BMS_BatType: raw 0..15
  range DC_BMS_BRMVersions: raw 0..65535
  range DC_BMS_CellNumbers: raw 0..255
  range DC_BMS_ChagComplete: raw 0..4
  range DC_BMS_ChargeStatus: raw 0..15
  range DC_BMS_ChgCurrLongTerm: raw 0..20000
  range DC_BMS_ChgCurrShortTerm: raw 0..20000
  range DC_BMS_ChrgDcChrgnReq: raw 0..3
  range DC_BMS_ComVersion: raw 0..65535
  range DC_BMS_CoolCommand: raw 0..7
  range DC_BMS_DCChgMode: raw 0..3
  range DC_BMS_DisChgCurrLongTerm: raw 0..20000
  range DC_BMS_DisChgCurrShortTerm: raw 0..20000
  range DC_BMS_DisplaySOC: raw 55000..65000
  range DC_BMS_DTC: raw 0..255
  range DC_BMS_ErrorBattOverVolt: raw 0..3
  range DC_BMS_ErrorBattUnderVolt: raw 0..3
  range DC_BMS_ErrorBatVolt: raw 0..3
  range DC_BMS_ErrorBSUBalance: raw 0..1
  range DC_BMS_ErrorBSUOffline: raw 0..1
  range DC_BMS_ErrorCellHighTemp: raw 0..3
  range DC_BMS_ErrorCellLowTemp: raw 0..3
  range DC_BMS_ErrorCellOverVolt: raw 0..3
  range DC_BMS_ErrorCellTempDiff: raw 0..3
  range DC_BMS_ErrorCellTempOffline: raw 0..1
  range DC_BMS_ErrorCellUnderVolt: raw 0..3
  range DC_BMS_ErrorCellVoltDiff: raw 0..3
  range DC_BMS_ErrorCellVoltOffline: raw 0..1
  range DC_BMS_ErrorChaCurrentOver: raw 0..3
  range DC_BMS_ErrorDisChaCurrentOver: raw 0..3
  range DC_BMS_ErrorEmergencyOffCrash: raw 0..1
  range DC_BMS_ErrorHallOffline: raw 0..1
  range DC_BMS_ErrorHighSoc: raw 0..1
  range DC_BMS_ErrorHVIL: raw 0..1
  range DC_BMS_ErrorIsolationSingleLow: raw 0..3
  range DC_BMS_ErrorLeakCurrent: raw 0..3
  range DC_BMS_ErrorLeakDet: raw 0..1
  range DC_BMS_ErrorLevel: raw 0..4
  range DC_BMS_ErrorLowSOC: raw 0..3
  range DC_BMS_ErrorPreChaFailed: raw 0..1
  range DC_BMS_ErrorRelay: raw 0..1
  range DC_BMS_ErrorSmoke: raw 0..1
  range DC_BMS_ErrorSoCJump_RM: raw 0..1
  range DC_BMS_ErrorSystemsMatch: raw 0..1
  range DC_BMS_FlowRate: raw 0..255
  range DC_BMS_HardVsesion: raw 0..1
  range DC_BMS_HeatCommand: raw 0..7
  range DC_BMS_HVinterlockState: raw 0..3
  range DC_BMS_InsulationDetectionStatus: raw 0..1
  range DC_BMS_Life: raw 0..255
  range DC_BMS_LinkVoltage: raw 0..65535
  range DC_BMS_MaxCellTemp: raw 0..255
  range DC_BMS_MaxCellTempModuleNO: raw 0..255
  range DC_BMS_MaxCellTempNO: raw 0..255
  range DC_BMS_MaxCellVoltage: raw 0..65535
  range DC_BMS_MaxCellVoltageModuleNO: raw 0..15
  range DC_BMS_MaxCellVoltageNO: raw 0..255
  range DC_BMS_MaxChagVoltage: raw 0..65535
  range DC_BMS_MinCellTemp: raw 0..255
  range DC_BMS_MinCellTempModuleNO: raw 0..255
  range DC_BMS_MinCellTempNO: raw 0..255
  range DC_BMS_MinCellVoltage: raw 0..65535
  range DC_BMS_MinCellVoltageModlueNO: raw 0..15
  range DC_BMS_MinCellVoltageNO: raw 0..255
  range DC_BMS_NegRelayStatus: raw 0..3
  range DC_BMS_PackVoltage: raw 0..65535
  range DC_BMS_PosRelayStatus: raw 0..3
  range DC_BMS_PreCharge: raw 0..15
  range DC_BMS_PreRelayStatus: raw 0..3
  range DC_BMS_PTCRelayStatus: raw 0..3
  range DC_BMS_RatBatVoltage: raw 0..65535
  range DC_BMS_RatCapacity: raw 0..65535
  range DC_BMS_RatEnergy: raw 0..65535
  range DC_BMS_RemChagTime: raw 0..3600
  range DC_BMS_RunHeatStatus: raw 0..15
  range DC_BMS_SingChgkwh: raw 0..255
  range DC_BMS_SOC: raw 55000..65000
  range DC_BMS_SoftVsesion: raw 0..1
  range DC_BMS_SOH: raw 0..200
  range DC_BMS_StateDI{2..8}: raw 0..3
  range DC_BMS_StateRelay{4..8}: raw 0..3
  range DC_BMS_status: raw 0..15
  range DC_BMS_SumChgkwh: raw 0..16777215
  range DC_BMS_SumDisChgkwh: raw 0..16777215
  range DC_BMS_SysRegInsulationValue: raw 0..60000
  range DC_BMS_TargetBatteryMaxCellTemp: raw 0..255
  range DC_BMS_TempInlet: raw 0..255
  range DC_BMS_Tempoutlet: raw 0..255
  range DC_BMS_ThermalRunawayFault: raw 0..1
  range DC_BMS_ThermometerProbes: raw 0..255
  range DC_Checksum_046: raw 0..255
  range DC_Checksum_047: raw 0..255
  range DC_Checksum_0A1: raw 0..255
  range DC_Checksum_273: raw 0..255
  range DC_Checksum_274: raw 0..255
  range DC_Checksum_2C0: raw 0..255
  range DC_Checksum_2C1: raw 0..127
  range DC_Checksum_375: raw 0..255
  range DC_Checksum_5: raw 0..255
  range DC_Checksum_AE: raw 0..255
  range DC_Checksum_AF: raw 0..255
  range DC_DCDC_ComFault: raw 0..1
  range DC_DCDC_FaultStatus: raw 0..3
  range DC_DCDC_HVInputCurrent: raw 0..255
  range DC_DCDC_HVInputVoltage: raw 0..2047
  range DC_DCDC_HWFault: raw 0..1
  range DC_DCDC_InputVoltHighFault: raw 0..1
  range DC_DCDC_InputVoltLowFault: raw 0..1
  range DC_DCDC_LVOutputCurrent: raw 0..4000
  range DC_DCDC_LVOutputVoltage: raw 0..255
  range DC_DCDC_OBCTempHighFault: raw 0..1
  range DC_DCDC_OutputCurrentHighFault: raw 0..1
  range DC_DCDC_OutputCurrentSensorFault: raw 0..1
  range DC_DCDC_OutputSOGFault: raw 0..1
  range DC_DCDC_OutputTempSensorFault: raw 0..1
  range DC_DCDC_OutputVoltHighFault: raw 0..1
  range DC_DCDC_OutputVoltLowFault: raw 0..1
  range DC_DCDC_SecondarySideTemp: raw 0..255
  range DC_DCDC_StopFault: raw 0..1
  range DC_DCDC_TempHighFault: raw 0..1
  range DC_DCDC_WorkMode: raw 0..3
  range DC_EVCOM_ActlOprtMode: raw 0..3
  range DC_EVCOM_CommunicationError: raw 0..1
  range DC_EVCOM_CompActlCnsmpCur: raw 0..255
  range DC_EVCOM_CompActlCnsmpCurValid: raw 0..1
  range DC_EVCOM_CompActlPwrCnsmp: raw 0..255
  range DC_EVCOM_CompActlPwrCnsmpValid: raw 0..1
  range DC_EVCOM_CompActlSpd: raw 0..8191
  range DC_EVCOM_CompActlSpdValid: raw 0..1
  range DC_EVCOM_CompDeratingOprtStatus: raw 0..1
  range DC_EVCOM_CompDeviceInternTempError: raw 0..255
  range DC_EVCOM_FailStatus: raw 0..1
  range DC_EVCOM_OverCurDropFreqError: raw 0..1
  range DC_EVCOM_OverCurrentError: raw 0..1
  range DC_EVCOM_OverPwrDropFreqError: raw 0..1
  range DC_EVCOM_OverVoltageError: raw 0..1
  range DC_EVCOM_StandByOverVolError: raw 0..1
  range DC_EVCOM_StandByUnderVolError: raw 0..1
  range DC_EVCOM_UnderVoltageError: raw 0..1
  range DC_MCU_ActTrqValid: raw 0..1
  range DC_MCU_ActualSpeed: raw 0..65535
  range DC_MCU_ActualSpeedValid: raw 0..1
  range DC_MCU_ActualTorque: raw 0..2047
  range DC_MCU_bDernN: raw 0..1
  range DC_MCU_bDernOvrIdc: raw 0..1
  range DC_MCU_bDernOvrUdc: raw 0..1
  range DC_MCU_bDernStrTemp: raw 0..1
  range DC_MCU_bDernTempCool: raw 0..1
  range DC_MCU_bDernTempIGBT: raw 0..1
  range DC_MCU_bDernTrqMax: raw 0..1
  range DC_MCU_bDernTrqMin: raw 0..1
  range DC_MCU_bDernUndrIdc: raw 0..1
  range DC_MCU_bDernUndrUdc: raw 0..1
  range DC_MCU_bDmpCActv: raw 0..1
  range DC_MCU_bReadyHv: raw 0..1
  range DC_MCU_CAN_Fault: raw 0..255
  range DC_MCU_CodeVer: raw 0..65535
  range DC_MCU_CpldVer: raw 0..65535
  range DC_MCU_DataVer: raw 0..65535
  range DC_MCU_DmpCTrqCurr: raw 0..250
  range DC_MCU_FailCode1: raw 0..7
  range DC_MCU_Hardware_Fault: raw 0..65535
  range DC_MCU_HvMcuVer: raw 0..65535
  range DC_MCU_HwVer: raw 0..65535
  range DC_MCU_IGBTTempMax: raw 0..255
  range DC_MCU_IGBTTempRiseMax: raw 0..255
  range DC_MCU_IGBTTempRiseU: raw 0..255
  range DC_MCU_IGBTTempRiseV: raw 0..255
  range DC_MCU_IGBTTempRiseW: raw 0..255
  range DC_MCU_IGBTTempU: raw 0..255
  range DC_MCU_IGBTTempV: raw 0..255
  range DC_MCU_IGBTTempW: raw 0..255
  range DC_MCU_IsCurr: raw 0..2045
  range DC_MCU_Isd: raw 0..4093
  range DC_MCU_Isq: raw 0..4093
  range DC_MCU_OfsAl: raw 0..4093
  range DC_MCU_Sensor_Fault: raw 0..255
  range DC_MCU_Softwae_FaultBit: raw 0..524287
  range DC_MCU_stDischg: raw 0..3
  range DC_MCU_stGateDrv: raw 0..3
  range DC_MCU_TempCurrCool: raw 0..255
  range DC_MCU_TempCurrStr: raw 0..255
  range DC_MCU_TempCurrStr1: raw 0..255
  range DC_MCU_TempCurrStr2: raw 0..255
  range DC_MCU_TempRiseCurrStr: raw 0..255
  range DC_MCU_TempStatus: raw 0..3
  range DC_MCU_TrqAbsMax: raw 0..2047
  range DC_MCU_TrqAbsMin: raw 0..2047
  range DC_MCU_UdcCurr: raw 0..1021
  range DC_MCU_UT15Curr: raw 0..61
  range DC_MCU_VCUWorkMode: raw 0..15
  range DC_MessageCounter_046: raw 0..15
  range DC_MessageCounter_047: raw 0..15
  range DC_MessageCounter_0A1: raw 0..15
  range DC_MessageCounter_273: raw 0..15
  range DC_MessageCounter_274: raw 0..15
  range DC_MessageCounter_2C0: raw 0..15
  range DC_MessageCounter_2C1: raw 0..7
  range DC_MessageCounter_375: raw 0..15
  range DC_MessageCounter_5: raw 0..15
  range DC_MessageCounter_7A: raw 0..15
  range DC_MessageCounter_AE: raw 0..15
  range DC_MessageCounter_AF: raw 0..15
  range DC_MMI_AC_OnKey: raw 0..1
  range DC_MMI_AcKey: raw 0..1
  range DC_MMI_AirConditionerPowerKey: raw 0..1
  range DC_MMI_AirDistributionModeReq: raw 0..7
  range DC_MMI_AqsKey: raw 0..1
  range DC_MMI_AutoKey: raw 0..1
  range DC_MMI_BlowerFanLevel: raw 0..15
  range DC_MMI_DualKey: raw 0..1
  range DC_MMI_FreshReciKey: raw 0..1
  range DC_MMI_FrontDefrostKey: raw 0..1
  range DC_MMI_IONIZERKey: raw 0..1
  range DC_MMI_LeftSetTemp: raw 0..29
  range DC_MMI_MaxAcKey: raw 0..1
  range DC_MMI_PM25Key: raw 0..1
  range DC_MMI_PM25PopupActive: raw 0..1
  range DC_MMI_PM25PopupOperationSts: raw 0..3
  range DC_MMI_RightSetTemp: raw 0..29
  range DC_OBC_ACPortTempA: raw 0..255
  range DC_OBC_ACPortTempASensValid: raw 0..2
  range DC_OBC_ACPortTempB: raw 0..255
  range DC_OBC_ACPortTempBSensValid: raw 0..2
  range DC_OBC_ACVoltHighFault: raw 0..1
  range DC_OBC_ACVoltLowFault: raw 0..1
  range DC_OBC_CCCurrentLimit: raw 0..255
  range DC_OBC_CCStatus: raw 0..7
  range DC_OBC_ChargCapacibility: raw 0..2
  range DC_OBC_ChargeStatus: raw 0..7
  range DC_OBC_ChrgOutpPwrAvl: raw 0..255
  range DC_OBC_ComFault1: raw 0..1
  range DC_OBC_ComFault2: raw 0..1
  range DC_OBC_CommunFault: raw 0..1
  range DC_OBC_CPCurrentLimit: raw 0..255
  range DC_OBC_CPDuty: raw 0..255
  range DC_OBC_CPFrequency: raw 0..2000
  range DC_OBC_CPStatus: raw 0..7
  range DC_OBC_DCCurHighFault: raw 0..1
  range DC_OBC_DCCurLowFault: raw 0..1
  range DC_OBC_DCVoltHighFault: raw 0..1
  range DC_OBC_DCVoltLowFault: raw 0..1
  range DC_OBC_DSPError: raw 0..1
  range DC_OBC_EMLockState: raw 0..2
  range DC_OBC_FaultLevel: raw 0..3
  range DC_OBC_HWFault: raw 0..1
  range DC_OBC_InputACCurrent: raw 0..5000
  range DC_OBC_InputACVoltage: raw 0..65535
  range DC_OBC_InputFrequencyStatus: raw 0..1
  range DC_OBC_InputOverCurrentstatus_R: raw 0..1
  range DC_OBC_InputOverCurrentstatus_S: raw 0..1
  range DC_OBC_InputOverCurrentstatus_T: raw 0..1
  range DC_OBC_InputPhaseStatus: raw 0..1
  range DC_OBC_NlineStatus: raw 0..1
  range DC_OBC_OBCMaxPermOutpCrrt: raw 0..400
  range DC_OBC_OutputDCChargeCurrent: raw 0..5000
  range DC_OBC_OutputDCChargeVoltage: raw 0..8191
  range DC_OBC_OutputShortError: raw 0..1
  range DC_OBC_PFCOverVoltageError: raw 0..1
  range DC_OBC_PFCUnderVoltageError: raw 0..1
  range DC_OBC_PrimarySideOvertempStatus: raw 0..1
  range DC_OBC_PrimarySideTemp: raw 0..250
  range DC_OBC_S2State: raw 0..2
  range DC_OBC_SecondarySideTemp: raw 0..250
  range DC_OBC_SecordarySideOvertempStatus: raw 0..1
  range DC_OBC_StartUpAllowed: raw 0..1
  range DC_POD_DCFCCurrent: raw 0..2047
  range DC_POD_DCFCVoltage: raw 0..8191
  range DC_POD_DCInletTempA: raw 0..255
  range DC_POD_DCInletTempB: raw 0..255
  range DC_POD_DCNegRelayState: raw 0..2
  range DC_POD_DCPortInletTempAValid: raw 0..2
  range DC_POD_DCPortInletTempBValid: raw 0..2
  range DC_POD_DCPosRelayState: raw 0..2
  range DC_POD_faultTemp: raw 0..1
  range DC_POD_Temperature: raw 0..255
  range DC_POD_TempSensor1Fault: raw 0..1
  range DC_TCU_AmbientTemperature: raw 0..255
  range DC_TCU_APTC1Enable: raw 0..1
  range DC_TCU_APTCLeftCmd: raw 0..100
  range DC_TCU_APTCRightCmd: raw 0..100
  range DC_TCU_APTCState: raw 0..3
  range DC_TCU_BattTMState: raw 0..7
  range DC_TCU_CompEnable: raw -1..0
  range DC_TCU_CompMaxAllowPwrCmsp: raw 0..127
  range DC_TCU_CompTargetSpeed: raw 0..4095
  range DC_TCU_EVCompState: raw 0..3
  range DC_TCU_HVACACState: raw 0..3
  range DC_TCU_HVCHHighVoltage: raw 0..255
  range DC_TCU_HVCHHVDCCurrent: raw 0..254
  range DC_TCU_HVCHState: raw 0..3
  range DC_TCU_HvOnReq: raw 0..1
  range DC_TCU_HVPwrState: raw 0..3
  range DC_TCU_TMSFaultLevel: raw 0..7
  range DC_TCU_TMSState: raw 0..15
  range DC_TCU_TMSTotoalPwrReq: raw 0..200
  range DC_UDS_EPT_BootCmd{1..3}: raw 0..255
  range DC_Uds_EPT_bootResponse_Byte{0..7}: raw 0..255
  range DC_VCU_ActualGear: raw 0..7
  range DC_VCU_BrakepedalStatus: raw 0..1
  range DC_VCU_Chargestatus: raw 0..11
  range DC_VCU_Enable_DC_Relay: raw 0..1
  range DC_VCU_EnableOBC: raw 0..3
  range DC_VCU_HVStatus: raw 0..15
  range DC_VCU_IsoMeasurementSwitch: raw 0..1
  range DC_VCU_KL15On: raw 0..1
  range DC_VCU_MaxTorqueGradient: raw 0..16383
  range DC_VCU_MaxTorqueLimit: raw 0..2047
  range DC_VCU_MCUDesiredTorque: raw 0..2047
  range DC_VCU_MCURequestedState: raw 0..15
  range DC_VCU_MCUSurgeDamperState: raw 0..3
  range DC_VCU_MinTorqueLimit: raw 0..2047
  range DC_VCU_ModeRequestDCDC: raw 0..7
  range DC_VCU_OBC_ChargeCurrentCommand: raw 0..5000
  range DC_VCU_OBC_Control_of_em_lock: raw 0..1
  range DC_VCU_OBC_Control_of_S2_SW: raw 0..1
  range DC_VCU_RequestedModeBMS: raw 0..7
  range DC_VCU_RequestedModeTCU: raw 0..3
  range DC_VCU_TCSActive: raw 0..1
  range DC_VCU_TCUPowerAllowed: raw 0..255
  range DC_VCU_TrqThresholdDampgCtl: raw 0..255
  range DC_VCU_VoltageDemandLV: raw 0..511
  range DC_AC_AirDistributionMode: raw 0..7
  range DC_AC_BlowerLevel: raw 0..15
  range DC_AC_FrontDefrostState: raw 0..1
  range DC_AC_IntakeAirState: raw 0..3
  range DC_AC_LeftSetTemperature: raw 0..31
  range DC_AC_MaxAcState: raw 0..1
  range DC_AC_OnState: raw 0..1
  range DC_ACC_ComfortLowBand: raw 0..255
  range DC_ACC_ComfortUpBand: raw 0..255
  range DC_ACC_DeceToStop_Request: raw 0..1
  range DC_ACC_Driveoff_Request: raw 0..1
  range DC_ACC_MaxJerkA: raw 0..127
  range DC_ACC_MinJerkA: raw 0..127
  range DC_ACC_Mode: raw 0..7
  range DC_ACC_ParkShiftReq: raw 0..1
  range DC_ACC_TargetAcceleration: raw 0..255
  range DC_ACU_DrvSeatbeltBucklestatus: raw 0..1
  range DC_ACU_PassSeatbeltBucklestatus: raw 0..1
  range DC_ADAS_ReqValid: raw 0..1
  range DC_ADAS_State: raw 0..1
  range DC_ADAS_SteeringAngleReq: raw 0..14760
  range DC_ADAS_SteeringWheel_Vibration: raw 0..1
  range DC_ADAS_SteerSpeedReq: raw 0..54
  range DC_ADAS_WorkModeReq: raw 0..15
  range DC_AEB_ABALevel: raw 0..3
  range DC_AEB_ABAReq: raw 0..1
  range DC_AEB_ABPReq: raw 0..1
  range DC_AEB_AWB_eq: raw 0..1
  range DC_AEB_AWB_Level: raw 0..15
  range DC_AEB_BrakeReqFunction: raw 0..7
  range DC_AEB_TargetDecel_eq: raw 0..1
  range DC_AEB_TargetDecel_ReqValue: raw 0..65535
  range DC_AEB_VehHldReq: raw 0..1
  range DC_APA_APAMode: raw 0..15
  range DC_APA_GearShiftReq: raw 0..7
  range DC_APA_SpeedLimit: raw 0..127
  range DC_APA_StopDistance: raw 0..4095
  range DC_BBF_failurestatus: raw 0..1
  range DC_BCM_FrontLeftDoorAjarStatus: raw 0..1
  range DC_BMS_DisChgCurr: raw 0..20000
  range DC_BMS_FeedbackCurr: raw 0..20000
  range DC_BMS_RemainCapacity: raw 0..250
  range DC_Checksum_101: raw 0..255
  range DC_Checksum_130: raw 0..255
  range DC_Checksum_131: raw 0..255
  range DC_Checksum_151: raw 0..255
  range DC_Checksum_152: raw 0..255
  range DC_Checksum_1A{1..3}: raw 0..255
  range DC_Checksum_27A: raw 0..255
  range DC_Checksum_27B: raw 0..255
  range DC_Checksum_27E: raw 0..255
  range DC_Checksum_27F: raw 0..255
  range DC_Checksum_340: raw 0..255
  range DC_Checksum_59: raw 0..255
  range DC_Checksum_5A: raw 0..255
  range DC_Checksum_5B: raw 0..255
  range DC_Checksum_5C: raw 0..255
  range DC_Checksum_5D: raw 0..255
  range DC_Checksum_5E: raw 0..255
  range DC_Checksum_5F: raw 0..255
  range DC_Checksum_6A: raw 0..255
  range DC_Checksum_7A: raw 0..255
  range DC_DCDC_InternalFault: raw 0..1
  range DC_DCDC_OBC_CANBusoff: raw 0..1
  range DC_DCDC_PrimarySideOvertempStatus: raw 0..1
  range DC_DCDC_SecordarySideOvertempStatus: raw 0..1
  range DC_DM1_Byte{0..7}: raw 0..255
  range DC_DM2_Byte{0..7}: raw 0..255
  range DC_DM3_Byte{0..7}: raw 0..255
  range DC_EBA_TargetDecelReq: raw 0..1
  range DC_EGSM_Pbutton: raw 0..3
  range DC_EGSM_ShifterLevelFailSts: raw 0..7
  range DC_EGSM_ShifterLevelPosition: raw 0..7
  range DC_EPB_failurestatus: raw 0..1
  range DC_EPS_Iq: raw 0..20000
  range DC_EPS_SteeringwheelAngle: raw 0..14760
  range DC_EPS_SteeringwheelAngleSpeed: raw 0..54
  range DC_EPS_WorkMode: raw 0..15
  range DC_GSM_AliveCounter: raw 0..15
  range DC_IBS_ABSACTIVEABS: raw 0..1
  range DC_IBS_ABSFault: raw 0..1
  range DC_IBS_AEBActive: raw 0..1
  range DC_IBS_AVHActive: raw 0..1
  range DC_IBS_AVHAvailable: raw 0..1
  range DC_IBS_AVHStandbySts: raw 0..1
  range DC_IBS_BrakeLightRequest: raw 0..3
  range DC_IBS_BrakepedalStatus: raw 0..1
  range DC_IBS_BrakePushrodStroke: raw 0..3328
  range DC_IBS_CDPActive: raw 0..1
  range DC_IBS_CDPAvailable: raw 0..1
  range DC_IBS_EBDActive: raw 0..1
  range DC_IBS_EBDFault: raw 0..1
  range DC_IBS_ECDActive: raw 0..1
  range DC_IBS_EPBFailureLamp: raw 0..3
  range DC_IBS_EPBFunctionLamp: raw 0..3
  range DC_IBS_EPBSwitchPosition: raw 0..3
  range DC_IBS_EPBSwitchPositionValid: raw 0..1
  range DC_IBS_EPBTxtdisplay: raw 0..15
  range DC_IBS_EPBworkingStatus: raw 0..3
  range DC_IBS_ESCLateralAccle: raw 0..65535
  range DC_IBS_ESCLongitudinalAccle: raw 0..65535
  range DC_IBS_ESCYawRate: raw 0..65534
  range DC_IBS_ESPEnableSts: raw 0..1
  range DC_IBS_ESPInfoLamp: raw 0..1
  range DC_IBS_FLMovingDirection: raw 0..3
  range DC_IBS_FLWheelPulseCounter: raw 0..255
  range DC_IBS_FLWheelSpeed: raw 0..6400
  range DC_IBS_FLWheelSpeed_Fault: raw 0..1
  range DC_IBS_FRMovingDirection: raw 0..3
  range DC_IBS_FRWheelPulseCounter: raw 0..255
  range DC_IBS_FRWheelSpeed: raw 0..6400
  range DC_IBS_FRWheelSpeedFault: raw 0..1
  range DC_IBS_HDCActive: raw 0..3
  range DC_IBS_HDCAvailable: raw 0..1
  range DC_IBS_HHCActive: raw 0..1
  range DC_IBS_HHCAvailable: raw 0..1
  range DC_IBS_LiquidAlarm: raw 0..1
  range DC_IBS_MasterCylinderPressure: raw 0..2500
  range DC_IBS_PlungerPressure: raw 0..2500
  range DC_IBS_RBSSTATUS: raw 0..1
  range DC_IBS_RLMovingDirection: raw 0..3
  range DC_IBS_RLWheelPulseCounter: raw 0..255
  range DC_IBS_RLWheelSpeed: raw 0..6400
  range DC_IBS_RLWheelSpeed_Fault: raw 0..1
  range DC_IBS_RRMovingDirection: raw 0..3
  range DC_IBS_RRWheelPulseCounter: raw 0..255
  range DC_IBS_RRWheelSpeed: raw 0..6400
  range DC_IBS_RRWheelSpeed_Fault: raw 0..1
  range DC_IBS_TCSActive: raw 0..1
  range DC_IBS_TCSFault: raw 0..1
  range DC_IBS_TorqueIncreaseRequest: raw 0..17400
  range DC_IBS_TorqueIncreaseStatus: raw 0..1
  range DC_IBS_TorqueRBSReq: raw 0..65535
  range DC_IBS_TorqueRBSReqValid: raw 0..3
  range DC_IBS_TorqueReductionRequest: raw 0..17400
  range DC_IBS_TorqueReductionRequestValid: raw 0..1
  range DC_IBS_VDCActive: raw 0..1
  range DC_IBS_VDCFault: raw 0..1
  range DC_IBS_VehicleSpeed: raw 0..6400
  range DC_IBS_VehiclespeedValid: raw 0..1
  range DC_IBS_VehicleStandstill: raw 0..1
  range DC_IBS_VehicleStandstill_Valid: raw 0..1
  range DC_IBS_VLCTorqueRequest: raw 0..2047
  range DC_IBS_VLCTorqueRequestValid: raw 0..1
  range DC_MessageCounter_101: raw 0..15
  range DC_MessageCounter_130: raw 0..15
  range DC_MessageCounter_131: raw 0..15
  range DC_MessageCounter_151: raw 0..7
  range DC_MessageCounter_152: raw 0..7
  range DC_MessageCounter_1A{1..3}: raw 0..15
  range DC_MessageCounter_27A: raw 0..7
  range DC_MessageCounter_27B: raw 0..7
  range DC_MessageCounter_27E: raw 0..7
  range DC_MessageCounter_27F: raw 0..7
  range DC_MessageCounter_340: raw 0..15
  range DC_MessageCounter_59: raw 0..15
  range DC_MessageCounter_5A: raw 0..15
  range DC_MessageCounter_5B: raw 0..15
  range DC_MessageCounter_5C: raw 0..15
  range DC_MessageCounter_5D: raw 0..15
  range DC_MessageCounter_5E: raw 0..15
  range DC_MessageCounter_5F: raw 0..15
  range DC_MessageCounter_6A: raw 0..15
  range DC_MMI_DriverModeReq: raw 0..7
  range DC_OBC_ACPortTempAerror: raw 0..1
  range DC_OBC_ACPortTempBerror: raw 0..1
  range DC_OBC_DCDC_KL30Error: raw 0..1
  range DC_OBC_internalFault: raw 0..1
  range DC_PEPS_Message_Sts_AliveCounter: raw 0..15
  range DC_PEPS_Message_Sts_Checksum: raw 0..255
  range DC_PEPS_PowerMode: raw 0..7
  range DC_PEPS_PowerModeValidity: raw 0..3
  range DC_PWT_ErrorLevel: raw 0..15
  range DC_remainChrgTime: raw 0..1023
  range DC_TCU_ambientTemperature: raw 0..255
  range DC_VCU_AccelerationPedal: raw 0..1000
  range DC_VCU_AccelerationPedalValid: raw 0..1
  range DC_VCU_ActDriverMode: raw 0..7
  range DC_VCU_ActiveEnergyProfile: raw 0..7
  range DC_VCU_ActiveRgnBrkProfile: raw 0..7
  range DC_VCU_ActTrqValid: raw 0..1
  range DC_VCU_ActualSpeed: raw 0..65535
  range DC_VCU_ActualTorque: raw 0..2047
  range DC_VCU_AvaDrvRange: raw 0..1023
  range DC_VCU_AVHActivereq: raw 0..1
  range DC_VCU_BMS_Control_of_NegRelay: raw 0..3
  range DC_VCU_chrgSystemStatus: raw 0..7
  range DC_VCU_CriSysFailure: raw 0..1
  range DC_VCU_cruiseControlSetUnit: raw 0..1
  range DC_VCU_CruiseControlStatus: raw 0..7
  range DC_VCU_currentFromExtChargerAc: raw 0..4095
  range DC_VCU_currentFromExtChargerDc: raw 0..4095
  range DC_VCU_DCDCFail: raw 0..1
  range DC_VCU_DegradedHVCharging: raw 0..1
  range DC_VCU_DegradedPerformance: raw 0..1
  range DC_VCU_DegradedRegenBraking: raw 0..1
  range DC_VCU_DriveMotOverSpd: raw 0..1
  range DC_VCU_DriveMotOvrTemp: raw 0..1
  range DC_VCU_driverTorqueRequest: raw 0..2045
  range DC_VCU_DrvDirCtrlFlt: raw 0..1
  range DC_VCU_DrvModSwitchWarn: raw 0..7
  range DC_VCU_DynamicMileage: raw 0..500
  range DC_VCU_EnergyChargeSession: raw 0..2047
  range DC_VCU_EnergyReturnedRegen: raw 0..1000
  range DC_VCU_EPBAppliedReq: raw 0..1
  range DC_VCU_faultChrgMultPlugs: raw 0..1
  range DC_VCU_FrMotorSpd: raw 0..255
  range DC_VCU_HVBatCoolOvrTemp: raw 0..1
  range DC_VCU_HVBatCriFail: raw 0..1
  range DC_VCU_HVBatCurrent_VCU: raw 0..16383
  range DC_VCU_HVBatLowSocWar: raw 0..1
  range DC_VCU_HVBatOvrTemp: raw 0..1
  range DC_VCU_HVBatTargetSoC: raw 0..255
  range DC_VCU_HVBatUndTemp: raw 0..1
  range DC_VCU_HVBatVolt_VCU: raw 0..4095
  range DC_VCU_HVILError: raw 0..1
  range DC_VCU_HVInsulResFault: raw 0..1
  range DC_VCU_InvldGearSel: raw 0..15
  range DC_VCU_IsCurr: raw 0..2045
  range DC_VCU_LimpHome: raw 0..1
  range DC_VCU_MCUPower: raw 0..400
  range DC_VCU_NeutralLockExitReason: raw 0..7
  range DC_VCU_NeutralLockStatus: raw 0..3
  range DC_VCU_OdometerInfo_VCU: raw 0..1048575
  range DC_VCU_onepedalstatusActive: raw 0..1
  range DC_VCU_OPStandstillReq: raw 0..1
  range DC_VCU_PtCrashStatus: raw 0..3
  range DC_VCU_RegenBrakeLightRequest: raw 0..1
  range DC_VCU_regenBrakeLightReqVld: raw 0..1
  range DC_VCU_RegenTorqueActive: raw 0..1
  range DC_VCU_RegenTorqueCap: raw 0..40000
  range DC_VCU_RegenTorqueValid: raw 0..1
  range DC_VCU_RrMotorSpd: raw 0..250
  range DC_VCU_SystemReady: raw 0..1
  range DC_VCU_TargetDeceleration: raw 0..255
  range DC_VCU_TargetGear: raw 0..7
  range DC_VCU_TorqueRequestActive: raw 0..1
  range DC_VCU_TorqueRequestAvailable: raw 0..1
  range DC_VCU_UdcCurr: raw 0..1021
  range DC_VCU_UnavailHVCharging: raw 0..1
  range DC_VCU_UnavailHVChgReason: raw 0..7
  range DC_VCU_UnavailRegenBraking: raw 0..1
  range DC_VCU_VirtualPedal: raw 0..1000
  range DC_VCU_VirtualPedalValid: raw 0..1
  range DC_VCU_VLCTorqueRequestActive: raw 0..1
  range DC_VCU_VLCTorqueRequestAvailable: raw 0..1
  range DC_VCU_voltageFromExtChargerAc: raw 0..2047
  range DC_VCU_voltageFromExtChargerDc: raw 0..2047
  range DC_VCU_WheelTrqACT: raw 0..40000
  range DC_YRS_Ax: raw 0..65535
  range DC_YRS_AxRateFailure: raw 0..1
  range DC_YRS_AxStatus: raw 0..15
  range DC_YRS_Ay: raw 0..65535
  range DC_YRS_AyRateFailure: raw 0..1
  range DC_YRS_AyStatus: raw 0..15
  range DC_YRS_BusOff: raw 0..1
  range DC_YRS_DirectionCalibrationResult: raw 0..7
  range DC_YRS_YawRate: raw 0..65534
  range DC_YRS_YawRateFailure: raw 0..1
  range DC_YRS_YawRateStatus: raw 0..15
  range DC_YRS_ZeroCalibrationResult: raw 0..2
package /DataType/Semantics
  compu method CM_APTC_Core1TempSensorFaltStatus: 0=Cx0_no_error (no error), 1=Cx1_L_sensor_open_ (L sensor open), 2=Cx2_sensor_short (sensor short)
  compu method CM_APTC_Core2TempSensorFaltStatus: 0=Cx0_no_error (no error), 1=Cx1_R_sensor_open_ (R sensor open), 2=Cx2_sensor_short (sensor short)
  compu method CM_APTC_DriveFaltStatus: 0=Cx0_no_error (no error), 1=Cx1_error_
  compu method CM_APTC_HeatingFaltStatus: 0=Cx0_no_error (no error), 1=Cx1_error_
  compu method CM_APTC_HVBusVoltage: phys=raw*0.05 for raw 0..2047; unit V
  compu method CM_APTC_HVPowerUpReq: 0=Cx0_APTC_OK (APTC OK), 1=Cx1_APTC_failure_ (APTC failure)
  compu method CM_APTC_IGBTFaltStatus: 0=Cx0_no_error (no error), 1=Cx1_IGBT1_SHORT_ (IGBT1 SHORT), 2=Cx2_IGBT2_SHORT_ (IGBT2 SHORT), 3=Cx3_BOTH_SHORT (BOTH SHORT)
  compu method CM_APTC_LeftCoreTemp: phys=raw-40 for raw 0..255; unit deg
  compu method CM_APTC_LostCommuFaltStatus: 0=Cx0_no_error (no error), 1=Cx1_TCU_signal_losted_ (TCU signal losted)
  compu method CM_APTC_PowerConsumption: phys=raw*0.04 for raw 0..255; unit KW
  compu method CM_APTC_RightCoreTemp: phys=raw-40 for raw 0..255; unit deg
  compu method CM_BCM_RLHSHumidSensorValue: phys=raw*0.5 for raw 0..200; unit %
  compu method CM_BCM_RLHSSolarDrvr: phys=raw*4 for raw 0..250; unit W/m2
  compu method CM_BCM_RLHSSolarPass: phys=raw*4 for raw 0..250; unit W/m2
  compu method CM_BCM_RLHSTempDewPoint: phys=raw*0.1-40 for raw 0..1600
  compu method CM_BCM_RLHSTempSensorValue: phys=raw*0.5-40 for raw 0..255
  compu method CM_BMS_AbortAchivesetValue: 0=Cx0_not_reached (not reached), 1=Cx1_reached, 2=Cx2_untrustable
  compu method CM_BMS_AbortAchiveSingleVolt: 0=Cx0_not_reached (not reached), 1=Cx1_reached, 2=Cx2_untrustable
  compu method CM_BMS_AbortAchiveTotalVolt: 0=Cx0_not_reached (not reached), 1=Cx1_reached, 2=Cx2_untrustable
  compu method CM_BMS_AbortErrorCurrent: 0=Cx0_normal, 1=Cx1_over_current (over current), 2=Cx2_untrustable
  compu method CM_BMS_AbortErrorVoltage: 0=Cx0_normal, 1=Cx1_abnormal, 2=Cx2_untrustable
  compu method CM_BMS_AbortFaultBatteryTemp: 0=Cx0_normal, 1=Cx1_over_temp (over temp), 2=Cx2_untrustable
  compu method CM_BMS_AbortFaultBMSTemp: 0=Cx0_normal, 1=Cx1_over_temp (over temp), 2=Cx2_untrustable
  compu method CM_BMS_AllowCellTemperature: phys=raw-40 for raw 0..255
  compu method CM_BMS_AllowChagCurrent: phys=raw*0.1-1000 for raw 0..20000; unit A
  compu method CM_BMS_AverageCellTemp: phys=raw-40 for raw 0..255
  compu method CM_BMS_BalanceCommand: 0=Cx0_No_request (No request), 1=Cx1_request_
  compu method CM_BMS_BalancingStatus: 0=Cx0_stop, 1=Cx1_active
  compu method CM_BMS_BatChagSum: identical
  compu method CM_BMS_BatCode{1..6}: identical
  compu method CM_BMS_BatCodeFrameLength: identical
  compu method CM_BMS_BatCodeFrameNO: identical
  compu method CM_BMS_BatProDatDay: identical
  compu method CM_BMS_BatProDatMonth: identical
  compu method CM_BMS_BatProDatYear: phys=raw+1985 for raw 0..-1730
  compu method CM_BMS_BatProRights: 0=Cx0_lease, 1=Cx1_Buy
  compu method CM_BMS_BatStatus: 0=Cx0_power, 1=Cx1_Standby, 2=Cx2_Run, 3=Cx3_Error, 4=Cx4_Shutdown
  compu method CM_BMS_BatSupName: identical
  compu method CM_BMS_BattCurr: phys=raw*0.1-1024 for raw 0..20470
  compu method CM_BMS_BattVolt: phys=raw*0.1 for raw 0..10000
  compu method CM_BMS_BatType: identical
  compu method CM_BMS_BRMVersions: identical
  compu method CM_BMS_CellNumbers: identical
  compu method CM_BMS_ChagComplete: 0=Cx0_Normal_Completion (Normal Completion), 1=Cx1_Abnormal_completion (Abnormal completion), 2=Cx2_Untrustable, 3=Cx3_During_Charging (During Charging)
  compu method CM_BMS_ChargeStatus: 0=Cx0_Not_charging (Not charging), 1=Cx1_Heat_only (Heat only), 2=Cx2_Charge_and_heat_DC_ (Charge and heat(DC)), 3=Cx3_Charge_and_heat_AC_ (Charge and heat(AC)), 4=Cx4_Charge_only_DC_ (Charge only(DC)), 5=Cx5_Charge_only_AC_ (Charge only(AC)), 6=Cx6_Charge_hold (Charge hold), 7=Cx7_Charge_stop (Charge stop)
  compu method CM_BMS_ChgCurrLongTerm: phys=raw*0.1-1000 for raw 0..20000; unit A
  compu method CM_BMS_ChgCurrShortTerm: phys=raw*0.1-1000 for raw 0..20000; unit A
  compu method CM_BMS_ChrgDcChrgnReq: 0=Cx0_invalid, 1=Cx1_no_charging_request (no charging request), 2=Cx2_charging_request (charging request)
  compu method CM_BMS_ComVersion: identical
  compu method CM_BMS_CoolCommand: 0=Cx0_Not_cooling (Not cooling), 1=Cx1_Reserved, 2=Cx2_Charge_and_cool_DC_ (Charge and cool(DC)), 3=Cx3_Charge_and_cool_AC_ (Charge and cool(AC)), 4=Cx4_Running_cool (Running cool), 5=Cx5_Keep_cool (Keep cool), 6=Cx6_Reserved, 7=Cx7_Target_cool (Target cool)
  compu method CM_BMS_DCChgMode: 0=Cx0_ready, 1=Cx1_constant_voltage (constant voltage), 2=Cx2_constant_current (constant current)
  compu method CM_BMS_DisChgCurrLongTerm: phys=raw*0.1-1000 for raw 0..20000; unit A
  compu method CM_BMS_DisChgCurrShortTerm: phys=raw*0.1-1000 for raw 0..20000; unit A
  compu method CM_BMS_DisplaySOC: phys=raw*0.01-550 for raw 55000..65000; unit %
  compu method CM_BMS_DTC: identical
  compu method CM_BMS_ErrorBattOverVolt: 0=Cx0_Normal, 1=Cx1_Fault_Level1 (Fault Level1), 2=Cx2_Fault_Level2 (Fault Level2), 3=Cx3_Fault_Level3 (Fault Level3)
  compu method CM_BMS_ErrorBattUnderVolt: 0=Cx0_Normal, 1=Cx1_Fault_Level1 (Fault Level1), 2=Cx2_Fault_Level2 (Fault Level2), 3=Cx3_Fault_Level3 (Fault Level3)
  compu method CM_BMS_ErrorBatVolt: 0=Cx0_Normal, 1=Cx1_Fault_Level1 (Fault Level1), 2=Cx2_Fault_Level2 (Fault Level2), 3=Cx3_Fault_Level3 (Fault Level3)
  compu method CM_BMS_ErrorBSUBalance: 0=Cx0_Normal_ (Normal;), 1=Cx1_Fault
  compu method CM_BMS_ErrorBSUOffline: 0=Cx0_Normal, 1=Cx1_Fault
  compu method CM_BMS_ErrorCellHighTemp: 0=Cx0_Normal, 1=Cx1_Fault_Level1 (Fault Level1), 2=Cx2_Fault_Level2 (Fault Level2), 3=Cx3_Fault_Level3 (Fault Level3)
  compu method CM_BMS_ErrorCellLowTemp: 0=Cx0_Normal, 1=Cx1_Fault_Level1 (Fault Level1), 2=Cx2_Fault_Level2 (Fault Level2), 3=Cx3_Fault_Level3 (Fault Level3)
  compu method CM_BMS_ErrorCellOverVolt: 0=Cx0_Normal, 1=Cx1_Fault_Level1 (Fault Level1), 2=Cx2_Fault_Level2 (Fault Level2), 3=Cx3_Fault_Level3 (Fault Level3)
  compu method CM_BMS_ErrorCellTempDiff: 0=Cx0_Normal, 1=Cx1_Fault_Level1 (Fault Level1), 2=Cx2_Fault_Level2 (Fault Level2), 3=Cx3_Fault_Level3 (Fault Level3)
  compu method CM_BMS_ErrorCellTempOffline: 0=Cx0_Normal, 1=Cx1_Fault
  compu method CM_BMS_ErrorCellUnderVolt: 0=Cx0_Normal, 1=Cx1_Fault_Level1 (Fault Level1), 2=Cx2_Fault_Level2 (Fault Level2), 3=Cx3_Fault_Level3 (Fault Level3)
  compu method CM_BMS_ErrorCellVoltDiff: 0=Cx0_Normal, 1=Cx1_Fault_Level1 (Fault Level1), 2=Cx2_Fault_Level2 (Fault Level2), 3=Cx3_Fault_Level3 (Fault Level3)
  compu method CM_BMS_ErrorCellVoltOffline: 0=Cx0_Normal_ (Normal;), 1=Cx1_Fault
  compu method CM_BMS_ErrorChaCurrentOver: 0=Cx0_Normal, 1=Cx1_Fault_Level1 (Fault Level1), 2=Cx2_Fault_Level2 (Fault Level2), 3=Cx3_Fault_Level3 (Fault Level3)
  compu method CM_BMS_ErrorDisChaCurrentOver: 0=Cx0_Normal, 1=Cx1_Fault_Level1 (Fault Level1), 2=Cx2_Fault_Level2 (Fault Level2), 3=Cx3_Fault_Level3 (Fault Level3)
  compu method CM_BMS_ErrorEmergencyOffCrash: 0=Cx0_Normal_ (Normal;), 1=Cx1_Fault
  compu method CM_BMS_ErrorHallOffline: 0=Cx0_Normal, 1=Cx1_Fault
  compu method CM_BMS_ErrorHighSoc: 0=Cx0_Normal_ (Normal;), 1=Cx1_Fault
  compu method CM_BMS_ErrorHVIL: 0=Cx0_Normal_ (Normal;), 1=Cx1_Fault
  compu method CM_BMS_ErrorIsolationSingleLow: 0=Cx0_Normal, 1=Cx1_Fault_Level1 (Fault Level1), 2=Cx2_Fault_Level2 (Fault Level2), 3=Cx3_Fault_Level3 (Fault Level3)
  compu method CM_BMS_ErrorLeakCurrent: 0=Cx0_Normal, 1=Cx1_Fault_Level1 (Fault Level1), 2=Cx2_Fault_Level2 (Fault Level2), 3=Cx3_Fault_Level3 (Fault Level3)
  compu method CM_BMS_ErrorLeakDet: 0=Cx0_Normal, 1=Cx1_Fault
  compu method CM_BMS_ErrorLevel: 0=Cx0_Normal, 1=Cx1_level1, 2=Cx2_level2, 3=Cx3_level3, 4=Cx4_level4
  compu method CM_BMS_ErrorLowSOC: 0=Cx0_Normal, 1=Cx1_Fault_Level1 (Fault Level1), 2=Cx2_Fault_Level2 (Fault Level2), 3=Cx3_Fault_Level3 (Fault Level3)
  compu method CM_BMS_ErrorPreChaFailed: 0=Cx0_Normal_ (Normal;), 1=Cx1_Fault
  compu method CM_BMS_ErrorRelay: 0=Cx0_Normal, 1=Cx1_Fault
  compu method CM_BMS_ErrorSmoke: 0=Cx0_Normal_ (Normal;), 1=Cx1_Fault
  compu method CM_BMS_ErrorSoCJump_RM: 0=Cx0_Normal, 1=Cx1_Fault
  compu method CM_BMS_ErrorSystemsMatch: 0=Cx0_Normal_ (Normal;), 1=Cx1_Fault
  compu method CM_BMS_FlowRate: identical
  compu method CM_BMS_HardVsesion: identical
  compu method CM_BMS_HeatCommand: 0=Cx0_Not_heat (Not heat), 1=Cx1_Preheating, 2=Cx2_Charge_and_heat_DC_ (Charge and heat(DC)), 3=Cx3_Charge_and_heat_AC_ (Charge and heat(AC)), 4=Cx4_Running_heat (Running heat), 5=Cx5_Keep_warm (Keep warm), 6=Cx6_Reserved, 7=Cx7_Target_heat (Target heat)
  compu method CM_BMS_HVinterlockState: 0=Cx0_Normal, 1=Cx1_Fault
  compu method CM_BMS_InsulationDetectionStatus: 0=Cx0_stop, 1=Cx1_active
  compu method CM_BMS_Life: identical
  compu method CM_BMS_LinkVoltage: phys=raw*0.1 for raw 0..65535; unit V
  compu method CM_BMS_MaxCellTemp: phys=raw-40 for raw 0..255
  compu method CM_BMS_MaxCellTempModuleNO: identical
  compu method CM_BMS_MaxCellTempNO: identical
  compu method CM_BMS_MaxCellVoltage: phys=raw*0.001 for raw 0..65535; unit V
  compu method CM_BMS_MaxCellVoltageModuleNO: identical
  compu method CM_BMS_MaxCellVoltageNO: identical
  compu method CM_BMS_MaxChagVoltage: phys=raw*0.1 for raw 0..65535; unit V
  compu method CM_BMS_MinCellTemp: phys=raw-40 for raw 0..255
  compu method CM_BMS_MinCellTempModuleNO: identical
  compu method CM_BMS_MinCellTempNO: identical
  compu method CM_BMS_MinCellVoltage: phys=raw*0.001 for raw 0..65535; unit V
  compu method CM_BMS_MinCellVoltageModlueNO: identical
  compu method CM_BMS_MinCellVoltageNO: identical
  compu method CM_BMS_NegRelayStatus: 0=Cx0_Reserved, 1=Cx1_Opened, 2=Cx2_Closed, 3=Cx3_Signal_Invalid (Signal Invalid)
  compu method CM_BMS_PackVoltage: phys=raw*0.1 for raw 0..65535; unit V
  compu method CM_BMS_PosRelayStatus: 0=Cx0_Reserved, 1=Cx1_Opened, 2=Cx2_Closed, 3=Cx3_Signal_Invalid (Signal Invalid)
  compu method CM_BMS_PreCharge: 0=Cx0_Not_precharge (Not precharge), 1=Cx1_Precharging, 2=Cx2_Precharge_finished (Precharge finished), 3=Cx3_Precharge_failed (Precharge failed)
  compu method CM_BMS_PreRelayStatus: 0=Cx0_Reserved, 1=Cx1_Opened, 2=Cx2_Closed, 3=Cx3_Signal_Invalid (Signal Invalid)
  compu method CM_BMS_PTCRelayStatus: 0=Cx0_Reserved, 1=Cx1_Opened, 2=Cx2_Closed, 3=Cx3_Signal_Invalid (Signal Invalid)
  compu method CM_BMS_RatBatVoltage: phys=raw*0.1 for raw 0..65535; unit V
  compu method CM_BMS_RatCapacity: phys=raw*0.1 for raw 0..65535; unit Ah
  compu method CM_BMS_RatEnergy: identical
  compu method CM_BMS_RemChagTime: identical
  compu method CM_BMS_RunHeatStatus: 0=Cx0_Running_heat (Running heat), 1=Cx1_Target_heat (Target heat), 2=Cx2_App_heat (App heat), 3=Cx3_Running_cool (Running cool)
  compu method CM_BMS_SingChgkwh: identical
  compu method CM_BMS_SOC: phys=raw*0.01-550 for raw 55000..65000; unit %
  compu method CM_BMS_SoftVsesion: identical
  compu method CM_BMS_SOH: phys=raw*0.5 for raw 0..200; unit %
  compu method CM_BMS_StateDI{2..8}: identical
  compu method CM_BMS_StateRelay{4..8}: identical
  compu method CM_BMS_status: 0=Cx0_initialize, 1=Cx1_standby, 2=Cx2_running, 3=Cx3_DC_charge (DC charge), 4=Cx4_AC_charge (AC charge), 5=Cx5_Discharge, 6=Cx6_Error, 7=Cx7_Invalid
  compu method CM_BMS_SumChgkwh: identical
  compu method CM_BMS_SumDisChgkwh: identical
  compu method CM_BMS_SysRegInsulationValue: identical
  compu method CM_BMS_TargetBatteryMaxCellTemp: phys=raw-40 for raw 0..255
  compu method CM_BMS_TempInlet: phys=raw-40 for raw 0..255
  compu method CM_BMS_Tempoutlet: phys=raw-40 for raw 0..255
  compu method CM_BMS_ThermalRunawayFault: 0=Cx0_Normal, 1=Cx1_Fault
  compu method CM_BMS_ThermometerProbes: identical
  compu method CM_Checksum_046: identical
  compu method CM_Checksum_047: identical
  compu method CM_Checksum_0A1: identical
  compu method CM_Checksum_273: identical
  compu method CM_Checksum_274: identical
  compu method CM_Checksum_2C0: identical
  compu method CM_Checksum_2C1: identical
  compu method CM_Checksum_375: identical
  compu method CM_Checksum_5: identical
  compu method CM_Checksum_AE: identical
  compu method CM_Checksum_AF: identical
  compu method CM_DCDC_ComFault: 0=Cx0_No_Fault_ (No Fault;), 1=Cx1_Fault
  compu method CM_DCDC_FaultStatus: 0=Cx0_No_Fault (No Fault), 1=Cx1_Fault_Level1 (Fault Level1), 2=Cx2_Fault_Level2 (Fault Level2), 3=Cx3_Fault_Level3 (Fault Level3)
  compu method CM_DCDC_HVInputCurrent: phys=raw*0.1 for raw 0..255; unit A
  compu method CM_DCDC_HVInputVoltage: phys=raw*0.5 for raw 0..2047; unit V
  compu method CM_DCDC_HWFault: 0=Cx0_No_Fault_ (No Fault;), 1=Cx1_Fault
  compu method CM_DCDC_InputVoltHighFault: 0=Cx0_No_Fault (No Fault), 1=Cx1_Fault
  compu method CM_DCDC_InputVoltLowFault: 0=Cx0_No_Fault (No Fault), 1=Cx1_Fault
  compu method CM_DCDC_LVOutputCurrent: phys=raw*0.1 for raw 0..4000; unit A
  compu method CM_DCDC_LVOutputVoltage: phys=raw*0.1 for raw 0..255; unit V
  compu method CM_DCDC_OBCTempHighFault: 0=Cx0_No_Fault (No Fault), 1=Cx1_Fault
  compu method CM_DCDC_OutputCurrentHighFault: 0=Cx0_No_Fault (No Fault), 1=Cx1_Fault
  compu method CM_DCDC_OutputCurrentSensorFault: 0=Cx0_No_Fault_ (No Fault;), 1=Cx1_Fault
  compu method CM_DCDC_OutputSOGFault: 0=Cx0_No_Fault (No Fault), 1=Cx1_Fault
  compu method CM_DCDC_OutputTempSensorFault: 0=Cx0_No_Fault (No Fault), 1=Cx1_Fault
  compu method CM_DCDC_OutputVoltHighFault: 0=Cx0_No_Fault_ (No Fault;), 1=Cx1_Fault
  compu method CM_DCDC_OutputVoltLowFault: 0=Cx0_No_Fault (No Fault), 1=Cx1_Fault
  compu method CM_DCDC_SecondarySideTemp: phys=raw-40 for raw 0..255
  compu method CM_DCDC_StopFault: 0=Cx0_No_Fault_ (No Fault;), 1=Cx1_Fault
  compu method CM_DCDC_TempHighFault: 0=Cx0_No_Fault (No Fault), 1=Cx1_Fault
  compu method CM_DCDC_WorkMode: 0=Cx0_Init, 1=Cx1_Standby, 2=Cx2_Buck, 3=Cx3_Fault
  compu method CM_EVCOM_ActlOprtMode: 0=Cx0_off, 1=Cx1_standby, 2=Cx2_running, 3=Cx3_emrgncy_shutdown (emrgncy shutdown)
  compu method CM_EVCOM_CommunicationError: 0=Cx0_No_Error (No Error), 1=Cx1_Error
  compu method CM_EVCOM_CompActlCnsmpCur: phys=raw*0.2 for raw 0..255; unit A
  compu method CM_EVCOM_CompActlCnsmpCurValid: 0=Cx0_Invalid, 1=Cx1_Valid
  compu method CM_EVCOM_CompActlPwrCnsmp: phys=raw*0.04 for raw 0..255; unit KW
  compu method CM_EVCOM_CompActlPwrCnsmpValid: 0=Cx0_Invalid, 1=Cx1_Valid
  compu method CM_EVCOM_CompActlSpd: identical
  compu method CM_EVCOM_CompActlSpdValid: 0=Cx0_Invalid, 1=Cx1_Valid
  compu method CM_EVCOM_CompDeratingOprtStatus: 0=Cx0_Derating_off_ (Derating off;), 1=Cx1_Derating_on (Derating on)
  compu method CM_EVCOM_CompDeviceInternTempError: phys=raw-40 for raw 0..255
  compu method CM_EVCOM_FailStatus: 0=Cx0_No_Error_ (No Error;), 1=Cx1_Error
  compu method CM_EVCOM_OverCurDropFreqError: 0=Cx0_No_Error (No Error), 1=Cx1_Error
  compu method CM_EVCOM_OverCurrentError: 0=Cx0_No_Error (No Error), 1=Cx1_Error
  compu method CM_EVCOM_OverPwrDropFreqError: 0=Cx0_No_Error (No Error), 1=Cx1_Error
  compu method CM_EVCOM_OverVoltageError: 0=Cx0_No_Error (No Error), 1=Cx1_Error
  compu method CM_EVCOM_StandByOverVolError: 0=Cx0_No_Error (No Error), 1=Cx1_Error
  compu method CM_EVCOM_StandByUnderVolError: 0=Cx0_No_Error (No Error), 1=Cx1_Error
  compu method CM_EVCOM_UnderVoltageError: 0=Cx0_No_Error (No Error), 1=Cx1_Error
  compu method CM_MCU_ActTrqValid: 0=Cx0_invalid, 1=Cx1_valid
  compu method CM_MCU_ActualSpeed: phys=raw-32768 for raw 0..65535
  compu method CM_MCU_ActualSpeedValid: 0=Cx0_invalid, 1=Cx1_valid
  compu method CM_MCU_ActualTorque: phys=raw-1024 for raw 0..2047
  compu method CM_MCU_bDernN: 0=Cx0_Normal_, 1=Cx1_Derating
  compu method CM_MCU_bDernOvrIdc: 0=Cx0_Normal_, 1=Cx1_Derating
  compu method CM_MCU_bDernOvrUdc: 0=Cx0_Normal_, 1=Cx1_Derating
  compu method CM_MCU_bDernStrTemp: 0=Cx0_Normal_, 1=Cx1_Derating
  compu method CM_MCU_bDernTempCool: 0=Cx0_Normal_, 1=Cx1_Derating
  compu method CM_MCU_bDernTempIGBT: 0=Cx0_Normal_, 1=Cx1_Derating
  compu method CM_MCU_bDernTrqMax: 0=Cx0_Normal_, 1=Cx1_Derating
  compu method CM_MCU_bDernTrqMin: 0=Cx0_Normal_, 1=Cx1_Derating
  compu method CM_MCU_bDernUndrIdc: 0=Cx0_Normal_, 1=Cx1_Derating
  compu method CM_MCU_bDernUndrUdc: 0=Cx0_Normal_, 1=Cx1_Derating
  compu method CM_MCU_bDmpCActv: 0=Cx0_Damping_On (Damping On), 1=Cx1_Damping_Off (Damping Off)
  compu method CM_MCU_bReadyHv: 0=Cx0_PreCharge_Not_Finished (PreCharge Not Finished), 1=Cx1_Precharge_Finished (Precharge Finished)
  compu method CM_MCU_CAN_Fault: identical
  compu method CM_MCU_CodeVer: identical
  compu method CM_MCU_CpldVer: identical
  compu method CM_MCU_DataVer: identical
  compu method CM_MCU_DmpCTrqCurr: phys=raw*0.1 for raw 0..250; unit Nm
  compu method CM_MCU_FailCode1: 0=Cx0_No_Fault (No Fault), 1=Cx1_Fault_Level1 (Fault Level1), 2=Cx2_Fault_Level2 (Fault Level2), 3=Cx3_Fault_Level3 (Fault Level3), 4=Cx4_Fault_Level4 (Fault Level4)
  compu method CM_MCU_Hardware_Fault: identical
  compu method CM_MCU_HvMcuVer: identical
  compu method CM_MCU_HwVer: identical
  compu method CM_MCU_IGBTTempMax: phys=raw-50 for raw 0..255
  compu method CM_MCU_IGBTTempRiseMax: identical
  compu method CM_MCU_IGBTTempRiseU: identical
  compu method CM_MCU_IGBTTempRiseV: identical
  compu method CM_MCU_IGBTTempRiseW: identical
  compu method CM_MCU_IGBTTempU: phys=raw-50 for raw 0..255
  compu method CM_MCU_IGBTTempV: phys=raw-50 for raw 0..255
  compu method CM_MCU_IGBTTempW: phys=raw-50 for raw 0..255
  compu method CM_MCU_IsCurr: phys=raw*0.5 for raw 0..2045
  compu method CM_MCU_Isd: phys=raw*0.5-1023.5 for raw 0..4093
  compu method CM_MCU_Isq: phys=raw*0.5-1023.5 for raw 0..4093
  compu method CM_MCU_OfsAl: phys=raw*0.0878906 for raw 0..4093
  compu method CM_MCU_Sensor_Fault: identical
  compu method CM_MCU_Softwae_FaultBit: identical
  compu method CM_MCU_stDischg: 0=Cx0_Standby, 1=Cx1_Active, 2=Cx2_Finished, 3=Cx3_Failed
  compu method CM_MCU_stGateDrv: 0=Cx0_ASC, 1=Cx1_FreeWheel, 2=Cx2_PWMrun
  compu method CM_MCU_TempCurrCool: phys=raw-50 for raw 0..255
  compu method CM_MCU_TempCurrStr: phys=raw-50 for raw 0..255
  compu method CM_MCU_TempCurrStr1: phys=raw-50 for raw 0..255
  compu method CM_MCU_TempCurrStr2: phys=raw-50 for raw 0..255
  compu method CM_MCU_TempRiseCurrStr: identical
  compu method CM_MCU_TempStatus: 0=Cx0_Normal_Temperature (Normal Temperature), 1=Cx1_Heating_alarm_1 (Heating alarm 1), 2=Cx2_Heating_alarm_2 (Heating alarm 2), 3=Cx3_Over_Heating (Over Heating)
  compu method CM_MCU_TrqAbsMax: phys=raw-1024 for raw 0..2047
  compu method CM_MCU_TrqAbsMin: phys=raw-1024 for raw 0..2047
  compu method CM_MCU_UdcCurr: identical
  compu method CM_MCU_UT15Curr: phys=raw*0.5 for raw 0..61
  compu method CM_MCU_VCUWorkMode: 0=Cx0_Initialization, 1=Cx1_Standby, 2=Cx2_Ready, 3=Cx3_Torque_Control (Torque Control), 4=Cx4_Shutdown, 5=Cx5_ActiveDischarge, 6=Cx6_Afterrun, 7=Cx7_Motor_Active_Hearting (Motor Active Hearting), 8=Cx8_Speed_Control (Speed Control)
  compu method CM_MessageCounter_046: identical
  compu method CM_MessageCounter_047: identical
  compu method CM_MessageCounter_0A1: identical
  compu method CM_MessageCounter_273: identical
  compu method CM_MessageCounter_274: identical
  compu method CM_MessageCounter_2C0: identical
  compu method CM_MessageCounter_2C1: identical
  compu method CM_MessageCounter_375: identical
  compu method CM_MessageCounter_5: identical
  compu method CM_MessageCounter_7A: identical
  compu method CM_MessageCounter_AE: identical
  compu method CM_MessageCounter_AF: identical
  compu method CM_MMI_AC_OnKey: 0=Cx0_Not_Pressed (Not Pressed), 1=Cx1_Pressed
  compu method CM_MMI_AcKey: 0=Cx0_Not_Pressed (Not Pressed), 1=Cx1_Pressed
  compu method CM_MMI_AirConditionerPowerKey: 0=Cx0_Not_Pressed (Not Pressed), 1=Cx1_Pressed
  compu method CM_MMI_AirDistributionModeReq: 0=Cx0_Face, 1=Cx1_Bilevel_Foot_face_ (Bilevel(Foot face)), 2=Cx2_Foot, 3=Cx3_Foot_Screen (Foot Screen), 4=Cx4_Screen, 5=Cx5_Reserved, 6=Cx6_Reserved, 7=Cx7_Not_set (Not set)
  compu method CM_MMI_AqsKey: 0=Cx0_Not_Pressed (Not Pressed), 1=Cx1_Pressed
  compu method CM_MMI_AutoKey: 0=Cx0_Not_Pressed (Not Pressed), 1=Cx1_Pressed
  compu method CM_MMI_BlowerFanLevel: 0=Cx0_Off_Reserved (Off(Reserved), 1=Cx1_Blower_Level1 (Blower Level1), 2=Cx2_Blower_Level2 (Blower Level2), 3=Cx3_Blower_Level3 (Blower Level3), 4=Cx4_Blower_Level4 (Blower Level4), 5=Cx5_Blower_Level5 (Blower Level5), 6=Cx6_Blower_Level6 (Blower Level6), 7=Cx7_Blower_Level7 (Blower Level7), 8=Cx8_Blower_Level8 (Blower Level8), 15=CxF_Not_set (Not set)
  compu method CM_MMI_DualKey: 0=Cx0_Not_Pressed (Not Pressed), 1=Cx1_Pressed
  compu method CM_MMI_FreshReciKey: 0=Cx0_Not_Pressed (Not Pressed), 1=Cx1_Pressed
  compu method CM_MMI_FrontDefrostKey: 0=Cx0_Not_Pressed (Not Pressed), 1=Cx1_Pressed
  compu method CM_MMI_IONIZERKey: 0=Cx0_Not_Pressed (Not Pressed), 1=Cx1_Pressed
  compu method CM_MMI_LeftSetTemp: 0=Cx00_Lo, 1=Cx01_17_5 (17.5), 2=Cx02_18, 16=Cx10_Hi, phys=raw*0.5+17 for raw 3..29
  compu method CM_MMI_MaxAcKey: 0=Cx0_Not_Pressed (Not Pressed), 1=Cx1_Pressed
  compu method CM_MMI_PM25Key: 0=Cx0_Not_Pressed (Not Pressed), 1=Cx1_Pressed
  compu method CM_MMI_PM25PopupActive: 0=Cx0_Not_Pressed (Not Pressed), 1=Cx1_Pressed
  compu method CM_MMI_PM25PopupOperationSts: identical
  compu method CM_MMI_RightSetTemp: 0=Cx00_Lo, 1=Cx01_17_5 (17.5), 2=Cx02_18, 16=Cx10_Hi, phys=raw*0.5+17 for raw 3..29
  compu method CM_OBC_ACPortTempA: phys=raw-40 for raw 0..255
  compu method CM_OBC_ACPortTempASensValid: 0=Cx0_Damage, 1=Cx1_Short_Circuit_ (Short Circuit), 2=Cx2_Normal_
  compu method CM_OBC_ACPortTempB: phys=raw-40 for raw 0..255
  compu method CM_OBC_ACPortTempBSensValid: 0=Cx0_Damage, 1=Cx1_Short_Circuit_ (Short Circuit), 2=Cx2_Normal_
  compu method CM_OBC_ACVoltHighFault: 0=Cx0_No_Fault_ (No Fault;), 1=Cx1_Fault
  compu method CM_OBC_ACVoltLowFault: 0=Cx0_No_Fault_ (No Fault;), 1=Cx1_Fault
  compu method CM_OBC_CCCurrentLimit: phys=raw*0.4 for raw 0..255; unit A
  compu method CM_OBC_CCStatus: 0=Cx0_Unconnected, 1=Cx1_Half_connected (Half-connected), 2=Cx2_1500_Ohm_ (1500 Ohm), 3=Cx3_680_Ohm_ (680 Ohm), 4=Cx4_220_Ohm (220 Ohm), 5=Cx5_100_Ohm (100 Ohm), 6=Cx6_2000_Ohm (2000 Ohm), 7=Cx7_Fault
  compu method CM_OBC_ChargCapacibility: 0=Cx0_single_phase (single-phase), 1=Cx1_Three_phase (Three-phase), 2=Cx2_Error
  compu method CM_OBC_ChargeStatus: 0=Cx0_Init, 1=Cx1_Standby, 2=Cx2_Ready, 3=Cx3_Charging_Mode (Charging Mode), 4=Cx4_Pre_heating_Mode (Pre-heating Mode), 5=Cx5_V2L_Mode (V2L Mode), 6=Cx6_Sleep, 7=Cx7_Fault
  compu method CM_OBC_ChrgOutpPwrAvl: phys=raw*0.1 for raw 0..255; unit KW
  compu method CM_OBC_ComFault1: 0=Cx0_No_Fault_ (No Fault;), 1=Cx1_Fault
  compu method CM_OBC_ComFault2: 0=Cx0_No_Fault_ (No Fault;), 1=Cx1_Fault
  compu method CM_OBC_CommunFault: 0=Cx0_No_Fault_ (No Fault;), 1=Cx1_Fault
  compu method CM_OBC_CPCurrentLimit: phys=raw*0.4 for raw 0..255; unit A
  compu method CM_OBC_CPDuty: identical
  compu method CM_OBC_CPFrequency: identical
  compu method CM_OBC_CPStatus: 0=Cx0_Unconnected, 1=Cx1_9V, 2=Cx2_9V_PWM (9V PWM), 3=Cx3_6V, 4=Cx4_6V_PWM (6V PWM), 5=Cx5_Fault, 6=Cx6_Reserve, 7=Cx7_Reserve
  compu method CM_OBC_DCCurHighFault: 0=Cx0_No_Fault_ (No Fault;), 1=Cx1_Fault
  compu method CM_OBC_DCCurLowFault: 0=Cx0_No_Fault_ (No Fault;), 1=Cx1_Fault
  compu method CM_OBC_DCVoltHighFault: 0=Cx0_No_Fault_ (No Fault;), 1=Cx1_Fault
  compu method CM_OBC_DCVoltLowFault: 0=Cx0_No_Fault_ (No Fault;), 1=Cx1_Fault
  compu method CM_OBC_DSPError: 0=Cx0_No_Fault_ (No Fault;), 1=Cx1_Fault
  compu method CM_OBC_EMLockState: 0=Cx0_Open, 1=Cx1_Close, 2=Cx2_Error
  compu method CM_OBC_FaultLevel: 0=Cx0_No_Fault (No Fault), 1=Cx1_Level1, 2=Cx2_Level2, 3=Cx3_Level3
  compu method CM_OBC_HWFault: 0=Cx0_No_Fault_ (No Fault;), 1=Cx1_Fault
  compu method CM_OBC_InputACCurrent: phys=raw*0.1 for raw 0..5000; unit A
  compu method CM_OBC_InputACVoltage: phys=raw*0.1 for raw 0..65535; unit V
  compu method CM_OBC_InputFrequencyStatus: 0=Cx0_No_Fault_ (No Fault;), 1=Cx1_Fault
  compu method CM_OBC_InputOverCurrentstatus_R: 0=Cx0_No_Fault_ (No Fault;), 1=Cx1_Fault
  compu method CM_OBC_InputOverCurrentstatus_S: 0=Cx0_No_Fault_ (No Fault;), 1=Cx1_Fault
  compu method CM_OBC_InputOverCurrentstatus_T: 0=Cx0_No_Fault_ (No Fault;), 1=Cx1_Fault
  compu method CM_OBC_InputPhaseStatus: 0=Cx0_No_Fault_ (No Fault;), 1=Cx1_Fault
  compu method CM_OBC_NlineStatus: 0=Cx0_No_Fault_ (No Fault;), 1=Cx1_Fault
  compu method CM_OBC_OBCMaxPermOutpCrrt: phys=raw*0.1 for raw 0..400; unit A
  compu method CM_OBC_OutputDCChargeCurrent: phys=raw*0.1 for raw 0..5000; unit A
  compu method CM_OBC_OutputDCChargeVoltage: phys=raw*0.1 for raw 0..8191; unit V
  compu method CM_OBC_OutputShortError: 0=Cx0_No_Fault_ (No Fault;), 1=Cx1_Fault
  compu method CM_OBC_PFCOverVoltageError: 0=Cx0_No_Fault_ (No Fault;), 1=Cx1_Fault
  compu method CM_OBC_PFCUnderVoltageError: 0=Cx0_No_Fault_ (No Fault;), 1=Cx1_Fault
  compu method CM_OBC_PrimarySideOvertempStatus: 0=Cx0_No_Fault_ (No Fault;), 1=Cx1_Fault
  compu method CM_OBC_PrimarySideTemp: phys=raw-40 for raw 0..250
  compu method CM_OBC_S2State: 0=Cx0_Open, 1=Cx1_Close, 2=Cx2_Error
  compu method CM_OBC_SecondarySideTemp: phys=raw-40 for raw 0..250
  compu method CM_OBC_SecordarySideOvertempStatus: 0=Cx0_No_Fault_ (No Fault;), 1=Cx1_Fault
  compu method CM_OBC_StartUpAllowed: 0=Cx0_No_Fault_ (No Fault;), 1=Cx1_Fault
  compu method CM_POD_DCFCCurrent: phys=raw*0.5 for raw 0..2047; unit A
  compu method CM_POD_DCFCVoltage: phys=raw*0.1 for raw 0..8191; unit V
  compu method CM_POD_DCInletTempA: phys=raw-40 for raw 0..255
  compu method CM_POD_DCInletTempB: phys=raw-40 for raw 0..255
  compu method CM_POD_DCNegRelayState: 0=Cx0_Opening, 1=Cx1_Closing, 2=Cx2_Error
  compu method CM_POD_DCPortInletTempAValid: 0=Cx0_Damage, 1=Cx1_Short_Circuit_ (Short Circuit), 2=Cx2_normal
  compu method CM_POD_DCPortInletTempBValid: 0=Cx0_Damage, 1=Cx1_Short_Circuit_ (Short Circuit), 2=Cx2_normal
  compu method CM_POD_DCPosRelayState: 0=Cx0_Opening, 1=Cx1_Closing, 2=Cx2_Error
  compu method CM_POD_faultTemp: 0=Cx0_No_Fault_ (No Fault;), 1=Cx1_Fault
  compu method CM_POD_Temperature: phys=raw-40 for raw 0..255
  compu method CM_POD_TempSensor1Fault: 0=Cx0_No_Fault (No Fault), 1=Cx1_Fault
  compu method CM_TCU_AmbientTemperature: phys=raw-50 for raw 0..255
  compu method CM_TCU_APTC1Enable: 0=Cx0_Not_Allowed (Not Allowed), 1=Cx1_Allowed
  compu method CM_TCU_APTCLeftCmd: identical
  compu method CM_TCU_APTCRightCmd: identical
  compu method CM_TCU_APTCState: 0=Cx0_Default, 1=Cx1_OFF, 2=Cx2_ON, 3=Cx3_Reserved
  compu method CM_TCU_BattTMState: 0=Cx0_sleep_mode_and_no_coolant_flow (sleep mode and no coolant flow), 1=Cx1_cooling_mode (cooling mode), 2=Cx2_heating_mode (heating mode), 3=Cx3_pump_only_mode (pump only mode), 4=Cx4_exception_mode (exception mode), 5=Cx5_Reserved, 6=Cx6_Reserved, 7=Cx7_Reserved
  compu method CM_TCU_CompEnable: -1=Cx1_Enabled, 0=Cx0_Disabled  # Source signal range: [0,0]
  compu method CM_TCU_CompMaxAllowPwrCmsp: phys=raw*0.04 for raw 0..127; unit KW
  compu method CM_TCU_CompTargetSpeed: identical
  compu method CM_TCU_EVCompState: 0=Cx0_Default, 1=Cx1_OFF, 2=Cx2_ON, 3=Cx3_Reserved
  compu method CM_TCU_HVACACState: 0=Cx0_Default, 1=Cx1_Auto, 2=Cx2_Manual, 3=Cx3_Reserved
  compu method CM_TCU_HVCHHighVoltage: identical
  compu method CM_TCU_HVCHHVDCCurrent: phys=raw*0.25 for raw 0..254; unit A
  compu method CM_TCU_HVCHState: 0=Cx0_Default, 1=Cx1_OFF, 2=Cx2_ON, 3=Cx3_Reserved
  compu method CM_TCU_HvOnReq: 0=Cx0_No_Request (No Request), 1=Cx1_Request
  compu method CM_TCU_HVPwrState: 0=Cx0_ready_to_Power_Off (ready to Power Off), 1=Cx1_ready_to_Power_On (ready to Power On), 2=Cx2_One_Side_No_Power_or_Error (One Side No Power or Error), 3=Cx3_Reserved
  compu method CM_TCU_TMSFaultLevel: 0=Cx0_No_Fault (No Fault), 1=Cx1_Fault_Level_1 (Fault Level 1), 2=Cx2_Fault_Level_2 (Fault Level 2), 3=Cx3_Fault_Level_3 (Fault Level 3), 4=Cx4_Fault_Level_4 (Fault Level 4), 5=Cx5_Reserved, 6=Cx6_Reserved, 7=Cx7_Reserved  # Source signal range: [0,3]
  compu method CM_TCU_TMSState: identical
  compu method CM_TCU_TMSTotoalPwrReq: phys=raw*200 for raw 0..200; unit w
  compu method CM_UDS_EPT_BootCmd{1..3}: identical
  compu method CM_Uds_EPT_bootResponse_Byte{0..7}: identical
  compu method CM_VCU_ActualGear: 0=Cx0_reserve, 1=Cx1_P, 2=Cx2_N, 3=Cx3_R, 4=Cx4_D
  compu method CM_VCU_BrakepedalStatus: 0=Cx0_Brake_Not_Pressed (Brake Not Pressed), 1=Cx1_Brake_pressed (Brake pressed)
  compu method CM_VCU_Chargestatus: 0=Cx0_Initializing (? Initializing), 1=Cx1_Off_Plug (? Off Plug), 2=Cx2_AC_Plug_Detected (? AC Plug Detected), 3=Cx3_DC_Plug_Detected (? DC Plug Detected), 4=Cx4_V2L_Plug_Detected (? V2L Plug Detected), 5=Cx5_AC_Charging (? AC Charging), 6=Cx6_DC_Charging (? DC Charging), 7=Cx7_V2L_Discharging (? V2L Discharging), 8=Cx8_Charging_Completed (?Charging Completed), 9=Cx9_Fault (?Fault), 10=CxA_AC_Preheating (AC Preheating), 11=CxB_DC_Preheating (DC Preheating)  # Source signal range: [0,9]
  compu method CM_VCU_Enable_DC_Relay: 0=Cx0_Open_Request (Open Request), 1=Cx1_Close_Request (Close Request)
  compu method CM_VCU_EnableOBC: 0=Cx0_Sleep, 1=Cx1_Ready, 2=Cx2_Enable, 3=Cx3_Disable
  compu method CM_VCU_HVStatus: 0=Cx0_Sleep, 1=Cx1_Standby, 2=Cx2_HV_start_up (HV start-up), 3=Cx3_HV_ready (HV ready), 4=Cx4_Drive_ready (Drive ready), 5=Cx5_Preheating
  compu method CM_VCU_IsoMeasurementSwitch: 0=Cx0_On, 1=Cx1_Off
  compu method CM_VCU_KL15On: 0=Cx0_Off, 1=Cx1_On
  compu method CM_VCU_MaxTorqueGradient: 16382=Cx3FFE_Init_ (Init;), 16383=Cx3FFF_Error, phys=raw*32 for raw 0..16381; unit Nm/s  # Source signal range: [0,16381]
  compu method CM_VCU_MaxTorqueLimit: 2046=Cx7FE_Init_ (Init;), 2047=Cx7FF_Error, phys=raw-1023 for raw 0..2045; unit Nm  # Source signal range: [0,2045]
  compu method CM_VCU_MCUDesiredTorque: 2046=Cx7FE_Init_ (Init;), 2047=Cx7FF_Error, phys=raw-1023 for raw 0..2045; unit Nm  # Source signal range: [0,2045]
  compu method CM_VCU_MCURequestedState: 0=Cx0_Ready_, 1=Cx1_TrqCtr, 2=Cx2_Active_Hearting (Active Hearting), 3=Cx3_Discharge, 4=Cx4_Shutdown, 5=Cx5_Speed_Control (Speed Control)
  compu method CM_VCU_MCUSurgeDamperState: 0=Cx0_DstC_off, 1=Cx1_DstC_ext, 2=Cx2_DstC_int_ext; unit SED
  compu method CM_VCU_MinTorqueLimit: 2046=Cx7FE_Init, 2047=Cx7FF_Error, phys=raw-1023 for raw 0..2045; unit Nm  # Source signal range: [0,2045]
  compu method CM_VCU_ModeRequestDCDC: 0=Cx0_OFF, 1=Cx1_Buck, 2=Cx2_Disabl
  compu method CM_VCU_OBC_ChargeCurrentCommand: phys=raw*0.1 for raw 0..5000; unit A
  compu method CM_VCU_OBC_Control_of_em_lock: 0=Cx0_Open_ (Open;), 1=Cx1_Close
  compu method CM_VCU_OBC_Control_of_S2_SW: 0=Cx0_Open_ (Open;), 1=Cx1_Close
  compu method CM_VCU_RequestedModeBMS: 0=Cx0_InActive, 1=Cx1_HVActive, 2=Cx2_Reserved, 3=Cx3_Reserved, 4=Cx4_Reserved, 5=Cx5_EmergencyOff, 6=Cx6_Reserved, 7=Cx7_InitValue
  compu method CM_VCU_RequestedModeTCU: 0=Cx0_Init, 1=Cx1_Standby, 2=Cx2_Disable, 3=Cx3_Enable
  compu method CM_VCU_TCSActive: 0=Cx0_NotActive, 1=Cx1_Active
  compu method CM_VCU_TCUPowerAllowed: phys=raw*40 for raw 0..255; unit W
  compu method CM_VCU_TrqThresholdDampgCtl: 254=CxFE_Init_ (Init;), 255=CxFF_Error, phys=raw*0.1 for raw 0..250; unit Nm  # Source signal range: [0,250]
  compu method CM_VCU_VoltageDemandLV: 510=Cx1FE_Init_ (Init;), 511=Cx1FF_Error, phys=raw*0.125 for raw 0..509; unit V  # Source signal range: [0,509.4]
  compu method CM_AC_AirDistributionMode: 0=Cx0_Face, 1=Cx1_Bilevel, 2=Cx2_Foo, 3=Cx3_Foot_Screen_Mix_ (Foot Screen(Mix)), 4=Cx4_Screen, 7=Cx7_Invalid
  compu method CM_AC_BlowerLevel: 0=Cx0_OFF, 1=Cx1_Blower_Level_1 (Blower Level =1), 2=Cx2_Blower_Level_2 (Blower Level =2), 3=Cx3_Blower_Level_3 (Blower Level =3), 4=Cx4_Blower_Level_4 (Blower Level =4), 5=Cx5_Blower_Level_5 (Blower Level =5), 6=Cx6_Blower_Level_6 (Blower Level =6), 7=Cx7_Blower_Level_7 (Blower Level =7), 8=Cx8_Blower_Level_8 (Blower Level =8), 15=CxF_Invalid
  compu method CM_AC_FrontDefrostState: 0=Cx0_OFF, 1=Cx1_ON
  compu method CM_AC_IntakeAirState: 0=Cx0_Fresh, 1=Cx1_Recirculation, 2=Cx2_Reserved, 3=Cx3_Invalid
  compu method CM_AC_LeftSetTemperature: 0=Cx00_LO, 30=Cx1E_HI, 31=Cx1F_Invalid, phys=raw*0.5+17 for raw 1..29  # Source signal range: [1,29]
  compu method CM_AC_MaxAcState: 0=Cx0_OFF, 1=Cx1_MAX_AC (MAX AC)
  compu method CM_AC_OnState: 0=Cx0_OF, 1=Cx1_O
  compu method CM_ACC_ComfortLowBand: phys=raw*0.05-7 for raw 0..255
  compu method CM_ACC_ComfortUpBand: 0=Cx00_no_demand (no demand), 1=Cx01_demand, phys=raw*0.05-7 for raw 2..255
  compu method CM_ACC_DeceToStop_Request: 0=Cx0_no_demand (no demand), 1=Cx1_demand
  compu method CM_ACC_Driveoff_Request: 0=Cx0_no_demand (no demand), 1=Cx1_demand
  compu method CM_ACC_MaxJerkA: phys=raw*0.2 for raw 0..127
  compu method CM_ACC_MinJerkA: phys=raw*0.2-25.4 for raw 0..127
  compu method CM_ACC_Mode: 0=Cx0_Off, 1=Cx1_passive, 2=Cx2_Standby, 3=Cx3_active, 4=Cx4_BrakeOnly, 5=Cx5_Override, 6=Cx6_Standstill, 7=Cx7_Failure
  compu method CM_ACC_ParkShiftReq: 0=Cx0_No_Request_ (No Request), 1=Cx1_Request_Park_Shif (Request; Park Shif)
  compu method CM_ACC_TargetAcceleration: phys=raw*0.05-7 for raw 0..255; unit m/s^2
  compu method CM_ACU_DrvSeatbeltBucklestatus: 0=Cx0_Off, 1=Cx1_Bucked
  compu method CM_ACU_PassSeatbeltBucklestatus: 0=Cx0_Off, 1=Cx1_Bucked
  compu method CM_ADAS_ReqValid: 0=Cx0_InValid_ (InValid;), 1=Cx1_Valid
  compu method CM_ADAS_State: 0=Cx0_InValid_ (InValid;), 1=Cx1_Valid
  compu method CM_ADAS_SteeringAngleReq: phys=raw*0.1-738 for raw 0..14760; unit deg
  compu method CM_ADAS_SteeringWheel_Vibration: 0=Cx0_InValid_ (InValid;), 1=Cx1_Valid
  compu method CM_ADAS_SteerSpeedReq: 0=Cx00_InValid_ (InValid;), 1=Cx01_Valid, phys=raw*10 for raw 2..54; unit deg/s
  compu method CM_ADAS_WorkModeReq: 0=Cx0_reserve, 1=Cx1_AutoSteering_Mode (AutoSteering Mode), 4=Cx4_DriverSteering_Mode_ (DriverSteering Mode), 5=Cx5_Intervent_Recove (Intervent Recove)
  compu method CM_AEB_ABALevel: 0=Cx0_Level_0_ (Level 0), 1=Cx1_Level_1 (Level 1), 2=Cx2_Level_2 (Level 2), 3=Cx3_Level_3 (Level 3)
  compu method CM_AEB_ABAReq: 0=Cx0_No_Request_ (No Request), 1=Cx1_Request
  compu method CM_AEB_ABPReq: 0=Cx0_No_Request_ (No Request), 1=Cx1_Request
  compu method CM_AEB_AWB_eq: 0=Cx0_No_Request_ (No Request), 1=Cx1_Request
  compu method CM_AEB_AWB_Level: 0=Cx0_No_level_ (No level), 1=Cx1_Level_1 (Level 1), 2=Cx2_Level_2 (Level 2), 3=Cx3_Level_3 (Level 3), 4=Cx4_Level_4 (Level 4), 5=Cx5_Resvered
  compu method CM_AEB_BrakeReqFunction: 0=Cx0_No_Request_ (No Request), 1=Cx1_AEB_V (AEB-V), 2=Cx2_AEB_VRU (AEB-VRU), 3=Cx3_AEB_JA (AEB-JA), 4=Cx4_Reserved, 5=Cx5_AEB_FCTB (AEB-FCTB), 6=Cx6_Reserved
  compu method CM_AEB_TargetDecel_eq: 0=Cx0_No_Request_ (No Request), 1=Cx1_Request
  compu method CM_AEB_TargetDecel_ReqValue: 0=Cx0000_Valid_value_ (Valid value), 21813=Cx5535_Invalid, phys=raw*0.000488-16 for raw 1..65535; unit m/s2
  compu method CM_AEB_VehHldReq: 0=Cx0_No_Request_ (No Request), 1=Cx1_Request
  compu method CM_APA_APAMode: 0=Cx0_Init, 1=Cx1_Standby, 2=Cx2_Active, 3=Cx3_Maneuver_Finished (Maneuver Finished), 4=Cx4_Suspend, 5=Cx5_Abort, 10=CxA_Off
  compu method CM_APA_GearShiftReq: 0=Cx0_No_Request (No Request), 1=Cx1_P, 2=Cx2_R, 3=Cx3_N, 4=Cx4_D
  compu method CM_APA_SpeedLimit: phys=raw*0.1 for raw 0..127; unit kph
  compu method CM_APA_StopDistance: identical
  compu method CM_BBF_failurestatus: 0=Cx0_No_Failure_ (No Failure;), 1=Cx1_Failure
  compu method CM_BCM_FrontLeftDoorAjarStatus: identical
  compu method CM_BMS_DisChgCurr: phys=raw*0.1-1000 for raw 0..20000; unit A
  compu method CM_BMS_FeedbackCurr: phys=raw*0.1-1000 for raw 0..20000; unit A
  compu method CM_BMS_RemainCapacity: identical
  compu method CM_Checksum_101: identical
  compu method CM_Checksum_130: identical
  compu method CM_Checksum_131: identical
  compu method CM_Checksum_151: identical
  compu method CM_Checksum_152: identical
  compu method CM_Checksum_1A{1..3}: identical
  compu method CM_Checksum_27A: identical
  compu method CM_Checksum_27B: identical
  compu method CM_Checksum_27E: identical
  compu method CM_Checksum_27F: identical
  compu method CM_Checksum_340: identical
  compu method CM_Checksum_59: identical
  compu method CM_Checksum_5A: identical
  compu method CM_Checksum_5B: identical
  compu method CM_Checksum_5C: identical
  compu method CM_Checksum_5D: identical
  compu method CM_Checksum_5E: identical
  compu method CM_Checksum_5F: identical
  compu method CM_Checksum_6A: identical
  compu method CM_Checksum_7A: identical
  compu method CM_DCDC_InternalFault: 0=Cx0_NoFault, 1=Cx1_Fault
  compu method CM_DCDC_OBC_CANBusoff: 0=Cx0_No_Fault (No Fault), 1=Cx1_Fault
  compu method CM_DCDC_PrimarySideOvertempStatus: 0=Cx0_No_Fault (No Fault), 1=Cx1_Fault
  compu method CM_DCDC_SecordarySideOvertempStatus: 0=Cx0_No_Fault (No Fault), 1=Cx1_Fault
  compu method CM_DM1_Byte{0..7}: identical
  compu method CM_DM2_Byte{0..7}: identical
  compu method CM_DM3_Byte{0..7}: identical
  compu method CM_EBA_TargetDecelReq: 0=Cx0_No_Request_ (No Request), 1=Cx1_Request
  compu method CM_EGSM_Pbutton: 0=Cx0_Not_Pressed (Not Pressed), 1=Cx1_Pressed
  compu method CM_EGSM_ShifterLevelFailSts: 0=Cx0_No_Fault (No Fault), 1=Cx1_Fault_Level1 (Fault Level1), 2=Cx2_Fault_Level2 (Fault Level2)
  compu method CM_EGSM_ShifterLevelPosition: 0=Cx0_Default, 1=Cx1_Left_1 (Left 1), 2=Cx2_Right_1 (Right 1), 3=Cx3_Left_2 (Left 2), 4=Cx4_Right_2 (Right 2)
  compu method CM_EPB_failurestatus: 0=Cx0_No_Failure_ (No Failure;), 1=Cx1_Failure
  compu method CM_EPS_Iq: phys=raw*0.25-2500 for raw 0..20000
  compu method CM_EPS_SteeringwheelAngle: phys=raw*0.1-738 for raw 0..14760; unit deg
  compu method CM_EPS_SteeringwheelAngleSpeed: phys=raw*10 for raw 0..54; unit deg/s
  compu method CM_EPS_WorkMode: 0=Cx0_Reserved, 1=Cx1_AutoSteering_Mode (AutoSteering Mode), 2=Cx2_Reserved, 3=Cx3_Reserved, 4=Cx4_DriverSteering_Mode (DriverSteering Mode), 5=Cx5_Intervent_Recover (Intervent Recover), 6=Cx6_Warning_Mode (Warning Mode), 7=Cx7_Erorr_Mode (Erorr Mode), 8=Cx8_Reserved
  compu method CM_GSM_AliveCounter: identical
  compu method CM_IBS_ABSACTIVEABS: 0=Cx0_NotActive, 1=Cx1_Active
  compu method CM_IBS_ABSFault: 0=Cx0_Noerror, 1=Cx1_Error
  compu method CM_IBS_AEBActive: 0=Cx0_notactive, 1=Cx1_active
  compu method CM_IBS_AVHActive: 0=Cx0_notactive, 1=Cx1_active
  compu method CM_IBS_AVHAvailable: 0=Cx0_Valid, 1=Cx1_Invalid
  compu method CM_IBS_AVHStandbySts: 0=Cx0_notactive, 1=Cx1_activ
  compu method CM_IBS_BrakeLightRequest: 0=Cx0_brakelightOFF, 1=Cx1_brakelightON, 2=Cx2_notused, 3=Cx3_signal_not_available (signal not available)
  compu method CM_IBS_BrakepedalStatus: 0=Cx0_No_pressed (No pressed), 1=Cx1_pressed
  compu method CM_IBS_BrakePushrodStroke: phys=raw/64-5 for raw 0..3328; unit mm
  compu method CM_IBS_CDPActive: 0=Cx0_notactive, 1=Cx1_active
  compu method CM_IBS_CDPAvailable: 0=Cx0_Valid, 1=Cx1_Invalid
  compu method CM_IBS_EBDActive: 0=Cx0_NotActive, 1=Cx1_Active
  compu method CM_IBS_EBDFault: 0=Cx0_Noerror, 1=Cx1_Error
  compu method CM_IBS_ECDActive: 0=Cx0_notactive, 1=Cx1_active
  compu method CM_IBS_EPBFailureLamp: 0=Cx0_LampOFF, 1=Cx1_LampON, 2=Cx2_flash, 3=Cx3_Invalid
  compu method CM_IBS_EPBFunctionLamp: 0=Cx0_LampOFF, 1=Cx1_LampON, 2=Cx2_flash, 3=Cx3_Invalid
  compu method CM_IBS_EPBSwitchPosition: 0=Cx0_no_request_ (no request£»), 1=Cx1_Release_request (Release request), 2=Cx2_Apply_request_ (Apply request£»), 3=Cx3_Error
  compu method CM_IBS_EPBSwitchPositionValid: 0=Cx0_valid, 1=Cx1_error
  compu method CM_IBS_EPBTxtdisplay: 0=Cx0_Notextmessage, 1=Cx1_Gradienttoohigh, 2=Cx2_Clampforcenotenough, 3=Cx3_Fastenseatbelt, 4=Cx4_Openparkbrakebyswitch, 5=Cx5_Pressbrakepedal, 6=Cx6_reserved, 15=CxF_Invalid
  compu method CM_IBS_EPBworkingStatus: 0=Cx0_both_brakes_released (both brakes released), 1=Cx1_both_brakes_applied (both brakes applied), 2=Cx2_both_brakes_in_operation (both brakes in operation), 3=Cx3_unknown
  compu method CM_IBS_ESCLateralAccle: phys=raw*0.0001274-4.1768 for raw 0..65535; unit g/digit
  compu method CM_IBS_ESCLongitudinalAccle: phys=raw*0.0001274-4.1768 for raw 0..65535; unit g/digit
  compu method CM_IBS_ESCYawRate: phys=raw*0.005-163.84 for raw 0..65534; unit ¡ã/s
  compu method CM_IBS_ESPEnableSts: 0=Cx0_OFF, 1=Cx1_ON
  compu method CM_IBS_ESPInfoLamp: 0=Cx0_NotActive, 1=Cx1_Active
  compu method CM_IBS_FLMovingDirection: 0=Cx0_Standstill, 1=Cx1_Forward, 2=Cx2_Backward
  compu method CM_IBS_FLWheelPulseCounter: identical
  compu method CM_IBS_FLWheelSpeed: phys=raw*0.05625 for raw 0..6400; unit km/h
  compu method CM_IBS_FLWheelSpeed_Fault: 0=Cx0_No_error (No error), 1=Cx1_Error_ (Error;)
  compu method CM_IBS_FRMovingDirection: 0=Cx0_Standstill, 1=Cx1_Forward, 2=Cx2_Backward
  compu method CM_IBS_FRWheelPulseCounter: identical
  compu method CM_IBS_FRWheelSpeed: phys=raw*0.05625 for raw 0..6400; unit km/h
  compu method CM_IBS_FRWheelSpeedFault: 0=Cx0_No_error (No error), 1=Cx1_Error_ (Error;)
  compu method CM_IBS_HDCActive: 0=Cx0_OFF, 1=Cx1_ON, 2=Cx2_Standby, 3=Cx3_Error
  compu method CM_IBS_HDCAvailable: 0=Cx0_Valid, 1=Cx1_Invalid
  compu method CM_IBS_HHCActive: 0=Cx0_notactive, 1=Cx1_active
  compu method CM_IBS_HHCAvailable: 0=Cx0_notactive, 1=Cx1_active
  compu method CM_IBS_LiquidAlarm: 0=Cx0_No_error (No error), 1=Cx1_Error
  compu method CM_IBS_MasterCylinderPressure: phys=raw*0.1 for raw 0..2500; unit BAR
  compu method CM_IBS_PlungerPressure: phys=raw*0.1 for raw 0..2500; unit BAR
  compu method CM_IBS_RBSSTATUS: 0=Cx0_NotActive, 1=Cx1_Active
  compu method CM_IBS_RLMovingDirection: 0=Cx0_Standstill, 1=Cx1_Forward, 2=Cx2_Backward
  compu method CM_IBS_RLWheelPulseCounter: identical
  compu method CM_IBS_RLWheelSpeed: phys=raw*0.05625 for raw 0..6400; unit km/h
  compu method CM_IBS_RLWheelSpeed_Fault: 0=Cx0_No_error (No error), 1=Cx1_Error_ (Error;)
  compu method CM_IBS_RRMovingDirection: 0=Cx0_Standstill, 1=Cx1_Forward, 2=Cx2_Backward
  compu method CM_IBS_RRWheelPulseCounter: identical
  compu method CM_IBS_RRWheelSpeed: phys=raw*0.05625 for raw 0..6400; unit km/h
  compu method CM_IBS_RRWheelSpeed_Fault: 0=Cx0_No_error (No error), 1=Cx1_Error_ (Error;)
  compu method CM_IBS_TCSActive: 0=Cx0_NotActive, 1=Cx1_Activ
  compu method CM_IBS_TCSFault: 0=Cx0_Noerror, 1=Cx1_Error
  compu method CM_IBS_TorqueIncreaseRequest: phys=raw-5400 for raw 0..17400; unit NM
  compu method CM_IBS_TorqueIncreaseStatus: 0=Cx0_NotActive, 1=Cx1_Active
  compu method CM_IBS_TorqueRBSReq: phys=raw-32768 for raw 0..65535; unit Nm
  compu method CM_IBS_TorqueRBSReqValid: 0=Cx0_NotIntialized, 1=Cx1_Normal, 2=Cx2_Faulty
  compu method CM_IBS_TorqueReductionRequest: phys=raw-5400 for raw 0..17400; unit NM
  compu method CM_IBS_TorqueReductionRequestValid: 0=Cx0_NotActive, 1=Cx1_Active
  compu method CM_IBS_VDCActive: 0=Cx0_NotActive, 1=Cx1_Active
  compu method CM_IBS_VDCFault: 0=Cx0_Noerror, 1=Cx1_Error
  compu method CM_IBS_VehicleSpeed: phys=raw*0.05625 for raw 0..6400; unit km/h
  compu method CM_IBS_VehiclespeedValid: 0=Cx0_valid, 1=Cx1_not_valid (not valid)
  compu method CM_IBS_VehicleStandstill: 0=Cx0_NOT_STANDSTILL, 1=Cx1_STANDSTILL
  compu method CM_IBS_VehicleStandstill_Valid: 0=Cx0_invalid, 1=Cx1_valid
  compu method CM_IBS_VLCTorqueRequest: phys=raw-1024 for raw 0..2047
  compu method CM_IBS_VLCTorqueRequestValid: 0=Cx0_NotActive, 1=Cx1_Active
  compu method CM_MessageCounter_101: identical
  compu method CM_MessageCounter_130: identical
  compu method CM_MessageCounter_131: identical
  compu method CM_MessageCounter_151: identical
  compu method CM_MessageCounter_152: identical
  compu method CM_MessageCounter_1A{1..3}: identical
  compu method CM_MessageCounter_27A: identical
  compu method CM_MessageCounter_27B: identical
  compu method CM_MessageCounter_27E: identical
  compu method CM_MessageCounter_27F: identical
  compu method CM_MessageCounter_340: identical
  compu method CM_MessageCounter_59: identical
  compu method CM_MessageCounter_5A: identical
  compu method CM_MessageCounter_5B: identical
  compu method CM_MessageCounter_5C: identical
  compu method CM_MessageCounter_5D: identical
  compu method CM_MessageCounter_5E: identical
  compu method CM_MessageCounter_5F: identical
  compu method CM_MessageCounter_6A: identical
  compu method CM_MMI_DriverModeReq: 0=Cx0_ECO_Mode (ECO Mode), 1=Cx1_Reserved, 2=Cx2_Sport
  compu method CM_OBC_ACPortTempAerror: 0=Cx0_No_Fault (No Fault), 1=Cx1_Fault
  compu method CM_OBC_ACPortTempBerror: 0=Cx0_No_Fault (No Fault), 1=Cx1_Fault
  compu method CM_OBC_DCDC_KL30Error: 0=Cx0_No_Fault (No Fault), 1=Cx1_Fault
  compu method CM_OBC_internalFault: 0=Cx0_No_Fault (No Fault), 1=Cx1_Fault
  compu method CM_PEPS_Message_Sts_AliveCounter: identical
  compu method CM_PEPS_Message_Sts_Checksum: identical
  compu method CM_PEPS_PowerMode: 0=Cx0_Off, 1=Cx1_ACC, 2=Cx2_On, 3=Cx3_Reserved
  compu method CM_PEPS_PowerModeValidity: identical
  compu method CM_PWT_ErrorLevel: 0=Cx0_Fault_Level0 (Fault Level0), 1=Cx1_Fault_Level1 (Fault Level1), 2=Cx2_Fault_Level2 (Fault Level2), 3=Cx3_Fault_Level3 (Fault Level3), 4=Cx4_Fault_Level4 (Fault Level4), 5=Cx5_Fault_Level5 (Fault Level5), 6=Cx6_Fault_Level6 (Fault Level6), 7=Cx7_Fault_Level7 (Fault Level7), 8=Cx8_Fault_Level8 (Fault Level8), 9=Cx9_Fault_Level9 (Fault Level9), 10=CxA_Fault_Level10 (Fault Level10), 11=CxB_Fault_Level11 (Fault Level11), 12=CxC_Fault_Level12 (Fault Level12), 13=CxD_Fault_Level13 (Fault Level13), 14=CxE_Fault_Level14 (Fault Level14), 15=CxF_Fault_Level15 (Fault Level15)
  compu method CM_remainChrgTime: 1022=Cx3FE_Init_ (Init;), 1023=Cx3FF_Error, phys=raw*0.5 for raw 0..1000  # Source signal range: [0,1000]
  compu method CM_TCU_ambientTemperature: phys=raw-50 for raw 0..255
  compu method CM_VCU_AccelerationPedal: phys=raw*0.1 for raw 0..1000; unit %
  compu method CM_VCU_AccelerationPedalValid: 0=Cx0_invalid, 1=Cx1_valid
  compu method CM_VCU_ActDriverMode: 0=Cx0_ECO_Mode (ECO Mode), 1=Cx1_Reserved, 2=Cx2_Sport
  compu method CM_VCU_ActiveEnergyProfile: 0=Cx0_Comfort_ (Comfort;), 1=Cx1_Eco_ (Eco;), 2=Cx2_Resserved_ (Resserved;), 3=Cx3_On_ (On;), 4=Cx4_Reserved_ (Reserved;), 5=Cx5_Reserved_ (Reserved;), 6=Cx6_Reserved_ (Reserved;), 7=Cx7_Fault
  compu method CM_VCU_ActiveRgnBrkProfile: 0=Cx0_Low_ (Low;), 1=Cx1_High_ (High;), 2=Cx2_Reserved_ (Reserved;), 3=Cx3_Reserved_ (Reserved;), 4=Cx4_Reserved_ (Reserved;), 5=Cx5_Reserved_ (Reserved;), 6=Cx6_Reserved_ (Reserved;), 7=Cx7_Fault
  compu method CM_VCU_ActTrqValid: 0=Cx0_invalid, 1=Cx1_valid
  compu method CM_VCU_ActualSpeed: phys=raw-32768 for raw 0..65535
  compu method CM_VCU_ActualTorque: phys=raw-1024 for raw 0..2047
  compu method CM_VCU_AvaDrvRange: 1022=Cx3FE_Initializing_ (Initializing;), 1023=Cx3FF_Error; unit km
  compu method CM_VCU_AVHActivereq: 0=Cx0_NO_DEMAND, 1=Cx1_DEMAND
  compu method CM_VCU_BMS_Control_of_NegRelay: 0=Cx0_Invaild, 1=Cx1_Open, 2=Cx2_Close
  compu method CM_VCU_chrgSystemStatus: 1=Cx1_Off_Plug_ (Off Plug;), 2=Cx2_Plug_Detected_ (Plug Detected;), 3=Cx3_Charging_Standby_ (Charging Standby;), 4=Cx4_AC_Charging_ (AC Charging;), 5=Cx5_DC_Charging_ (DC Charging;), 6=Cx6_Charging_Completed_ (Charging Completed;), 7=Cx7_Fault
  compu method CM_VCU_CriSysFailure: 0=Cx0_False_ (False;), 1=Cx1_True
  compu method CM_VCU_cruiseControlSetUnit: 0=Cx0_Km_h_ (Km/h;), 1=Cx1_MPH
  compu method CM_VCU_CruiseControlStatus: 0=Cx0_Inactive_ (Inactive;), 1=Cx1_Standyby_ (Standyby;), 2=Cx2_Engaged_ (Engaged;), 3=Cx3_Reserved_ (Reserved;), 4=Cx4_Reserved_ (Reserved;), 5=Cx5_Reserved_ (Reserved;), 6=Cx6_Reserved_ (Reserved;), 7=Cx7_Fault
  compu method CM_VCU_currentFromExtChargerAc: 4094=CxFFE_Initializing_ (Initializing;), 4095=CxFFF_Error, phys=raw*0.5 for raw 0..4093; unit A  # Source signal range: [0,4093]
  compu method CM_VCU_currentFromExtChargerDc: 4094=CxFFE_Initializing_ (Initializing;), 4095=CxFFF_Error, phys=raw*0.5 for raw 0..4093; unit A  # Source signal range: [0,4093]
  compu method CM_VCU_DCDCFail: 0=Cx0_False_ (False;), 1=Cx1_True
  compu method CM_VCU_DegradedHVCharging: 0=Cx0_Full_Charge_Performance_ (Full Charge Performance;)
  compu method CM_VCU_DegradedPerformance: 0=Cx0_Nomal_Performance_ (Nomal Performance;), 1=Cx1_Degraded_Perfoemance (Degraded Perfoemance)
  compu method CM_VCU_DegradedRegenBraking: 0=Cx0_Nomal_Regeneration_ (Nomal Regeneration;), 1=Cx1_Degraded_Regeneration (Degraded Regeneration)
  compu method CM_VCU_DriveMotOverSpd: 0=Cx0_False_ (False;), 1=Cx1_True
  compu method CM_VCU_DriveMotOvrTemp: 0=Cx0_False_ (False;), 1=Cx1_True
  compu method CM_VCU_driverTorqueRequest: phys=raw-1023 for raw 0..2045; unit Nm
  compu method CM_VCU_DrvDirCtrlFlt: 0=Cx0_Drive_Control_System_Nomal_ (Drive Control System Nomal;), 1=Cx1_Drive_Control_System_Fault (Drive Control System Fault)
  compu method CM_VCU_DrvModSwitchWarn: 0=Cx0_RESERVE_, 1=Cx1_unrecommed_Sport_Low_SOC (unrecommed Sport-Low SOC), 2=Cx2_unrecommed_Vehicle_Fault (unrecommed-Vehicle Fault)
  compu method CM_VCU_DynamicMileage: identical
  compu method CM_VCU_EnergyChargeSession: 2046=Cx7FE_Init_ (Init;), 2047=Cx7FF_Fault, phys=raw*0.1 for raw 0..2000; unit kWh  # Source signal range: [0,2000]
  compu method CM_VCU_EnergyReturnedRegen: 254=Cx0FE_Init_ (Init;), 255=Cx0FF_Error, phys=raw*0.1 for raw 0..1000; unit kWh
  compu method CM_VCU_EPBAppliedReq: 0=Cx0_Not_Request (Not Request), 1=Cx1_Request
  compu method CM_VCU_faultChrgMultPlugs: 0=Cx0_False_ (False;), 1=Cx1_True
  compu method CM_VCU_FrMotorSpd: 250=CxFA_Init_ (Init;), 255=CxFF_Fault, phys=raw*100 for raw 0..249; unit rpm  # Source signal range: [0,250]
  compu method CM_VCU_HVBatCoolOvrTemp: 0=Cx0_False_ (False;), 1=Cx1_True
  compu method CM_VCU_HVBatCriFail: 0=Cx0_False_ (False;), 1=Cx1_True
  compu method CM_VCU_HVBatCurrent_VCU: 16382=Cx3FFE_Init_ (Init;), 16383=Cx3FFF_Error, phys=raw*0.5-4095 for raw 0..16381; unit A  # Source signal range: [0,16382]
  compu method CM_VCU_HVBatLowSocWar: 0=Cx0_False_ (False;), 1=Cx1_True
  compu method CM_VCU_HVBatOvrTemp: 0=Cx0_False_ (False;), 1=Cx1_True
  compu method CM_VCU_HVBatTargetSoC: 254=CxFE_Init_ (Init;), 255=CxFF_Fault, phys=raw*0.5 for raw 0..253; unit %
  compu method CM_VCU_HVBatUndTemp: 0=Cx0_False_ (False;), 1=Cx1_True
  compu method CM_VCU_HVBatVolt_VCU: 4094=CxFFE_Init_ (Init;), 4095=CxFFF_Error, phys=raw*0.25 for raw 0..4093; unit V  # Source signal range: [0,4093]
  compu method CM_VCU_HVILError: 0=Cx0_False_ (False;), 1=Cx1_True
  compu method CM_VCU_HVInsulResFault: 0=Cx0_False_ (False;), 1=Cx1_True
  compu method CM_VCU_InvldGearSel: 0=Cx0_Oe_ (³µÁ¾Î´¾ÍÐ÷_½ûÖ¹ÇÐ»»ÐÐÊ»µµ), 1=Cx1_P_Oe_Oe_ (PµµÇÐ»»ÖÐ_Çë²ÈÖÆ¶¯), 2=Cx2_EPB_P_ (EPBÎÞÏìÓ¦_ÎÞ·¨¹ÒÈëPµµ), 3=Cx3_ss_Oe_R_ (Î£ÏÕ_³µËÙ¹ý¸ß_½ûÖ¹ÇÐ»»Rµµ), 4=Cx4_ss_Oe_P_ (Î£ÏÕ_³µËÙ¹ý¸ß_½ûÖ¹ÇÐ»»Pµµ), 5=Cx5_Oe_ (Î£ÏÕ_ÓÍÃÅÌ¤°å¿ª¶È¹ý´ó_½ûÖ¹ÇÐ»»ÐÐÊ»µµ), 6=Cx6_Oe_Oe_ (³µÁ¾´æÔÚ½ûÖ¹ÐÐÊ»¹ÊÕÏ_½ûÖ¹»»µ²), 7=Cx7_Ae_Oe_ (»»µ²Ä£¿é´æÔÚ¹ÊÕÏ_½ûÖ¹»»), 8=Cx8_Oe_ (³µÁ¾¼ì²âµ½²åÇ¹_½ûÖ¹ÇÐ»»µµ), 9=Cx9_Oe_ (³µÁ¾µç×Ó×¤³µÊ§Ð§_½ûÖ¹ÇÐ»»)
  compu method CM_VCU_IsCurr: phys=raw*0.5 for raw 0..2045
  compu method CM_VCU_LimpHome: 0=Cx0_False_ (False;), 1=Cx1_True
  compu method CM_VCU_MCUPower: phys=raw-200 for raw 0..400; unit kW
  compu method CM_VCU_NeutralLockExitReason: 0=Cx0_None_ (None;), 1=Cx1_User_ (User;), 2=Cx2_Time_Out_ (Time Out;), 3=Cx3_Speed_Exceeded_ (Speed Exceeded;), 4=Cx4_Reserved_ (Reserved;), 5=Cx5_Reserved_ (Reserved;), 6=Cx6_Reserved_ (Reserved;), 7=Cx7_System_Fault (System Fault)
  compu method CM_VCU_NeutralLockStatus: 0=Cx0_Unavailable_ (Unavailable;), 1=Cx1_Available_ (Available;), 2=Cx2_On_ (On;), 3=Cx3_Reserved
  compu method CM_VCU_OdometerInfo_VCU: identical
  compu method CM_VCU_onepedalstatusActive: 0=Cx0_NotActive, 1=Cx1_Active
  compu method CM_VCU_OPStandstillReq: 0=Cx0_NO_DEMAND, 1=Cx1_DEMAND
  compu method CM_VCU_PtCrashStatus: 0=Cx0_No_Crash_ (No Crash;), 1=Cx1_Soft_Crash_ (Soft Crash;), 2=Cx2_Severe_Crash_ (Severe Crash;), 3=Cx3_Fault
  compu method CM_VCU_RegenBrakeLightRequest: 0=Cx0_Brake_lights_Off (Brake lights Off), 1=Cx1_Brake_lights_On (Brake lights On)
  compu method CM_VCU_regenBrakeLightReqVld: 0=Cx0_Brake_lights_Off_ (Brake lights Off;), 1=Cx1_Brake_lights_On (Brake lights On)
  compu method CM_VCU_RegenTorqueActive: 0=Cx0_Not_Active (Not Active), 1=Cx1_Active
  compu method CM_VCU_RegenTorqueCap: phys=raw-20000 for raw 0..40000; unit Nm
  compu method CM_VCU_RegenTorqueValid: 0=Cx0_invalid, 1=Cx1_valid
  compu method CM_VCU_RrMotorSpd: 1=Cx01_Fault_ (Fault;), 250=CxFA_Init, phys=raw*100 for raw 0..249; unit rpm
  compu method CM_VCU_SystemReady: 0=Cx0_Not_Ready (Not Ready), 1=Cx1_Ready
  compu method CM_VCU_TargetDeceleration: phys=raw*0.05-7 for raw 0..255; unit m/s^2
  compu method CM_VCU_TargetGear: 0=Cx0_reserve, 1=Cx1_P, 2=Cx2_N, 3=Cx3_R, 4=Cx4_D
  compu method CM_VCU_TorqueRequestActive: 0=Cx0_Not_Active (Not Active), 1=Cx1_Active
  compu method CM_VCU_TorqueRequestAvailable: 0=Cx0_Not_Available (Not Available), 1=Cx1_Available
  compu method CM_VCU_UdcCurr: identical
  compu method CM_VCU_UnavailHVCharging: 1=Cx1_Charging_Unvailable (Charging Unvailable)
  compu method CM_VCU_UnavailHVChgReason: 0=Cx0_Not_Fault_ (Not Fault;), 1=Cx1_OBC_Fault_ (OBC Fault;), 2=Cx2_Insufficient_AC_Power_Supply_ (Insufficient AC Power Supply;), 3=Cx3_AC_Offboard_Fault_ (AC Offboard Fault;), 4=Cx4_DC_Offboard_Fault_ (DC Offboard Fault;), 5=Cx5_Reserved_ (Reserved;), 6=Cx6_Reserved_ (Reserved;), 7=Cx7_Other_Fault (Other Fault)
  compu method CM_VCU_UnavailRegenBraking: 0=Cx0_Regen_Available_ (Regen Available;), 1=Cx1_Regen_Unavailable (Regen Unavailable)
  compu method CM_VCU_VirtualPedal: phys=raw*0.1 for raw 0..1000; unit %
  compu method CM_VCU_VirtualPedalValid: 0=Cx0_invalid, 1=Cx1_valid
  compu method CM_VCU_VLCTorqueRequestActive: 0=Cx0_Not_Active (Not Active), 1=Cx1_Active
  compu method CM_VCU_VLCTorqueRequestAvailable: 0=Cx0_Not_Available (Not Available), 1=Cx1_Availabl
  compu method CM_VCU_voltageFromExtChargerAc: 2046=Cx7FE_Initializing_ (Initializing;), 2047=Cx7FF_Error, phys=raw*0.5 for raw 0..2000; unit V  # Source signal range: [0,2000]
  compu method CM_VCU_voltageFromExtChargerDc: 2046=Cx7FE_Initializing_ (Initializing;), 2047=Cx7FF_Error, phys=raw*0.5 for raw 0..2000; unit V  # Source signal range: [0,2000]
  compu method CM_VCU_WheelTrqACT: phys=raw-20000 for raw 0..40000; unit Nm
  compu method CM_YRS_Ax: phys=raw*0.0001274-4.1768 for raw 0..65535; unit g/digit
  compu method CM_YRS_AxRateFailure: identical
  compu method CM_YRS_AxStatus: 0=Cx0_Valid, 1=Cx1_Sensor_not_available (Sensor not available), 2=Cx2_Signal_failure (Signal failure)
  compu method CM_YRS_Ay: phys=raw*0.0001274-4.1768 for raw 0..65535; unit g/digit
  compu method CM_YRS_AyRateFailure: 0=Cx0_No_Failure_ (No Failure;), 1=Cx1_Failure
  compu method CM_YRS_AyStatus: 0=Cx0_Valid, 1=Cx1_Sensor_not_available (Sensor not available), 2=Cx2_Signal_failure (Signal failure)
  compu method CM_YRS_BusOff: 0=Cx0_No_Bus_Off_ (No Bus-Off;), 1=Cx1_Bus_Off (Bus-Off)
  compu method CM_YRS_DirectionCalibrationResult: 0=Cx0_Ae_ (³¯Ç°(ÕýÃæ Ä¬ÈÏ)), 1=Cx1_ (³¯×ó(ÕýÃæ)), 2=Cx2_ (³¯ºó(ÕýÃæ)), 3=Cx3_ (³¯ÓÒ(ÕýÃæ)), 4=Cx4_ (³¯Ç°(·´Ãæ)), 5=Cx5_ (³¯×ó(·´Ãæ)), 6=Cx6_ (³¯ºó(·´Ãæ)), 7=Cx7_ (³¯ÓÒ(·´Ãæ))
  compu method CM_YRS_YawRate: phys=raw*0.005-163.84 for raw 0..65534; unit ¡ã/s
  compu method CM_YRS_YawRateFailure: 0=Cx0_No_Failure_ (No Failure;), 1=Cx1_Failure
  compu method CM_YRS_YawRateStatus: 0=Cx0_Valid, 1=Cx1_Sensor_not_available (Sensor not available), 2=Cx2_Signal_failure (Signal failure)
  compu method CM_YRS_ZeroCalibrationResult: 0=Cx0_Oe_ (³õÊ¼Öµ), 1=Cx1_ (±êÁã³É¹¦), 2=Cx2_Oe_ (±êÁãÖµ³É¹¦Çå³ý)
package /DataType/Unit
  33 x unit:
    U_A: display-name=A, factor-si-to-unit=1, offset-si-to-unit=0
    U_Ah: display-name=Ah, factor-si-to-unit=1, offset-si-to-unit=0
    U_deg: display-name=deg, factor-si-to-unit=1, offset-si-to-unit=0
    U_Hz: display-name=Hz, factor-si-to-unit=1, offset-si-to-unit=0
    U_k_: display-name=k¦¸, factor-si-to-unit=1, offset-si-to-unit=0
    U_KW: display-name=KW, factor-si-to-unit=1, offset-si-to-unit=0
    U_KWH: display-name=KWH, factor-si-to-unit=1, offset-si-to-unit=0
    U_LYmin: display-name=L/min, factor-si-to-unit=1, offset-si-to-unit=0
    U_Min: display-name=Min, factor-si-to-unit=1, offset-si-to-unit=0
    U_Nm: display-name=Nm, factor-si-to-unit=1, offset-si-to-unit=0
    U_NmYs: display-name=Nm/s, factor-si-to-unit=1, offset-si-to-unit=0
    U_p: display-name=%, factor-si-to-unit=1, offset-si-to-unit=0
    U_rpm: display-name=rpm, factor-si-to-unit=1, offset-si-to-unit=0
    U_SED: display-name=SED, factor-si-to-unit=1, offset-si-to-unit=0
    U_V: display-name=V, factor-si-to-unit=1, offset-si-to-unit=0
    U_w: display-name=w, factor-si-to-unit=1, offset-si-to-unit=0
    U_W: display-name=W, factor-si-to-unit=1, offset-si-to-unit=0
    U_WYm2: display-name=W/m2, factor-si-to-unit=1, offset-si-to-unit=0
    U_BAR: display-name=BAR
    U_cm: display-name=cm
    U_degYs: display-name=deg/s
    U_gYdigit: display-name=g/digit
    U_km: display-name=km
    U_Km: display-name=Km
    U_kmYh: display-name=km/h
    U_kph: display-name=kph
    U_kW: display-name=kW
    U_kWh: display-name=kWh
    U_mm: display-name=mm
    U_mYs2: display-name=m/s2
    U_mYsX2: display-name=m/s^2
    U_NM: display-name=NM
    U_Ys: display-name=¡ã/s
