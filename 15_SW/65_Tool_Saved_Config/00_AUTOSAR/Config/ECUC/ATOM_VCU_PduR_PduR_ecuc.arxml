AUTOSAR XML (schema 00048)
package /ActiveEcuC
  module config PduR: implementation-config-variant=VARIANT-PRE-COMPILE, module-description=PduR_Impl
    PduRGeneral:
      PduRDevErrorDetect = true
      PduRVersionInfoApi = false
      PduRMetaDataSupport = false
      PduRPduCallback = false
      PduRSwitching = false
      PduRSafeBswChecks = false
      PduREnableDeferredTransmission = false
      PduREnableDeferredReception = false
      PduRSupportMulticore = false
      PduRRoutingTypeGateway = false
      PduRSpinlockRetryCounter = 4294967295
      PduRExtendedErrorChecks = false
      PduRGeneration:
        PduROutOfBoundsWriteProtectionStrategy = NONE
        PduROutOfBoundsWriteSanitizer = false
        PduROutOfBoundsReadSanitizer = false
        PduRNumericalDataTypeMinimizationStrategy = WITH_CAST
        PduRReduceConstantData2Define = false
        PduRBoolDataInArrayOfStructStrategy = BITMASKING
        PduRDeduplicateIndirectedData = true
        PduRDataDeduplicationStrategy = WITH_CAST
        PduRReduceBoolDataByNegationThreshold = 2
        PduRReduceBoolDataByNumericalComparisonThreshold = 2
        PduRReduceBoolDataByNumericalRelationThreshold = 2
        PduRReduceBoolDataByNumericalOperandStrategy = WITH_ANY_VALUE
        PduRReduceNumericalDataByOffsetThreshold = 2
        PduRReduceNumericalDataByArraySubtractionThreshold = 2
        PduRReduceDataByStreaming = false
        PduRShortSymbols = false
        PduRInterfacesForDeactivatedData = false
        PduRReferringKeysInComments = false
    PduRRoutingTables: PduRConfigurationId=0
      PduRRoutingTable
        95 x PduRRoutingPath, all with PduRMulticoreRoutingPath=false:
          TCU_AmbientTemp_oKAMA_FP_EPT_0303_b02dde55_Rx: PduRRoutingPathCommunicationType=COMMUNICATION_INTERFACE, PduRLockRef=PduRLock_PduRExclusiveArea
            PduRSrcPdu_9f96e159 (PduRSrcPdu):
              PduRSourcePduHandleId = 61
              PduRSrcPduDirection = RECEIVE
              PduRSrcPduRef = TCU_AmbientTemp_oKAMA_FP_EPT_0303_b02dde55_Rx
              PduRSrcPduPduRBswModulesRef = CanIf
            TCU_AmbientTemp_oKAMA_FP_EPT_0303_b02dde55_Rx_9f96e159_Rx (PduRDestPdu):
              PduRDestPduHandleId = 61
              PduRDestPduDirection = RECEIVE
              PduRDestPduRoutingType = API_FORWARDING
              PduRDestPduDataProcessing = IMMEDIATE
              PduRPduLengthHandlingStrategy = UNUSED
              PduRDestPduCrossPartitionDestination = false
              PduRDestPduRef = TCU_AmbientTemp_oKAMA_FP_EPT_0303_16fc04eb_Rx
              PduRDestPduPduRBswModulesRef = Com
          GW_TCU_AmbientTemp_oKAMA_FP_EPSChassis1_0303_3f0a1e15_Rx: PduRRoutingPathCommunicationType=COMMUNICATION_INTERFACE, PduRLockRef=PduRLock_PduRExclusiveArea
            GW_TCU_AmbientTemp_oKAMA_FP_EPSChassis1_0303_3f0a1e15_Rx_77f52ec2_Rx (PduRDestPdu):
              PduRDestPduHandleId = 34
              PduRDestPduDirection = RECEIVE
              PduRDestPduRoutingType = API_FORWARDING
              PduRDestPduDataProcessing = IMMEDIATE
              PduRPduLengthHandlingStrategy = UNUSED
              PduRDestPduCrossPartitionDestination = false
              PduRDestPduRef = GW_TCU_AmbientTemp_oKAMA_FP_EPSChassis1_0303_013ab96f_Rx
              PduRDestPduPduRBswModulesRef = Com
            PduRSrcPdu_77f52ec2 (PduRSrcPdu):
              PduRSourcePduHandleId = 34
              PduRSrcPduDirection = RECEIVE
              PduRSrcPduRef = GW_TCU_AmbientTemp_oKAMA_FP_EPSChassis1_0303_3f0a1e15_Rx
              PduRSrcPduPduRBswModulesRef = CanIf
          MCU_Temperature1_oKAMA_FP_EPT_0303_5a37b923_Rx: PduRRoutingPathCommunicationType=COMMUNICATION_INTERFACE, PduRLockRef=PduRLock_PduRExclusiveArea
            MCU_Temperature1_oKAMA_FP_EPT_0303_5a37b923_Rx_fe9e3688_Rx (PduRDestPdu):
              PduRDestPduHandleId = 48
              PduRDestPduDirection = RECEIVE
              PduRDestPduRoutingType = API_FORWARDING
              PduRDestPduDataProcessing = IMMEDIATE
              PduRPduLengthHandlingStrategy = UNUSED
              PduRDestPduCrossPartitionDestination = false
              PduRDestPduRef = MCU_Temperature1_oKAMA_FP_EPT_0303_a297e928_Rx
              PduRDestPduPduRBswModulesRef = Com
            PduRSrcPdu_fe9e3688 (PduRSrcPdu):
              PduRSourcePduHandleId = 48
              PduRSrcPduDirection = RECEIVE
              PduRSrcPduRef = MCU_Temperature1_oKAMA_FP_EPT_0303_5a37b923_Rx
              PduRSrcPduPduRBswModulesRef = CanIf
          BMS_Temp_oKAMA_FP_EPT_0303_acd24b10_Rx: PduRRoutingPathCommunicationType=COMMUNICATION_INTERFACE, PduRLockRef=PduRLock_PduRExclusiveArea
            BMS_Temp_oKAMA_FP_EPT_0303_acd24b10_Rx_35e0a559_Rx (PduRDestPdu):
              PduRDestPduHandleId = 20
              PduRDestPduDirection = RECEIVE
              PduRDestPduRoutingType = API_FORWARDING
              PduRDestPduDataProcessing = IMMEDIATE
              PduRPduLengthHandlingStrategy = UNUSED
              PduRDestPduCrossPartitionDestination = false
              PduRDestPduRef = BMS_Temp_oKAMA_FP_EPT_0303_0559f438_Rx
              PduRDestPduPduRBswModulesRef = Com
            PduRSrcPdu_35e0a559 (PduRSrcPdu): PduRSourcePduHandleId=20, PduRSrcPduDirection=RECEIVE, PduRSrcPduRef=BMS_Temp_oKAMA_FP_EPT_0303_acd24b10_Rx, PduRSrcPduPduRBswModulesRef=CanIf
          TCU_Cmd_oKAMA_FP_EPT_0303_4f820fd2_Rx: PduRRoutingPathCommunicationType=COMMUNICATION_INTERFACE, PduRLockRef=PduRLock_PduRExclusiveArea
            TCU_Cmd_oKAMA_FP_EPT_0303_4f820fd2_Rx_6b90ecd2_Rx (PduRDestPdu):
              PduRDestPduHandleId = 62
              PduRDestPduDirection = RECEIVE
              PduRDestPduRoutingType = API_FORWARDING
              PduRDestPduDataProcessing = IMMEDIATE
              PduRPduLengthHandlingStrategy = UNUSED
              PduRDestPduCrossPartitionDestination = false
              PduRDestPduRef = TCU_Cmd_oKAMA_FP_EPT_0303_2f814a9a_Rx
              PduRDestPduPduRBswModulesRef = Com
            PduRSrcPdu_6b90ecd2 (PduRSrcPdu): PduRSourcePduHandleId=62, PduRSrcPduDirection=RECEIVE, PduRSrcPduRef=TCU_Cmd_oKAMA_FP_EPT_0303_4f820fd2_Rx, PduRSrcPduPduRBswModulesRef=CanIf
          VCU_PlugInChrgInfo1_oKAMA_FP_EPSChassis1_0303_f0a9ba25_Tx: PduRRoutingPathCommunicationType=COMMUNICATION_INTERFACE, PduRLockRef=PduRLock_PduRExclusiveArea
            VCU_PlugInChrgInfo1_oKAMA_FP_EPSChassis1_0303_8c12c5e9_Tx (PduRDestPdu):
              PduRDestPduHandleId = 14
              PduRDestPduDirection = TRANSMIT
              PduRDestPduRoutingType = API_FORWARDING
              PduRDestPduDataProcessing = IMMEDIATE
              PduRPduLengthHandlingStrategy = UNUSED
              PduRDestPduCrossPartitionDestination = false
              PduRDestPduRef = VCU_PlugInChrgInfo1_oKAMA_FP_EPSChassis1_0303_8c12c5e9_Tx
              PduRDestPduPduRBswModulesRef = CanIf
            PduRSrcPdu_58926181 (PduRSrcPdu):
              PduRSourcePduHandleId = 16
              PduRSrcPduDirection = TRANSMIT
              PduRSrcPduRef = VCU_PlugInChrgInfo1_oKAMA_FP_EPSChassis1_0303_f0a9ba25_Tx
              PduRSrcPduPduRBswModulesRef = Com
          OBDRequest_oKAMA_FP_EPT_0303_26f78dd4_Rx: PduRRoutingPathCommunicationType=TRANSPORT_PROTOCOL, PduRLockRef=(unset)
            PduRSrcPdu_0965517e (PduRSrcPdu): PduRSourcePduHandleId=2, PduRSrcPduDirection=RECEIVE, PduRSrcPduRef=OBDRequest_oKAMA_FP_EPT_0303_26f78dd4_Rx
            OBDRequest_oKAMA_FP_EPT_0303_26f78dd4_Rx_0965517e_Rx (PduRDestPdu):
              PduRDestPduHandleId = 2
              PduRDestPduDirection = RECEIVE
              PduRDestPduRoutingType = API_FORWARDING
              PduRDestPduDataProcessing = IMMEDIATE
              PduRPduLengthHandlingStrategy = UNUSED
              PduRDestPduCrossPartitionDestination = false
              PduRDestPduRef = OBDRequest_oKAMA_FP_EPT_0303_e2d185cc_Rx
          VCU_PwrtrainRequests_oKAMA_FP_EPSChassis1_0303_51346ff9_Tx: PduRRoutingPathCommunicationType=COMMUNICATION_INTERFACE, PduRLockRef=PduRLock_PduRExclusiveArea
            VCU_PwrtrainRequests_oKAMA_FP_EPSChassis1_0303_ba8adde5_Tx (PduRDestPdu):
              PduRDestPduHandleId = 17
              PduRDestPduDirection = TRANSMIT
              PduRDestPduRoutingType = API_FORWARDING
              PduRDestPduDataProcessing = IMMEDIATE
              PduRPduLengthHandlingStrategy = UNUSED
              PduRDestPduCrossPartitionDestination = false
              PduRDestPduRef = VCU_PwrtrainRequests_oKAMA_FP_EPSChassis1_0303_ba8adde5_Tx
              PduRDestPduPduRBswModulesRef = CanIf
            PduRSrcPdu_9afe87d5 (PduRSrcPdu):
              PduRSourcePduHandleId = 19
              PduRSrcPduDirection = TRANSMIT
              PduRSrcPduRef = VCU_PwrtrainRequests_oKAMA_FP_EPSChassis1_0303_51346ff9_Tx
              PduRSrcPduPduRBswModulesRef = Com
          Uds_EPT_Boot_Request_oKAMA_FP_EPT_0303_f415a987_Rx: PduRRoutingPathCommunicationType=COMMUNICATION_INTERFACE, PduRLockRef=PduRLock_PduRExclusiveArea
            PduRSrcPdu_e27e114a (PduRSrcPdu):
              PduRSourcePduHandleId = 64
              PduRSrcPduDirection = RECEIVE
              PduRSrcPduRef = Uds_EPT_Boot_Request_oKAMA_FP_EPT_0303_f415a987_Rx
              PduRSrcPduPduRBswModulesRef = CanIf
            Uds_EPT_Boot_Request_oKAMA_FP_EPT_0303_f415a987_Rx_e27e114a_Rx (PduRDestPdu):
              PduRDestPduHandleId = 64
              PduRDestPduDirection = RECEIVE
              PduRDestPduRoutingType = API_FORWARDING
              PduRDestPduDataProcessing = IMMEDIATE
              PduRPduLengthHandlingStrategy = UNUSED
              PduRDestPduCrossPartitionDestination = false
              PduRDestPduRef = Uds_EPT_Boot_Request_oKAMA_FP_EPT_0303_8243a077_Rx
              PduRDestPduPduRBswModulesRef = Com
          BMS_Batcode_oKAMA_FP_EPT_0303_bf81843e_Rx: PduRRoutingPathCommunicationType=COMMUNICATION_INTERFACE, PduRLockRef=PduRLock_PduRExclusiveArea
            BMS_Batcode_oKAMA_FP_EPT_0303_bf81843e_Rx_101c4c5c_Rx (PduRDestPdu):
              PduRDestPduHandleId = 7
              PduRDestPduDirection = RECEIVE
              PduRDestPduRoutingType = API_FORWARDING
              PduRDestPduDataProcessing = IMMEDIATE
              PduRPduLengthHandlingStrategy = UNUSED
              PduRDestPduCrossPartitionDestination = false
              PduRDestPduRef = BMS_Batcode_oKAMA_FP_EPT_0303_2af9015e_Rx
              PduRDestPduPduRBswModulesRef = Com
            PduRSrcPdu_101c4c5c (PduRSrcPdu): PduRSourcePduHandleId=7, PduRSrcPduDirection=RECEIVE, PduRSrcPduRef=BMS_Batcode_oKAMA_FP_EPT_0303_bf81843e_Rx, PduRSrcPduPduRBswModulesRef=CanIf
          MCU_Status_oKAMA_FP_EPT_0303_7c8eb231_Rx: PduRRoutingPathCommunicationType=COMMUNICATION_INTERFACE, PduRLockRef=PduRLock_PduRExclusiveArea
            PduRSrcPdu_e445fba3 (PduRSrcPdu): PduRSourcePduHandleId=47, PduRSrcPduDirection=RECEIVE, PduRSrcPduRef=MCU_Status_oKAMA_FP_EPT_0303_7c8eb231_Rx, PduRSrcPduPduRBswModulesRef=CanIf
            MCU_Status_oKAMA_FP_EPT_0303_7c8eb231_Rx_e445fba3_Rx (PduRDestPdu):
              PduRDestPduHandleId = 47
              PduRDestPduDirection = RECEIVE
              PduRDestPduRoutingType = API_FORWARDING
              PduRDestPduDataProcessing = IMMEDIATE
              PduRPduLengthHandlingStrategy = UNUSED
              PduRDestPduCrossPartitionDestination = false
              PduRDestPduRef = MCU_Status_oKAMA_FP_EPT_0303_f59e16e7_Rx
              PduRDestPduPduRBswModulesRef = Com
          MCU_SoftwareNumber_oKAMA_FP_EPT_0303_701182ec_Rx: PduRRoutingPathCommunicationType=COMMUNICATION_INTERFACE, PduRLockRef=PduRLock_PduRExclusiveArea
            PduRSrcPdu_a2eb3ae4 (PduRSrcPdu):
              PduRSourcePduHandleId = 46
              PduRSrcPduDirection = RECEIVE
              PduRSrcPduRef = MCU_SoftwareNumber_oKAMA_FP_EPT_0303_701182ec_Rx
              PduRSrcPduPduRBswModulesRef = CanIf
            MCU_SoftwareNumber_oKAMA_FP_EPT_0303_701182ec_Rx_a2eb3ae4_Rx (PduRDestPdu):
              PduRDestPduHandleId = 46
              PduRDestPduDirection = RECEIVE
              PduRDestPduRoutingType = API_FORWARDING
              PduRDestPduDataProcessing = IMMEDIATE
              PduRPduLengthHandlingStrategy = UNUSED
              PduRDestPduCrossPartitionDestination = false
              PduRDestPduRef = MCU_SoftwareNumber_oKAMA_FP_EPT_0303_560144a5_Rx
              PduRDestPduPduRBswModulesRef = Com
          OBC_Error_STATUS_oKAMA_FP_EPT_0303_52154d12_Rx: PduRRoutingPathCommunicationType=COMMUNICATION_INTERFACE, PduRLockRef=PduRLock_PduRExclusiveArea
            OBC_Error_STATUS_oKAMA_FP_EPT_0303_52154d12_Rx_0269fab0_Rx (PduRDestPdu):
              PduRDestPduHandleId = 51
              PduRDestPduDirection = RECEIVE
              PduRDestPduRoutingType = API_FORWARDING
              PduRDestPduDataProcessing = IMMEDIATE
              PduRPduLengthHandlingStrategy = UNUSED
              PduRDestPduCrossPartitionDestination = false
              PduRDestPduRef = OBC_Error_STATUS_oKAMA_FP_EPT_0303_fe50628e_Rx
              PduRDestPduPduRBswModulesRef = Com
            PduRSrcPdu_0269fab0 (PduRSrcPdu):
              PduRSourcePduHandleId = 51
              PduRSrcPduDirection = RECEIVE
              PduRSrcPduRef = OBC_Error_STATUS_oKAMA_FP_EPT_0303_52154d12_Rx
              PduRSrcPduPduRBswModulesRef = CanIf
          BMS_ChargeStop_oKAMA_FP_EPT_0303_5018d2ae_Rx: PduRRoutingPathCommunicationType=COMMUNICATION_INTERFACE, PduRLockRef=PduRLock_PduRExclusiveArea
            PduRSrcPdu_62af5ec7 (PduRSrcPdu):
              PduRSourcePduHandleId = 11
              PduRSrcPduDirection = RECEIVE
              PduRSrcPduRef = BMS_ChargeStop_oKAMA_FP_EPT_0303_5018d2ae_Rx
              PduRSrcPduPduRBswModulesRef = CanIf
            BMS_ChargeStop_oKAMA_FP_EPT_0303_5018d2ae_Rx_62af5ec7_Rx (PduRDestPdu):
              PduRDestPduHandleId = 11
              PduRDestPduDirection = RECEIVE
              PduRDestPduRoutingType = API_FORWARDING
              PduRDestPduDataProcessing = IMMEDIATE
              PduRPduLengthHandlingStrategy = UNUSED
              PduRDestPduCrossPartitionDestination = false
              PduRDestPduRef = BMS_ChargeStop_oKAMA_FP_EPT_0303_aeea1185_Rx
              PduRDestPduPduRBswModulesRef = Com
          YRS_1_oKAMA_FP_EPSChassis1_0303_2228b3b5_Rx: PduRRoutingPathCommunicationType=COMMUNICATION_INTERFACE, PduRLockRef=PduRLock_PduRExclusiveArea
            PduRSrcPdu_d3605b7b (PduRSrcPdu):
              PduRSourcePduHandleId = 65
              PduRSrcPduDirection = RECEIVE
              PduRSrcPduRef = YRS_1_oKAMA_FP_EPSChassis1_0303_2228b3b5_Rx
              PduRSrcPduPduRBswModulesRef = CanIf
            YRS_1_oKAMA_FP_EPSChassis1_0303_2228b3b5_Rx_d3605b7b_Rx (PduRDestPdu):
              PduRDestPduHandleId = 65
              PduRDestPduDirection = RECEIVE
              PduRDestPduRoutingType = API_FORWARDING
              PduRDestPduDataProcessing = IMMEDIATE
              PduRPduLengthHandlingStrategy = UNUSED
              PduRDestPduCrossPartitionDestination = false
              PduRDestPduRef = YRS_1_oKAMA_FP_EPSChassis1_0303_6b7756ae_Rx
              PduRDestPduPduRBswModulesRef = Com
          BMS_PackVoltage_oKAMA_FP_EPT_0303_97e1c558_Rx: PduRRoutingPathCommunicationType=COMMUNICATION_INTERFACE, PduRLockRef=PduRLock_PduRExclusiveArea
            PduRSrcPdu_85865d5c (PduRSrcPdu):
              PduRSourcePduHandleId = 18
              PduRSrcPduDirection = RECEIVE
              PduRSrcPduRef = BMS_PackVoltage_oKAMA_FP_EPT_0303_97e1c558_Rx
              PduRSrcPduPduRBswModulesRef = CanIf
            BMS_PackVoltage_oKAMA_FP_EPT_0303_97e1c558_Rx_85865d5c_Rx (PduRDestPdu):
              PduRDestPduHandleId = 18
              PduRDestPduDirection = RECEIVE
              PduRDestPduRoutingType = API_FORWARDING
              PduRDestPduDataProcessing = IMMEDIATE
              PduRPduLengthHandlingStrategy = UNUSED
              PduRDestPduCrossPartitionDestination = false
              PduRDestPduRef = BMS_PackVoltage_oKAMA_FP_EPT_0303_dde3d337_Rx
              PduRDestPduPduRBswModulesRef = Com
          DonorCar_GSM_oKAMA_FP_EPSChassis1_0303_7cec353b_Rx: PduRRoutingPathCommunicationType=COMMUNICATION_INTERFACE, PduRLockRef=PduRLock_PduRExclusiveArea
            PduRSrcPdu_ce155f17 (PduRSrcPdu):
              PduRSourcePduHandleId = 27
              PduRSrcPduDirection = RECEIVE
              PduRSrcPduRef = DonorCar_GSM_oKAMA_FP_EPSChassis1_0303_7cec353b_Rx
              PduRSrcPduPduRBswModulesRef = CanIf
            DonorCar_GSM_oKAMA_FP_EPSChassis1_0303_7cec353b_Rx_ce155f17_Rx (PduRDestPdu):
              PduRDestPduHandleId = 27
              PduRDestPduDirection = RECEIVE
              PduRDestPduRoutingType = API_FORWARDING
              PduRDestPduDataProcessing = IMMEDIATE
              PduRPduLengthHandlingStrategy = UNUSED
              PduRDestPduCrossPartitionDestination = false
              PduRDestPduRef = DonorCar_GSM_oKAMA_FP_EPSChassis1_0303_fcfe1306_Rx
              PduRDestPduPduRBswModulesRef = Com
          UDSResponse_oKAMA_FP_EPT_0303_6925161b_Tx: PduRRoutingPathCommunicationType=TRANSPORT_PROTOCOL, PduRLockRef=(unset)
            PduRSrcPdu_6522d271 (PduRSrcPdu): PduRSourcePduHandleId=1, PduRSrcPduDirection=TRANSMIT, PduRSrcPduRef=UDSResponse_oKAMA_FP_EPT_0303_6925161b_Tx
            UDSResponse_oKAMA_FP_EPT_0303_fcbffa9c_Tx (PduRDestPdu):
              PduRDestPduHandleId = 1
              PduRDestPduDirection = TRANSMIT
              PduRDestPduRoutingType = API_FORWARDING
              PduRDestPduDataProcessing = IMMEDIATE
              PduRPduLengthHandlingStrategy = UNUSED
              PduRDestPduCrossPartitionDestination = false
              PduRDestPduRef = UDSResponse_oKAMA_FP_EPT_0303_fcbffa9c_Tx
          BMS_CellVoltage1_oKAMA_FP_EPT_0303_e96b50f3_Rx: PduRRoutingPathCommunicationType=COMMUNICATION_INTERFACE, PduRLockRef=PduRLock_PduRExclusiveArea
            PduRSrcPdu_e4c0f915 (PduRSrcPdu):
              PduRSourcePduHandleId = 8
              PduRSrcPduDirection = RECEIVE
              PduRSrcPduRef = BMS_CellVoltage1_oKAMA_FP_EPT_0303_e96b50f3_Rx
              PduRSrcPduPduRBswModulesRef = CanIf
            BMS_CellVoltage1_oKAMA_FP_EPT_0303_e96b50f3_Rx_e4c0f915_Rx (PduRDestPdu):
              PduRDestPduHandleId = 8
              PduRDestPduDirection = RECEIVE
              PduRDestPduRoutingType = API_FORWARDING
              PduRDestPduDataProcessing = IMMEDIATE
              PduRPduLengthHandlingStrategy = UNUSED
              PduRDestPduCrossPartitionDestination = false
              PduRDestPduRef = BMS_CellVoltage1_oKAMA_FP_EPT_0303_fc77b879_Rx
              PduRDestPduPduRBswModulesRef = Com
          VCU_DCDC_oKAMA_FP_EPT_0303_cea088c8_Tx: PduRRoutingPathCommunicationType=COMMUNICATION_INTERFACE, PduRLockRef=PduRLock_PduRExclusiveArea
            PduRSrcPdu_b5d6682c (PduRSrcPdu): PduRSourcePduHandleId=5, PduRSrcPduDirection=TRANSMIT, PduRSrcPduRef=VCU_DCDC_oKAMA_FP_EPT_0303_cea088c8_Tx, PduRSrcPduPduRBswModulesRef=Com
            VCU_DCDC_oKAMA_FP_EPT_0303_5a1aa2b0_Tx (PduRDestPdu):
              PduRDestPduHandleId = 3
              PduRDestPduDirection = TRANSMIT
              PduRDestPduRoutingType = API_FORWARDING
              PduRDestPduDataProcessing = IMMEDIATE
              PduRPduLengthHandlingStrategy = UNUSED
              PduRDestPduCrossPartitionDestination = false
              PduRDestPduRef = VCU_DCDC_oKAMA_FP_EPT_0303_5a1aa2b0_Tx
              PduRDestPduPduRBswModulesRef = CanIf
          POD_VCU_Status_01_oKAMA_FP_EPT_0303_d96a2947_Rx: PduRRoutingPathCommunicationType=COMMUNICATION_INTERFACE, PduRLockRef=PduRLock_PduRExclusiveArea
            PduRSrcPdu_fa3c4437 (PduRSrcPdu):
              PduRSourcePduHandleId = 55
              PduRSrcPduDirection = RECEIVE
              PduRSrcPduRef = POD_VCU_Status_01_oKAMA_FP_EPT_0303_d96a2947_Rx
              PduRSrcPduPduRBswModulesRef = CanIf
            POD_VCU_Status_01_oKAMA_FP_EPT_0303_d96a2947_Rx_fa3c4437_Rx (PduRDestPdu):
              PduRDestPduHandleId = 55
              PduRDestPduDirection = RECEIVE
              PduRDestPduRoutingType = API_FORWARDING
              PduRDestPduDataProcessing = IMMEDIATE
              PduRPduLengthHandlingStrategy = UNUSED
              PduRDestPduCrossPartitionDestination = false
              PduRDestPduRef = POD_VCU_Status_01_oKAMA_FP_EPT_0303_334f0c5d_Rx
              PduRDestPduPduRBswModulesRef = Com
          VCU_PwrtrainHVbattStatus2_oKAMA_FP_EPSChassis1_0303_3c31462e_Tx: PduRRoutingPathCommunicationType=COMMUNICATION_INTERFACE, PduRLockRef=PduRLock_PduRExclusiveArea
            PduRSrcPdu_e3dbda11 (PduRSrcPdu):
              PduRSourcePduHandleId = 18
              PduRSrcPduDirection = TRANSMIT
              PduRSrcPduRef = VCU_PwrtrainHVbattStatus2_oKAMA_FP_EPSChassis1_0303_3c31462e_Tx
              PduRSrcPduPduRBswModulesRef = Com
            VCU_PwrtrainHVbattStatus2_oKAMA_FP_EPSChassis1_0303_f8d9f820_Tx (PduRDestPdu):
              PduRDestPduHandleId = 16
              PduRDestPduDirection = TRANSMIT
              PduRDestPduRoutingType = API_FORWARDING
              PduRDestPduDataProcessing = IMMEDIATE
              PduRPduLengthHandlingStrategy = UNUSED
              PduRDestPduCrossPartitionDestination = false
              PduRDestPduRef = VCU_PwrtrainHVbattStatus2_oKAMA_FP_EPSChassis1_0303_f8d9f820_Tx
              PduRDestPduPduRBswModulesRef = CanIf
          VCU_POD_oKAMA_FP_EPT_0303_79abac5b_Tx: PduRRoutingPathCommunicationType=COMMUNICATION_INTERFACE, PduRLockRef=PduRLock_PduRExclusiveArea
            VCU_POD_oKAMA_FP_EPT_0303_efe06d9c_Tx (PduRDestPdu):
              PduRDestPduHandleId = 13
              PduRDestPduDirection = TRANSMIT
              PduRDestPduRoutingType = API_FORWARDING
              PduRDestPduDataProcessing = IMMEDIATE
              PduRPduLengthHandlingStrategy = UNUSED
              PduRDestPduCrossPartitionDestination = false
              PduRDestPduRef = VCU_POD_oKAMA_FP_EPT_0303_efe06d9c_Tx
              PduRDestPduPduRBswModulesRef = CanIf
            PduRSrcPdu_2147386c (PduRSrcPdu): PduRSourcePduHandleId=15, PduRSrcPduDirection=TRANSMIT, PduRSrcPduRef=VCU_POD_oKAMA_FP_EPT_0303_79abac5b_Tx, PduRSrcPduPduRBswModulesRef=Com
          VCU_MCU01_oKAMA_FP_EPT_0303_46a91c2b_Tx: PduRRoutingPathCommunicationType=COMMUNICATION_INTERFACE, PduRLockRef=PduRLock_PduRExclusiveArea
            VCU_MCU01_oKAMA_FP_EPT_0303_e7022424_Tx (PduRDestPdu):
              PduRDestPduHandleId = 7
              PduRDestPduDirection = TRANSMIT
              PduRDestPduRoutingType = API_FORWARDING
              PduRDestPduDataProcessing = IMMEDIATE
              PduRPduLengthHandlingStrategy = UNUSED
              PduRDestPduCrossPartitionDestination = false
              PduRDestPduRef = VCU_MCU01_oKAMA_FP_EPT_0303_e7022424_Tx
              PduRDestPduPduRBswModulesRef = CanIf
            PduRSrcPdu_d5110ee2 (PduRSrcPdu): PduRSourcePduHandleId=9, PduRSrcPduDirection=TRANSMIT, PduRSrcPduRef=VCU_MCU01_oKAMA_FP_EPT_0303_46a91c2b_Tx, PduRSrcPduPduRBswModulesRef=Com
          DCDC_VCU_01_oKAMA_FP_EPT_0303_98afcba8_Rx: PduRRoutingPathCommunicationType=COMMUNICATION_INTERFACE, PduRLockRef=PduRLock_PduRExclusiveArea
            PduRSrcPdu_67c6d3ea (PduRSrcPdu): PduRSourcePduHandleId=23, PduRSrcPduDirection=RECEIVE, PduRSrcPduRef=DCDC_VCU_01_oKAMA_FP_EPT_0303_98afcba8_Rx, PduRSrcPduPduRBswModulesRef=CanIf
            DCDC_VCU_01_oKAMA_FP_EPT_0303_98afcba8_Rx_67c6d3ea_Rx (PduRDestPdu):
              PduRDestPduHandleId = 23
              PduRDestPduDirection = RECEIVE
              PduRDestPduRoutingType = API_FORWARDING
              PduRDestPduDataProcessing = IMMEDIATE
              PduRPduLengthHandlingStrategy = UNUSED
              PduRDestPduCrossPartitionDestination = false
              PduRDestPduRef = DCDC_VCU_01_oKAMA_FP_EPT_0303_a6207f52_Rx
              PduRDestPduPduRBswModulesRef = Com
          DonorCar_ACM_Status_oKAMA_FP_EPSChassis1_0303_b1c292e5_Rx: PduRRoutingPathCommunicationType=COMMUNICATION_INTERFACE, PduRLockRef=PduRLock_PduRExclusiveArea
            DonorCar_ACM_Status_oKAMA_FP_EPSChassis1_0303_b1c292e5_Rx_66cce665_Rx (PduRDestPdu):
              PduRDestPduHandleId = 25
              PduRDestPduDirection = RECEIVE
              PduRDestPduRoutingType = API_FORWARDING
              PduRDestPduDataProcessing = IMMEDIATE
              PduRPduLengthHandlingStrategy = UNUSED
              PduRDestPduCrossPartitionDestination = false
              PduRDestPduRef = DonorCar_ACM_Status_oKAMA_FP_EPSChassis1_0303_ae435576_Rx
              PduRDestPduPduRBswModulesRef = Com
            PduRSrcPdu_66cce665 (PduRSrcPdu):
              PduRSourcePduHandleId = 25
              PduRSrcPduDirection = RECEIVE
              PduRSrcPduRef = DonorCar_ACM_Status_oKAMA_FP_EPSChassis1_0303_b1c292e5_Rx
              PduRSrcPduPduRBswModulesRef = CanIf
          OBC_VCU_STATUS2_oKAMA_FP_EPT_0303_d1a52fc9_Rx: PduRRoutingPathCommunicationType=COMMUNICATION_INTERFACE, PduRLockRef=PduRLock_PduRExclusiveArea
            OBC_VCU_STATUS2_oKAMA_FP_EPT_0303_d1a52fc9_Rx_3af83b49_Rx (PduRDestPdu):
              PduRDestPduHandleId = 54
              PduRDestPduDirection = RECEIVE
              PduRDestPduRoutingType = API_FORWARDING
              PduRDestPduDataProcessing = IMMEDIATE
              PduRPduLengthHandlingStrategy = UNUSED
              PduRDestPduCrossPartitionDestination = false
              PduRDestPduRef = OBC_VCU_STATUS2_oKAMA_FP_EPT_0303_36a159a3_Rx
              PduRDestPduPduRBswModulesRef = Com
            PduRSrcPdu_3af83b49 (PduRSrcPdu):
              PduRSourcePduHandleId = 54
              PduRSrcPduDirection = RECEIVE
              PduRSrcPduRef = OBC_VCU_STATUS2_oKAMA_FP_EPT_0303_d1a52fc9_Rx
              PduRSrcPduPduRBswModulesRef = CanIf
          UDSRequest_oKAMA_FP_EPT_0303_03048258_Rx: PduRRoutingPathCommunicationType=TRANSPORT_PROTOCOL, PduRLockRef=(unset)
            PduRSrcPdu_79543ff5 (PduRSrcPdu): PduRSourcePduHandleId=4, PduRSrcPduDirection=RECEIVE, PduRSrcPduRef=UDSRequest_oKAMA_FP_EPT_0303_03048258_Rx
            UDSRequest_oKAMA_FP_EPT_0303_03048258_Rx_79543ff5_Rx (PduRDestPdu):
              PduRDestPduHandleId = 4
              PduRDestPduDirection = RECEIVE
              PduRDestPduRoutingType = API_FORWARDING
              PduRDestPduDataProcessing = IMMEDIATE
              PduRPduLengthHandlingStrategy = UNUSED
              PduRDestPduCrossPartitionDestination = false
              PduRDestPduRef = UDSRequest_oKAMA_FP_EPT_0303_39823b57_Rx
          ADAS_AEB_oKAMA_FP_EPSChassis1_0303_75a15668_Rx: PduRRoutingPathCommunicationType=COMMUNICATION_INTERFACE, PduRLockRef=PduRLock_PduRExclusiveArea
            PduRSrcPdu_a4f1a927 (PduRSrcPdu):
              PduRSourcePduHandleId = 1
              PduRSrcPduDirection = RECEIVE
              PduRSrcPduRef = ADAS_AEB_oKAMA_FP_EPSChassis1_0303_75a15668_Rx
              PduRSrcPduPduRBswModulesRef = CanIf
            ADAS_AEB_oKAMA_FP_EPSChassis1_0303_75a15668_Rx_a4f1a927_Rx (PduRDestPdu):
              PduRDestPduHandleId = 1
              PduRDestPduDirection = RECEIVE
              PduRDestPduRoutingType = API_FORWARDING
              PduRDestPduDataProcessing = IMMEDIATE
              PduRPduLengthHandlingStrategy = UNUSED
              PduRDestPduCrossPartitionDestination = false
              PduRDestPduRef = ADAS_AEB_oKAMA_FP_EPSChassis1_0303_cc20b539_Rx
              PduRDestPduPduRBswModulesRef = Com
          REPS_DM1_oKAMA_FP_EPSChassis1_0303_e0df96ff_Rx: PduRRoutingPathCommunicationType=COMMUNICATION_INTERFACE, PduRLockRef=PduRLock_PduRExclusiveArea
            REPS_DM1_oKAMA_FP_EPSChassis1_0303_e0df96ff_Rx_39f4fab5_Rx (PduRDestPdu):
              PduRDestPduHandleId = 57
              PduRDestPduDirection = RECEIVE
              PduRDestPduRoutingType = API_FORWARDING
              PduRDestPduDataProcessing = IMMEDIATE
              PduRPduLengthHandlingStrategy = UNUSED
              PduRDestPduCrossPartitionDestination = false
              PduRDestPduRef = REPS_DM1_oKAMA_FP_EPSChassis1_0303_940d8c44_Rx
              PduRDestPduPduRBswModulesRef = Com
            PduRSrcPdu_39f4fab5 (PduRSrcPdu):
              PduRSourcePduHandleId = 57
              PduRSrcPduDirection = RECEIVE
              PduRSrcPduRef = REPS_DM1_oKAMA_FP_EPSChassis1_0303_e0df96ff_Rx
              PduRSrcPduPduRBswModulesRef = CanIf
          IBS_WheelSpeed_oKAMA_FP_EPSChassis1_0303_fab7be15_Rx: PduRRoutingPathCommunicationType=COMMUNICATION_INTERFACE, PduRLockRef=PduRLock_PduRExclusiveArea
            PduRSrcPdu_09985fd5 (PduRSrcPdu):
              PduRSourcePduHandleId = 42
              PduRSrcPduDirection = RECEIVE
              PduRSrcPduRef = IBS_WheelSpeed_oKAMA_FP_EPSChassis1_0303_fab7be15_Rx
              PduRSrcPduPduRBswModulesRef = CanIf
            IBS_WheelSpeed_oKAMA_FP_EPSChassis1_0303_fab7be15_Rx_09985fd5_Rx (PduRDestPdu):
              PduRDestPduHandleId = 42
              PduRDestPduDirection = RECEIVE
              PduRDestPduRoutingType = API_FORWARDING
              PduRDestPduDataProcessing = IMMEDIATE
              PduRPduLengthHandlingStrategy = UNUSED
              PduRDestPduCrossPartitionDestination = false
              PduRDestPduRef = IBS_WheelSpeed_oKAMA_FP_EPSChassis1_0303_11b9484c_Rx
              PduRDestPduPduRBswModulesRef = Com
          Uds_EPT_Boot_Response_oKAMA_FP_EPT_0303_52f0f748_Tx: PduRRoutingPathCommunicationType=COMMUNICATION_INTERFACE, PduRLockRef=PduRLock_PduRExclusiveArea
            Uds_EPT_Boot_Response_oKAMA_FP_EPT_0303_ea2424f2_Tx (PduRDestPdu):
              PduRDestPduHandleId = 0
              PduRDestPduDirection = TRANSMIT
              PduRDestPduRoutingType = API_FORWARDING
              PduRDestPduDataProcessing = IMMEDIATE
              PduRPduLengthHandlingStrategy = UNUSED
              PduRDestPduCrossPartitionDestination = false
              PduRDestPduRef = Uds_EPT_Boot_Response_oKAMA_FP_EPT_0303_ea2424f2_Tx
              PduRDestPduPduRBswModulesRef = CanIf
            PduRSrcPdu_0d211c8a (PduRSrcPdu):
              PduRSourcePduHandleId = 2
              PduRSrcPduDirection = TRANSMIT
              PduRSrcPduRef = Uds_EPT_Boot_Response_oKAMA_FP_EPT_0303_52f0f748_Tx
              PduRSrcPduPduRBswModulesRef = Com
          VCU_HVbattStatus1_oKAMA_FP_EPSChassis1_0303_5305e357_Tx: PduRRoutingPathCommunicationType=COMMUNICATION_INTERFACE, PduRLockRef=PduRLock_PduRExclusiveArea
            PduRSrcPdu_1c526d6c (PduRSrcPdu):
              PduRSourcePduHandleId = 8
              PduRSrcPduDirection = TRANSMIT
              PduRSrcPduRef = VCU_HVbattStatus1_oKAMA_FP_EPSChassis1_0303_5305e357_Tx
              PduRSrcPduPduRBswModulesRef = Com
            VCU_HVbattStatus1_oKAMA_FP_EPSChassis1_0303_2775eb4c_Tx (PduRDestPdu):
              PduRDestPduHandleId = 6
              PduRDestPduDirection = TRANSMIT
              PduRDestPduRoutingType = API_FORWARDING
              PduRDestPduDataProcessing = IMMEDIATE
              PduRPduLengthHandlingStrategy = UNUSED
              PduRDestPduCrossPartitionDestination = false
              PduRDestPduRef = VCU_HVbattStatus1_oKAMA_FP_EPSChassis1_0303_2775eb4c_Tx
              PduRDestPduPduRBswModulesRef = CanIf
          IBS1_acceleration_oKAMA_FP_EPSChassis1_0303_2a04e229_Rx: PduRRoutingPathCommunicationType=COMMUNICATION_INTERFACE, PduRLockRef=PduRLock_PduRExclusiveArea
            PduRSrcPdu_8673d0d9 (PduRSrcPdu):
              PduRSourcePduHandleId = 35
              PduRSrcPduDirection = RECEIVE
              PduRSrcPduRef = IBS1_acceleration_oKAMA_FP_EPSChassis1_0303_2a04e229_Rx
              PduRSrcPduPduRBswModulesRef = CanIf
            IBS1_acceleration_oKAMA_FP_EPSChassis1_0303_2a04e229_Rx_8673d0d9_Rx (PduRDestPdu):
              PduRDestPduHandleId = 35
              PduRDestPduDirection = RECEIVE
              PduRDestPduRoutingType = API_FORWARDING
              PduRDestPduDataProcessing = IMMEDIATE
              PduRPduLengthHandlingStrategy = UNUSED
              PduRDestPduCrossPartitionDestination = false
              PduRDestPduRef = IBS1_acceleration_oKAMA_FP_EPSChassis1_0303_92cce59a_Rx
              PduRDestPduPduRBswModulesRef = Com
          YRS_2_oKAMA_FP_EPSChassis1_0303_a47f64f4_Rx: PduRRoutingPathCommunicationType=COMMUNICATION_INTERFACE, PduRLockRef=PduRLock_PduRExclusiveArea
            PduRSrcPdu_612114e0 (PduRSrcPdu):
              PduRSourcePduHandleId = 66
              PduRSrcPduDirection = RECEIVE
              PduRSrcPduRef = YRS_2_oKAMA_FP_EPSChassis1_0303_a47f64f4_Rx
              PduRSrcPduPduRBswModulesRef = CanIf
            YRS_2_oKAMA_FP_EPSChassis1_0303_a47f64f4_Rx_612114e0_Rx (PduRDestPdu):
              PduRDestPduHandleId = 66
              PduRDestPduDirection = RECEIVE
              PduRDestPduRoutingType = API_FORWARDING
              PduRDestPduDataProcessing = IMMEDIATE
              PduRPduLengthHandlingStrategy = UNUSED
              PduRDestPduCrossPartitionDestination = false
              PduRDestPduRef = YRS_2_oKAMA_FP_EPSChassis1_0303_d8e37b6d_Rx
              PduRDestPduPduRBswModulesRef = Com
          ADAS_ACC_oKAMA_FP_EPSChassis1_0303_0ad656f5_Rx: PduRRoutingPathCommunicationType=COMMUNICATION_INTERFACE, PduRLockRef=PduRLock_PduRExclusiveArea
            PduRSrcPdu_aceeab6f (PduRSrcPdu):
              PduRSourcePduHandleId = 0
              PduRSrcPduDirection = RECEIVE
              PduRSrcPduRef = ADAS_ACC_oKAMA_FP_EPSChassis1_0303_0ad656f5_Rx
              PduRSrcPduPduRBswModulesRef = CanIf
            ADAS_ACC_oKAMA_FP_EPSChassis1_0303_0ad656f5_Rx_aceeab6f_Rx (PduRDestPdu):
              PduRDestPduHandleId = 0
              PduRDestPduDirection = RECEIVE
              PduRDestPduRoutingType = API_FORWARDING
              PduRDestPduDataProcessing = IMMEDIATE
              PduRPduLengthHandlingStrategy = UNUSED
              PduRDestPduCrossPartitionDestination = false
              PduRDestPduRef = ADAS_ACC_oKAMA_FP_EPSChassis1_0303_a710a036_Rx
              PduRDestPduPduRBswModulesRef = Com
          VCU_OBC_oKAMA_FP_EPT_0303_8235bc7f_Tx: PduRRoutingPathCommunicationType=COMMUNICATION_INTERFACE, PduRLockRef=PduRLock_PduRExclusiveArea
            PduRSrcPdu_f352bb89 (PduRSrcPdu): PduRSourcePduHandleId=13, PduRSrcPduDirection=TRANSMIT, PduRSrcPduRef=VCU_OBC_oKAMA_FP_EPT_0303_8235bc7f_Tx, PduRSrcPduPduRBswModulesRef=Com
            VCU_OBC_oKAMA_FP_EPT_0303_39c153bb_Tx (PduRDestPdu):
              PduRDestPduHandleId = 11
              PduRDestPduDirection = TRANSMIT
              PduRDestPduRoutingType = API_FORWARDING
              PduRDestPduDataProcessing = IMMEDIATE
              PduRPduLengthHandlingStrategy = UNUSED
              PduRDestPduCrossPartitionDestination = false
              PduRDestPduRef = VCU_OBC_oKAMA_FP_EPT_0303_39c153bb_Tx
              PduRDestPduPduRBswModulesRef = CanIf
          VCU_Mileage_oKAMA_FP_EPT_0303_701fd8da_Tx: PduRRoutingPathCommunicationType=COMMUNICATION_INTERFACE, PduRLockRef=PduRLock_PduRExclusiveArea
            VCU_Mileage_oKAMA_FP_EPT_0303_cc59f83c_Tx (PduRDestPdu):
              PduRDestPduHandleId = 10
              PduRDestPduDirection = TRANSMIT
              PduRDestPduRoutingType = API_FORWARDING
              PduRDestPduDataProcessing = IMMEDIATE
              PduRPduLengthHandlingStrategy = UNUSED
              PduRDestPduCrossPartitionDestination = false
              PduRDestPduRef = VCU_Mileage_oKAMA_FP_EPT_0303_cc59f83c_Tx
              PduRDestPduPduRBswModulesRef = CanIf
            PduRSrcPdu_5450d37c (PduRSrcPdu): PduRSourcePduHandleId=12, PduRSrcPduDirection=TRANSMIT, PduRSrcPduRef=VCU_Mileage_oKAMA_FP_EPT_0303_701fd8da_Tx, PduRSrcPduPduRBswModulesRef=Com
          IBS_Status3_oKAMA_FP_EPSChassis1_0303_d2a1ba09_Rx: PduRRoutingPathCommunicationType=COMMUNICATION_INTERFACE, PduRLockRef=PduRLock_PduRExclusiveArea
            IBS_Status3_oKAMA_FP_EPSChassis1_0303_d2a1ba09_Rx_b990ef00_Rx (PduRDestPdu):
              PduRDestPduHandleId = 38
              PduRDestPduDirection = RECEIVE
              PduRDestPduRoutingType = API_FORWARDING
              PduRDestPduDataProcessing = IMMEDIATE
              PduRPduLengthHandlingStrategy = UNUSED
              PduRDestPduCrossPartitionDestination = false
              PduRDestPduRef = IBS_Status3_oKAMA_FP_EPSChassis1_0303_66e23593_Rx
              PduRDestPduPduRBswModulesRef = Com
            PduRSrcPdu_b990ef00 (PduRSrcPdu):
              PduRSourcePduHandleId = 38
              PduRSrcPduDirection = RECEIVE
              PduRSrcPduRef = IBS_Status3_oKAMA_FP_EPSChassis1_0303_d2a1ba09_Rx
              PduRSrcPduPduRBswModulesRef = CanIf
          BMS_BatInfor1_oKAMA_FP_EPT_0303_b5022845_Rx: PduRRoutingPathCommunicationType=COMMUNICATION_INTERFACE, PduRLockRef=PduRLock_PduRExclusiveArea
            PduRSrcPdu_0506907f (PduRSrcPdu): PduRSourcePduHandleId=5, PduRSrcPduDirection=RECEIVE, PduRSrcPduRef=BMS_BatInfor1_oKAMA_FP_EPT_0303_b5022845_Rx, PduRSrcPduPduRBswModulesRef=CanIf
            BMS_BatInfor1_oKAMA_FP_EPT_0303_b5022845_Rx_0506907f_Rx (PduRDestPdu):
              PduRDestPduHandleId = 5
              PduRDestPduDirection = RECEIVE
              PduRDestPduRoutingType = API_FORWARDING
              PduRDestPduDataProcessing = IMMEDIATE
              PduRPduLengthHandlingStrategy = UNUSED
              PduRDestPduCrossPartitionDestination = false
              PduRDestPduRef = BMS_BatInfor1_oKAMA_FP_EPT_0303_46423d38_Rx
              PduRDestPduPduRBswModulesRef = Com
          BMS_CurrentLimit_oKAMA_FP_EPT_0303_70231bec_Rx: PduRRoutingPathCommunicationType=COMMUNICATION_INTERFACE, PduRLockRef=PduRLock_PduRExclusiveArea
            BMS_CurrentLimit_oKAMA_FP_EPT_0303_70231bec_Rx_077c3813_Rx (PduRDestPdu):
              PduRDestPduHandleId = 12
              PduRDestPduDirection = RECEIVE
              PduRDestPduRoutingType = API_FORWARDING
              PduRDestPduDataProcessing = IMMEDIATE
              PduRPduLengthHandlingStrategy = UNUSED
              PduRDestPduCrossPartitionDestination = false
              PduRDestPduRef = BMS_CurrentLimit_oKAMA_FP_EPT_0303_4d8e4c2e_Rx
              PduRDestPduPduRBswModulesRef = Com
            PduRSrcPdu_077c3813 (PduRSrcPdu):
              PduRSourcePduHandleId = 12
              PduRSrcPduDirection = RECEIVE
              PduRSrcPduRef = BMS_CurrentLimit_oKAMA_FP_EPT_0303_70231bec_Rx
              PduRSrcPduPduRBswModulesRef = CanIf
          TCU_ACStatusInfo_oKAMA_FP_EPT_0303_5e6e4459_Rx: PduRRoutingPathCommunicationType=COMMUNICATION_INTERFACE, PduRLockRef=PduRLock_PduRExclusiveArea
            PduRSrcPdu_f7c86588 (PduRSrcPdu):
              PduRSourcePduHandleId = 60
              PduRSrcPduDirection = RECEIVE
              PduRSrcPduRef = TCU_ACStatusInfo_oKAMA_FP_EPT_0303_5e6e4459_Rx
              PduRSrcPduPduRBswModulesRef = CanIf
            TCU_ACStatusInfo_oKAMA_FP_EPT_0303_5e6e4459_Rx_f7c86588_Rx (PduRDestPdu):
              PduRDestPduHandleId = 60
              PduRDestPduDirection = RECEIVE
              PduRDestPduRoutingType = API_FORWARDING
              PduRDestPduDataProcessing = IMMEDIATE
              PduRPduLengthHandlingStrategy = UNUSED
              PduRDestPduCrossPartitionDestination = false
              PduRDestPduRef = TCU_ACStatusInfo_oKAMA_FP_EPT_0303_1e9c334e_Rx
              PduRDestPduPduRBswModulesRef = Com
          OBC_VCU_CHRGSTATION_ST_oKAMA_FP_EPT_0303_a723cdbe_Rx: PduRRoutingPathCommunicationType=COMMUNICATION_INTERFACE, PduRLockRef=PduRLock_PduRExclusiveArea
            OBC_VCU_CHRGSTATION_ST_oKAMA_FP_EPT_0303_a723cdbe_Rx_26cafd7f_Rx (PduRDestPdu):
              PduRDestPduHandleId = 52
              PduRDestPduDirection = RECEIVE
              PduRDestPduRoutingType = API_FORWARDING
              PduRDestPduDataProcessing = IMMEDIATE
              PduRPduLengthHandlingStrategy = UNUSED
              PduRDestPduCrossPartitionDestination = false
              PduRDestPduRef = OBC_VCU_CHRGSTATION_ST_oKAMA_FP_EPT_0303_04b5873f_Rx
              PduRDestPduPduRBswModulesRef = Com
            PduRSrcPdu_26cafd7f (PduRSrcPdu):
              PduRSourcePduHandleId = 52
              PduRSrcPduDirection = RECEIVE
              PduRSrcPduRef = OBC_VCU_CHRGSTATION_ST_oKAMA_FP_EPT_0303_a723cdbe_Rx
              PduRSrcPduPduRBswModulesRef = CanIf
          VCU_BMS_oKAMA_FP_EPT_0303_45397907_Tx: PduRRoutingPathCommunicationType=COMMUNICATION_INTERFACE, PduRLockRef=PduRLock_PduRExclusiveArea
            VCU_BMS_oKAMA_FP_EPT_0303_0668934d_Tx (PduRDestPdu):
              PduRDestPduHandleId = 2
              PduRDestPduDirection = TRANSMIT
              PduRDestPduRoutingType = API_FORWARDING
              PduRDestPduDataProcessing = IMMEDIATE
              PduRPduLengthHandlingStrategy = UNUSED
              PduRDestPduCrossPartitionDestination = false
              PduRDestPduRef = VCU_BMS_oKAMA_FP_EPT_0303_0668934d_Tx
              PduRDestPduPduRBswModulesRef = CanIf
            PduRSrcPdu_65708719 (PduRSrcPdu): PduRSourcePduHandleId=4, PduRSrcPduDirection=TRANSMIT, PduRSrcPduRef=VCU_BMS_oKAMA_FP_EPT_0303_45397907_Tx, PduRSrcPduPduRBswModulesRef=Com
          GW_BCM_oKAMA_FP_EPT_0303_49041fc8_Rx: PduRRoutingPathCommunicationType=COMMUNICATION_INTERFACE, PduRLockRef=PduRLock_PduRExclusiveArea
            PduRSrcPdu_47c7a2a9 (PduRSrcPdu): PduRSourcePduHandleId=33, PduRSrcPduDirection=RECEIVE, PduRSrcPduRef=GW_BCM_oKAMA_FP_EPT_0303_49041fc8_Rx, PduRSrcPduPduRBswModulesRef=CanIf
            GW_BCM_oKAMA_FP_EPT_0303_49041fc8_Rx_47c7a2a9_Rx (PduRDestPdu):
              PduRDestPduHandleId = 33
              PduRDestPduDirection = RECEIVE
              PduRDestPduRoutingType = API_FORWARDING
              PduRDestPduDataProcessing = IMMEDIATE
              PduRPduLengthHandlingStrategy = UNUSED
              PduRDestPduCrossPartitionDestination = false
              PduRDestPduRef = GW_BCM_oKAMA_FP_EPT_0303_144b8b19_Rx
              PduRDestPduPduRBswModulesRef = Com
          EPS_FEEDBACK_oKAMA_FP_EPSChassis1_0303_c3c7eb04_Rx: PduRRoutingPathCommunicationType=COMMUNICATION_INTERFACE, PduRLockRef=PduRLock_PduRExclusiveArea
            EPS_FEEDBACK_oKAMA_FP_EPSChassis1_0303_c3c7eb04_Rx_f5f0cd70_Rx (PduRDestPdu):
              PduRDestPduHandleId = 31
              PduRDestPduDirection = RECEIVE
              PduRDestPduRoutingType = API_FORWARDING
              PduRDestPduDataProcessing = IMMEDIATE
              PduRPduLengthHandlingStrategy = UNUSED
              PduRDestPduCrossPartitionDestination = false
              PduRDestPduRef = EPS_FEEDBACK_oKAMA_FP_EPSChassis1_0303_b7e2a70b_Rx
              PduRDestPduPduRBswModulesRef = Com
            PduRSrcPdu_f5f0cd70 (PduRSrcPdu):
              PduRSourcePduHandleId = 31
              PduRSrcPduDirection = RECEIVE
              PduRSrcPduRef = EPS_FEEDBACK_oKAMA_FP_EPSChassis1_0303_c3c7eb04_Rx
              PduRSrcPduPduRBswModulesRef = CanIf
          BMS_ChargeEnergy_oKAMA_FP_EPT_0303_3ac5a6c0_Rx: PduRRoutingPathCommunicationType=COMMUNICATION_INTERFACE, PduRLockRef=PduRLock_PduRExclusiveArea
            PduRSrcPdu_b727ea2b (PduRSrcPdu):
              PduRSourcePduHandleId = 10
              PduRSrcPduDirection = RECEIVE
              PduRSrcPduRef = BMS_ChargeEnergy_oKAMA_FP_EPT_0303_3ac5a6c0_Rx
              PduRSrcPduPduRBswModulesRef = CanIf
            BMS_ChargeEnergy_oKAMA_FP_EPT_0303_3ac5a6c0_Rx_b727ea2b_Rx (PduRDestPdu):
              PduRDestPduHandleId = 10
              PduRDestPduDirection = RECEIVE
              PduRDestPduRoutingType = API_FORWARDING
              PduRDestPduDataProcessing = IMMEDIATE
              PduRPduLengthHandlingStrategy = UNUSED
              PduRDestPduCrossPartitionDestination = false
              PduRDestPduRef = BMS_ChargeEnergy_oKAMA_FP_EPT_0303_67f5cf8b_Rx
              PduRDestPduPduRBswModulesRef = Com
          IBS_WheelPulse_oKAMA_FP_EPSChassis1_0303_0327ced1_Rx: PduRRoutingPathCommunicationType=COMMUNICATION_INTERFACE, PduRLockRef=PduRLock_PduRExclusiveArea
            IBS_WheelPulse_oKAMA_FP_EPSChassis1_0303_0327ced1_Rx_24c6609b_Rx (PduRDestPdu):
              PduRDestPduHandleId = 41
              PduRDestPduDirection = RECEIVE
              PduRDestPduRoutingType = API_FORWARDING
              PduRDestPduDataProcessing = IMMEDIATE
              PduRPduLengthHandlingStrategy = UNUSED
              PduRDestPduCrossPartitionDestination = false
              PduRDestPduRef = IBS_WheelPulse_oKAMA_FP_EPSChassis1_0303_72c6c64e_Rx
              PduRDestPduPduRBswModulesRef = Com
            PduRSrcPdu_24c6609b (PduRSrcPdu):
              PduRSourcePduHandleId = 41
              PduRSrcPduDirection = RECEIVE
              PduRSrcPduRef = IBS_WheelPulse_oKAMA_FP_EPSChassis1_0303_0327ced1_Rx
              PduRSrcPduPduRBswModulesRef = CanIf
          MCU_HardwareNumber_oKAMA_FP_EPT_0303_4cd13962_Rx: PduRRoutingPathCommunicationType=COMMUNICATION_INTERFACE, PduRLockRef=PduRLock_PduRExclusiveArea
            MCU_HardwareNumber_oKAMA_FP_EPT_0303_4cd13962_Rx_b2d2d82b_Rx (PduRDestPdu):
              PduRDestPduHandleId = 45
              PduRDestPduDirection = RECEIVE
              PduRDestPduRoutingType = API_FORWARDING
              PduRDestPduDataProcessing = IMMEDIATE
              PduRPduLengthHandlingStrategy = UNUSED
              PduRDestPduCrossPartitionDestination = false
              PduRDestPduRef = MCU_HardwareNumber_oKAMA_FP_EPT_0303_379b1fee_Rx
              PduRDestPduPduRBswModulesRef = Com
            PduRSrcPdu_b2d2d82b (PduRSrcPdu):
              PduRSourcePduHandleId = 45
              PduRSrcPduDirection = RECEIVE
              PduRSrcPduRef = MCU_HardwareNumber_oKAMA_FP_EPT_0303_4cd13962_Rx
              PduRSrcPduPduRBswModulesRef = CanIf
          IBS_Status1_oKAMA_FP_EPSChassis1_0303_293b2077_Rx: PduRRoutingPathCommunicationType=COMMUNICATION_INTERFACE, PduRLockRef=PduRLock_PduRExclusiveArea
            IBS_Status1_oKAMA_FP_EPSChassis1_0303_293b2077_Rx_7d9c10d1_Rx (PduRDestPdu):
              PduRDestPduHandleId = 36
              PduRDestPduDirection = RECEIVE
              PduRDestPduRoutingType = API_FORWARDING
              PduRDestPduDataProcessing = IMMEDIATE
              PduRPduLengthHandlingStrategy = UNUSED
              PduRDestPduCrossPartitionDestination = false
              PduRDestPduRef = IBS_Status1_oKAMA_FP_EPSChassis1_0303_bbfa0311_Rx
              PduRDestPduPduRBswModulesRef = Com
            PduRSrcPdu_7d9c10d1 (PduRSrcPdu):
              PduRSourcePduHandleId = 36
              PduRSrcPduDirection = RECEIVE
              PduRSrcPduRef = IBS_Status1_oKAMA_FP_EPSChassis1_0303_293b2077_Rx
              PduRSrcPduPduRBswModulesRef = CanIf
          TCU_Status_oKAMA_FP_EPT_0303_6a5ccd57_Rx: PduRRoutingPathCommunicationType=COMMUNICATION_INTERFACE, PduRLockRef=PduRLock_PduRExclusiveArea
            TCU_Status_oKAMA_FP_EPT_0303_6a5ccd57_Rx_e14540ea_Rx (PduRDestPdu):
              PduRDestPduHandleId = 63
              PduRDestPduDirection = RECEIVE
              PduRDestPduRoutingType = API_FORWARDING
              PduRDestPduDataProcessing = IMMEDIATE
              PduRPduLengthHandlingStrategy = UNUSED
              PduRDestPduCrossPartitionDestination = false
              PduRDestPduRef = TCU_Status_oKAMA_FP_EPT_0303_e2dbd2c2_Rx
              PduRDestPduPduRBswModulesRef = Com
            PduRSrcPdu_e14540ea (PduRSrcPdu): PduRSourcePduHandleId=63, PduRSrcPduDirection=RECEIVE, PduRSrcPduRef=TCU_Status_oKAMA_FP_EPT_0303_6a5ccd57_Rx, PduRSrcPduPduRBswModulesRef=CanIf
          VCU_HMIsignals_oKAMA_FP_EPSChassis1_0303_a83a481c_Tx: PduRRoutingPathCommunicationType=COMMUNICATION_INTERFACE, PduRLockRef=PduRLock_PduRExclusiveArea
            PduRSrcPdu_0e65e634 (PduRSrcPdu):
              PduRSourcePduHandleId = 7
              PduRSrcPduDirection = TRANSMIT
              PduRSrcPduRef = VCU_HMIsignals_oKAMA_FP_EPSChassis1_0303_a83a481c_Tx
              PduRSrcPduPduRBswModulesRef = Com
            VCU_HMIsignals_oKAMA_FP_EPSChassis1_0303_e417f061_Tx (PduRDestPdu):
              PduRDestPduHandleId = 5
              PduRDestPduDirection = TRANSMIT
              PduRDestPduRoutingType = API_FORWARDING
              PduRDestPduDataProcessing = IMMEDIATE
              PduRPduLengthHandlingStrategy = UNUSED
              PduRDestPduCrossPartitionDestination = false
              PduRDestPduRef = VCU_HMIsignals_oKAMA_FP_EPSChassis1_0303_e417f061_Tx
              PduRDestPduPduRBswModulesRef = CanIf
          VCU_chassis_oKAMA_FP_EPSChassis1_0303_187d50df_Tx: PduRRoutingPathCommunicationType=COMMUNICATION_INTERFACE, PduRLockRef=PduRLock_PduRExclusiveArea
            PduRSrcPdu_8ef91dcb (PduRSrcPdu):
              PduRSourcePduHandleId = 21
              PduRSrcPduDirection = TRANSMIT
              PduRSrcPduRef = VCU_chassis_oKAMA_FP_EPSChassis1_0303_187d50df_Tx
              PduRSrcPduPduRBswModulesRef = Com
            VCU_chassis_oKAMA_FP_EPSChassis1_0303_66946541_Tx (PduRDestPdu):
              PduRDestPduHandleId = 19
              PduRDestPduDirection = TRANSMIT
              PduRDestPduRoutingType = API_FORWARDING
              PduRDestPduDataProcessing = IMMEDIATE
              PduRPduLengthHandlingStrategy = UNUSED
              PduRDestPduCrossPartitionDestination = false
              PduRDestPduRef = VCU_chassis_oKAMA_FP_EPSChassis1_0303_66946541_Tx
              PduRDestPduPduRBswModulesRef = CanIf
          BMS_ErrorInfo1_oKAMA_FP_EPT_0303_6e0c791e_Rx: PduRRoutingPathCommunicationType=COMMUNICATION_INTERFACE, PduRLockRef=PduRLock_PduRExclusiveArea
            BMS_ErrorInfo1_oKAMA_FP_EPT_0303_6e0c791e_Rx_b262595f_Rx (PduRDestPdu):
              PduRDestPduHandleId = 15
              PduRDestPduDirection = RECEIVE
              PduRDestPduRoutingType = API_FORWARDING
              PduRDestPduDataProcessing = IMMEDIATE
              PduRPduLengthHandlingStrategy = UNUSED
              PduRDestPduCrossPartitionDestination = false
              PduRDestPduRef = BMS_ErrorInfo1_oKAMA_FP_EPT_0303_ebb790f1_Rx
              PduRDestPduPduRBswModulesRef = Com
            PduRSrcPdu_b262595f (PduRSrcPdu):
              PduRSourcePduHandleId = 15
              PduRSrcPduDirection = RECEIVE
              PduRSrcPduRef = BMS_ErrorInfo1_oKAMA_FP_EPT_0303_6e0c791e_Rx
              PduRSrcPduPduRBswModulesRef = CanIf
          BMS_Insulation_oKAMA_FP_EPT_0303_66d8098f_Rx: PduRRoutingPathCommunicationType=COMMUNICATION_INTERFACE, PduRLockRef=PduRLock_PduRExclusiveArea
            BMS_Insulation_oKAMA_FP_EPT_0303_66d8098f_Rx_596f7da7_Rx (PduRDestPdu):
              PduRDestPduHandleId = 16
              PduRDestPduDirection = RECEIVE
              PduRDestPduRoutingType = API_FORWARDING
              PduRDestPduDataProcessing = IMMEDIATE
              PduRPduLengthHandlingStrategy = UNUSED
              PduRDestPduCrossPartitionDestination = false
              PduRDestPduRef = BMS_Insulation_oKAMA_FP_EPT_0303_6e3c9b8a_Rx
              PduRDestPduPduRBswModulesRef = Com
            PduRSrcPdu_596f7da7 (PduRSrcPdu):
              PduRSourcePduHandleId = 16
              PduRSrcPduDirection = RECEIVE
              PduRSrcPduRef = BMS_Insulation_oKAMA_FP_EPT_0303_66d8098f_Rx
              PduRSrcPduPduRBswModulesRef = CanIf
          DonorCar_MMI_Status_Infor_oKAMA_FP_EPSChassis1_0303_e08f1a5b_Rx: PduRRoutingPathCommunicationType=COMMUNICATION_INTERFACE, PduRLockRef=PduRLock_PduRExclusiveArea
            PduRSrcPdu_6c13927f (PduRSrcPdu):
              PduRSourcePduHandleId = 29
              PduRSrcPduDirection = RECEIVE
              PduRSrcPduRef = DonorCar_MMI_Status_Infor_oKAMA_FP_EPSChassis1_0303_e08f1a5b_Rx
              PduRSrcPduPduRBswModulesRef = CanIf
            DonorCar_MMI_Status_Infor_oKAMA_FP_EPSChassis1_0303_e08f1a5b_Rx_6c13927f_Rx (PduRDestPdu):
              PduRDestPduHandleId = 29
              PduRDestPduDirection = RECEIVE
              PduRDestPduRoutingType = API_FORWARDING
              PduRDestPduDataProcessing = IMMEDIATE
              PduRPduLengthHandlingStrategy = UNUSED
              PduRDestPduCrossPartitionDestination = false
              PduRDestPduRef = DonorCar_MMI_Status_Infor_oKAMA_FP_EPSChassis1_0303_cfdfa99c_Rx
              PduRDestPduPduRBswModulesRef = Com
          VCU_OdometerInfo_oKAMA_FP_EPSChassis1_0303_60fc5853_Tx: PduRRoutingPathCommunicationType=COMMUNICATION_INTERFACE, PduRLockRef=PduRLock_PduRExclusiveArea
            PduRSrcPdu_0f315760 (PduRSrcPdu):
              PduRSourcePduHandleId = 14
              PduRSrcPduDirection = TRANSMIT
              PduRSrcPduRef = VCU_OdometerInfo_oKAMA_FP_EPSChassis1_0303_60fc5853_Tx
              PduRSrcPduPduRBswModulesRef = Com
            VCU_OdometerInfo_oKAMA_FP_EPSChassis1_0303_1b1e7931_Tx (PduRDestPdu):
              PduRDestPduHandleId = 12
              PduRDestPduDirection = TRANSMIT
              PduRDestPduRoutingType = API_FORWARDING
              PduRDestPduDataProcessing = IMMEDIATE
              PduRPduLengthHandlingStrategy = UNUSED
              PduRDestPduCrossPartitionDestination = false
              PduRDestPduRef = VCU_OdometerInfo_oKAMA_FP_EPSChassis1_0303_1b1e7931_Tx
              PduRDestPduPduRBswModulesRef = CanIf
          DonorCar_MMI_AC_Command_oKAMA_FP_EPT_0303_0dbdd94d_Rx: PduRRoutingPathCommunicationType=COMMUNICATION_INTERFACE, PduRLockRef=PduRLock_PduRExclusiveArea
            DonorCar_MMI_AC_Command_oKAMA_FP_EPT_0303_0dbdd94d_Rx_d623a643_Rx (PduRDestPdu):
              PduRDestPduHandleId = 28
              PduRDestPduDirection = RECEIVE
              PduRDestPduRoutingType = API_FORWARDING
              PduRDestPduDataProcessing = IMMEDIATE
              PduRPduLengthHandlingStrategy = UNUSED
              PduRDestPduCrossPartitionDestination = false
              PduRDestPduRef = DonorCar_MMI_AC_Command_oKAMA_FP_EPT_0303_2af1d020_Rx
              PduRDestPduPduRBswModulesRef = Com
            PduRSrcPdu_d623a643 (PduRSrcPdu):
              PduRSourcePduHandleId = 28
              PduRSrcPduDirection = RECEIVE
              PduRSrcPduRef = DonorCar_MMI_AC_Command_oKAMA_FP_EPT_0303_0dbdd94d_Rx
              PduRSrcPduPduRBswModulesRef = CanIf
          OBDResponse_oKAMA_FP_EPT_0303_0e230f69_Tx: PduRRoutingPathCommunicationType=TRANSPORT_PROTOCOL, PduRLockRef=(unset)
            PduRSrcPdu_c4d3598c (PduRSrcPdu): PduRSourcePduHandleId=0, PduRSrcPduDirection=TRANSMIT, PduRSrcPduRef=OBDResponse_oKAMA_FP_EPT_0303_0e230f69_Tx
            OBDResponse_oKAMA_FP_EPT_0303_1894c698_Tx (PduRDestPdu):
              PduRDestPduHandleId = 0
              PduRDestPduDirection = TRANSMIT
              PduRDestPduRoutingType = API_FORWARDING
              PduRDestPduDataProcessing = IMMEDIATE
              PduRPduLengthHandlingStrategy = UNUSED
              PduRDestPduCrossPartitionDestination = false
              PduRDestPduRef = OBDResponse_oKAMA_FP_EPT_0303_1894c698_Tx
          YRS_7_oKAMA_FP_EPSChassis1_0303_f5f61b76_Rx: PduRRoutingPathCommunicationType=COMMUNICATION_INTERFACE, PduRLockRef=PduRLock_PduRExclusiveArea
            YRS_7_oKAMA_FP_EPSChassis1_0303_f5f61b76_Rx_88011476_Rx (PduRDestPdu):
              PduRDestPduHandleId = 67
              PduRDestPduDirection = RECEIVE
              PduRDestPduRoutingType = API_FORWARDING
              PduRDestPduDataProcessing = IMMEDIATE
              PduRPduLengthHandlingStrategy = UNUSED
              PduRDestPduCrossPartitionDestination = false
              PduRDestPduRef = YRS_7_oKAMA_FP_EPSChassis1_0303_d72e0b69_Rx
              PduRDestPduPduRBswModulesRef = Com
            PduRSrcPdu_88011476 (PduRSrcPdu):
              PduRSourcePduHandleId = 67
              PduRSrcPduDirection = RECEIVE
              PduRSrcPduRef = YRS_7_oKAMA_FP_EPSChassis1_0303_f5f61b76_Rx
              PduRSrcPduPduRBswModulesRef = CanIf
          OBDFunRequest_oKAMA_FP_EPT_0303_1b11138c_Rx: PduRRoutingPathCommunicationType=TRANSPORT_PROTOCOL, PduRLockRef=(unset)
            PduRSrcPdu_37168948 (PduRSrcPdu): PduRSourcePduHandleId=1, PduRSrcPduDirection=RECEIVE, PduRSrcPduRef=OBDFunRequest_oKAMA_FP_EPT_0303_1b11138c_Rx
            OBDFunRequest_oKAMA_FP_EPT_0303_1b11138c_Rx_37168948_Rx (PduRDestPdu):
              PduRDestPduHandleId = 1
              PduRDestPduDirection = RECEIVE
              PduRDestPduRoutingType = API_FORWARDING
              PduRDestPduDataProcessing = IMMEDIATE
              PduRPduLengthHandlingStrategy = UNUSED
              PduRDestPduCrossPartitionDestination = false
              PduRDestPduRef = OBDFunRequest_oKAMA_FP_EPT_0303_f91ebc99_Rx
          POD_VCU_Status_02_oKAMA_FP_EPT_0303_e6a157d2_Rx: PduRRoutingPathCommunicationType=COMMUNICATION_INTERFACE, PduRLockRef=PduRLock_PduRExclusiveArea
            POD_VCU_Status_02_oKAMA_FP_EPT_0303_e6a157d2_Rx_6ae44677_Rx (PduRDestPdu):
              PduRDestPduHandleId = 56
              PduRDestPduDirection = RECEIVE
              PduRDestPduRoutingType = API_FORWARDING
              PduRDestPduDataProcessing = IMMEDIATE
              PduRPduLengthHandlingStrategy = UNUSED
              PduRDestPduCrossPartitionDestination = false
              PduRDestPduRef = POD_VCU_Status_02_oKAMA_FP_EPT_0303_90198af4_Rx
              PduRDestPduPduRBswModulesRef = Com
            PduRSrcPdu_6ae44677 (PduRSrcPdu):
              PduRSourcePduHandleId = 56
              PduRSrcPduDirection = RECEIVE
              PduRSrcPduRef = POD_VCU_Status_02_oKAMA_FP_EPT_0303_e6a157d2_Rx
              PduRSrcPduPduRBswModulesRef = CanIf
          MCU_VCU_1_oKAMA_FP_EPT_0303_ea4e79f6_Rx: PduRRoutingPathCommunicationType=COMMUNICATION_INTERFACE, PduRLockRef=PduRLock_PduRExclusiveArea
            MCU_VCU_1_oKAMA_FP_EPT_0303_ea4e79f6_Rx_ff0a44d2_Rx (PduRDestPdu):
              PduRDestPduHandleId = 50
              PduRDestPduDirection = RECEIVE
              PduRDestPduRoutingType = API_FORWARDING
              PduRDestPduDataProcessing = IMMEDIATE
              PduRPduLengthHandlingStrategy = UNUSED
              PduRDestPduCrossPartitionDestination = false
              PduRDestPduRef = MCU_VCU_1_oKAMA_FP_EPT_0303_4d7e305c_Rx
              PduRDestPduPduRBswModulesRef = Com
            PduRSrcPdu_ff0a44d2 (PduRSrcPdu): PduRSourcePduHandleId=50, PduRSrcPduDirection=RECEIVE, PduRSrcPduRef=MCU_VCU_1_oKAMA_FP_EPT_0303_ea4e79f6_Rx, PduRSrcPduPduRBswModulesRef=CanIf
          VCU_AccPedal_oKAMA_FP_EPSChassis1_0303_d4e5cf20_Tx: PduRRoutingPathCommunicationType=COMMUNICATION_INTERFACE, PduRLockRef=PduRLock_PduRExclusiveArea
            VCU_AccPedal_oKAMA_FP_EPSChassis1_0303_6cab291a_Tx (PduRDestPdu):
              PduRDestPduHandleId = 1
              PduRDestPduDirection = TRANSMIT
              PduRDestPduRoutingType = API_FORWARDING
              PduRDestPduDataProcessing = IMMEDIATE
              PduRPduLengthHandlingStrategy = UNUSED
              PduRDestPduCrossPartitionDestination = false
              PduRDestPduRef = VCU_AccPedal_oKAMA_FP_EPSChassis1_0303_6cab291a_Tx
              PduRDestPduPduRBswModulesRef = CanIf
            PduRSrcPdu_50170773 (PduRSrcPdu):
              PduRSourcePduHandleId = 3
              PduRSrcPduDirection = TRANSMIT
              PduRSrcPduRef = VCU_AccPedal_oKAMA_FP_EPSChassis1_0303_d4e5cf20_Tx
              PduRSrcPduPduRBswModulesRef = Com
          BMS_DisChargeEnergy_oKAMA_FP_EPT_0303_96fcbd4c_Rx: PduRRoutingPathCommunicationType=COMMUNICATION_INTERFACE, PduRLockRef=PduRLock_PduRExclusiveArea
            BMS_DisChargeEnergy_oKAMA_FP_EPT_0303_96fcbd4c_Rx_de0281a0_Rx (PduRDestPdu):
              PduRDestPduHandleId = 14
              PduRDestPduDirection = RECEIVE
              PduRDestPduRoutingType = API_FORWARDING
              PduRDestPduDataProcessing = IMMEDIATE
              PduRPduLengthHandlingStrategy = UNUSED
              PduRDestPduCrossPartitionDestination = false
              PduRDestPduRef = BMS_DisChargeEnergy_oKAMA_FP_EPT_0303_715042cb_Rx
              PduRDestPduPduRBswModulesRef = Com
            PduRSrcPdu_de0281a0 (PduRSrcPdu):
              PduRSourcePduHandleId = 14
              PduRSrcPduDirection = RECEIVE
              PduRSrcPduRef = BMS_DisChargeEnergy_oKAMA_FP_EPT_0303_96fcbd4c_Rx
              PduRSrcPduPduRBswModulesRef = CanIf
          BMS_PRO_oKAMA_FP_EPT_0303_04956e69_Rx: PduRRoutingPathCommunicationType=COMMUNICATION_INTERFACE, PduRLockRef=PduRLock_PduRExclusiveArea
            BMS_PRO_oKAMA_FP_EPT_0303_04956e69_Rx_35e4d25a_Rx (PduRDestPdu):
              PduRDestPduHandleId = 17
              PduRDestPduDirection = RECEIVE
              PduRDestPduRoutingType = API_FORWARDING
              PduRDestPduDataProcessing = IMMEDIATE
              PduRPduLengthHandlingStrategy = UNUSED
              PduRDestPduCrossPartitionDestination = false
              PduRDestPduRef = BMS_PRO_oKAMA_FP_EPT_0303_a99bebfe_Rx
              PduRDestPduPduRBswModulesRef = Com
            PduRSrcPdu_35e4d25a (PduRSrcPdu): PduRSourcePduHandleId=17, PduRSrcPduDirection=RECEIVE, PduRSrcPduRef=BMS_PRO_oKAMA_FP_EPT_0303_04956e69_Rx, PduRSrcPduPduRBswModulesRef=CanIf
          DonorCar_BCM_LDoorWindowState_oKAMA_FP_EPSChassis1_0303_25e710b8_Rx: PduRRoutingPathCommunicationType=COMMUNICATION_INTERFACE, PduRLockRef=PduRLock_PduRExclusiveArea
            DonorCar_BCM_LDoorWindowState_oKAMA_FP_EPSChassis1_0303_25e710b8_Rx_d69897d8_Rx (PduRDestPdu):
              PduRDestPduHandleId = 26
              PduRDestPduDirection = RECEIVE
              PduRDestPduRoutingType = API_FORWARDING
              PduRDestPduDataProcessing = IMMEDIATE
              PduRPduLengthHandlingStrategy = UNUSED
              PduRDestPduCrossPartitionDestination = false
              PduRDestPduRef = DonorCar_BCM_LDoorWindowState_oKAMA_FP_EPSChassis1_0303_2e82203e_Rx
              PduRDestPduPduRBswModulesRef = Com
            PduRSrcPdu_d69897d8 (PduRSrcPdu):
              PduRSourcePduHandleId = 26
              PduRSrcPduDirection = RECEIVE
              PduRSrcPduRef = DonorCar_BCM_LDoorWindowState_oKAMA_FP_EPSChassis1_0303_25e710b8_Rx
              PduRSrcPduPduRBswModulesRef = CanIf
          ADAS_APA_oKAMA_FP_EPSChassis1_0303_4a70cc95_Rx: PduRRoutingPathCommunicationType=COMMUNICATION_INTERFACE, PduRLockRef=PduRLock_PduRExclusiveArea
            ADAS_APA_oKAMA_FP_EPSChassis1_0303_4a70cc95_Rx_74cb152e_Rx (PduRDestPdu):
              PduRDestPduHandleId = 2
              PduRDestPduDirection = RECEIVE
              PduRDestPduRoutingType = API_FORWARDING
              PduRDestPduDataProcessing = IMMEDIATE
              PduRPduLengthHandlingStrategy = UNUSED
              PduRDestPduCrossPartitionDestination = false
              PduRDestPduRef = ADAS_APA_oKAMA_FP_EPSChassis1_0303_63894043_Rx
              PduRDestPduPduRBswModulesRef = Com
            PduRSrcPdu_74cb152e (PduRSrcPdu):
              PduRSourcePduHandleId = 2
              PduRSrcPduDirection = RECEIVE
              PduRSrcPduRef = ADAS_APA_oKAMA_FP_EPSChassis1_0303_4a70cc95_Rx
              PduRSrcPduPduRBswModulesRef = CanIf
          EVCOM_State_oKAMA_FP_EPT_0303_d94c86f8_Rx: PduRRoutingPathCommunicationType=COMMUNICATION_INTERFACE, PduRLockRef=PduRLock_PduRExclusiveArea
            EVCOM_State_oKAMA_FP_EPT_0303_d94c86f8_Rx_3a55192c_Rx (PduRDestPdu):
              PduRDestPduHandleId = 32
              PduRDestPduDirection = RECEIVE
              PduRDestPduRoutingType = API_FORWARDING
              PduRDestPduDataProcessing = IMMEDIATE
              PduRPduLengthHandlingStrategy = UNUSED
              PduRDestPduCrossPartitionDestination = false
              PduRDestPduRef = EVCOM_State_oKAMA_FP_EPT_0303_b23a01c5_Rx
              PduRDestPduPduRBswModulesRef = Com
            PduRSrcPdu_3a55192c (PduRSrcPdu): PduRSourcePduHandleId=32, PduRSrcPduDirection=RECEIVE, PduRSrcPduRef=EVCOM_State_oKAMA_FP_EPT_0303_d94c86f8_Rx, PduRSrcPduPduRBswModulesRef=CanIf
          VCU_MCU_7A_oKAMA_FP_EPSChassis1_0303_0bce5bfc_Tx: PduRRoutingPathCommunicationType=COMMUNICATION_INTERFACE, PduRLockRef=PduRLock_PduRExclusiveArea
            VCU_MCU_7A_oKAMA_FP_EPSChassis1_0303_8ee5ed3e_Tx (PduRDestPdu):
              PduRDestPduHandleId = 9
              PduRDestPduDirection = TRANSMIT
              PduRDestPduRoutingType = API_FORWARDING
              PduRDestPduDataProcessing = IMMEDIATE
              PduRPduLengthHandlingStrategy = UNUSED
              PduRDestPduCrossPartitionDestination = false
              PduRDestPduRef = VCU_MCU_7A_oKAMA_FP_EPSChassis1_0303_8ee5ed3e_Tx
              PduRDestPduPduRBswModulesRef = CanIf
            PduRSrcPdu_512ffa22 (PduRSrcPdu):
              PduRSourcePduHandleId = 11
              PduRSrcPduDirection = TRANSMIT
              PduRSrcPduRef = VCU_MCU_7A_oKAMA_FP_EPSChassis1_0303_0bce5bfc_Tx
              PduRSrcPduPduRBswModulesRef = Com
          BMS_VersionInfor_oKAMA_FP_EPT_0303_ee97b4a4_Rx: PduRRoutingPathCommunicationType=COMMUNICATION_INTERFACE, PduRLockRef=PduRLock_PduRExclusiveArea
            BMS_VersionInfor_oKAMA_FP_EPT_0303_ee97b4a4_Rx_b60805aa_Rx (PduRDestPdu):
              PduRDestPduHandleId = 21
              PduRDestPduDirection = RECEIVE
              PduRDestPduRoutingType = API_FORWARDING
              PduRDestPduDataProcessing = IMMEDIATE
              PduRPduLengthHandlingStrategy = UNUSED
              PduRDestPduCrossPartitionDestination = false
              PduRDestPduRef = BMS_VersionInfor_oKAMA_FP_EPT_0303_0f4b45f4_Rx
              PduRDestPduPduRBswModulesRef = Com
            PduRSrcPdu_b60805aa (PduRSrcPdu):
              PduRSourcePduHandleId = 21
              PduRSrcPduDirection = RECEIVE
              PduRSrcPduRef = BMS_VersionInfor_oKAMA_FP_EPT_0303_ee97b4a4_Rx
              PduRSrcPduPduRBswModulesRef = CanIf
          DonorCar_PEPS_Message_Sts_oKAMA_FP_EPSChassis1_0303_6824d552_Rx: PduRRoutingPathCommunicationType=COMMUNICATION_INTERFACE, PduRLockRef=PduRLock_PduRExclusiveArea
            DonorCar_PEPS_Message_Sts_oKAMA_FP_EPSChassis1_0303_6824d552_Rx_4741a1a4_Rx (PduRDestPdu):
              PduRDestPduHandleId = 30
              PduRDestPduDirection = RECEIVE
              PduRDestPduRoutingType = API_FORWARDING
              PduRDestPduDataProcessing = IMMEDIATE
              PduRPduLengthHandlingStrategy = UNUSED
              PduRDestPduCrossPartitionDestination = false
              PduRDestPduRef = DonorCar_PEPS_Message_Sts_oKAMA_FP_EPSChassis1_0303_1785e56a_Rx
              PduRDestPduPduRBswModulesRef = Com
            PduRSrcPdu_4741a1a4 (PduRSrcPdu):
              PduRSourcePduHandleId = 30
              PduRSrcPduDirection = RECEIVE
              PduRSrcPduRef = DonorCar_PEPS_Message_Sts_oKAMA_FP_EPSChassis1_0303_6824d552_Rx
              PduRSrcPduPduRBswModulesRef = CanIf
          IBS_VCUVLC_oKAMA_FP_EPSChassis1_0303_65a003e7_Rx: PduRRoutingPathCommunicationType=COMMUNICATION_INTERFACE, PduRLockRef=PduRLock_PduRExclusiveArea
            PduRSrcPdu_d87b903e (PduRSrcPdu):
              PduRSourcePduHandleId = 40
              PduRSrcPduDirection = RECEIVE
              PduRSrcPduRef = IBS_VCUVLC_oKAMA_FP_EPSChassis1_0303_65a003e7_Rx
              PduRSrcPduPduRBswModulesRef = CanIf
            IBS_VCUVLC_oKAMA_FP_EPSChassis1_0303_65a003e7_Rx_d87b903e_Rx (PduRDestPdu):
              PduRDestPduHandleId = 40
              PduRDestPduDirection = RECEIVE
              PduRDestPduRoutingType = API_FORWARDING
              PduRDestPduDataProcessing = IMMEDIATE
              PduRPduLengthHandlingStrategy = UNUSED
              PduRDestPduCrossPartitionDestination = false
              PduRDestPduRef = IBS_VCUVLC_oKAMA_FP_EPSChassis1_0303_ba73f862_Rx
              PduRDestPduPduRBswModulesRef = Com
          UDSFunRequest_oKAMA_FP_EPT_0303_50124e24_Rx: PduRRoutingPathCommunicationType=TRANSPORT_PROTOCOL, PduRLockRef=(unset)
            UDSFunRequest_oKAMA_FP_EPT_0303_50124e24_Rx_8e65bd2a_Rx (PduRDestPdu):
              PduRDestPduHandleId = 3
              PduRDestPduDirection = RECEIVE
              PduRDestPduRoutingType = API_FORWARDING
              PduRDestPduDataProcessing = IMMEDIATE
              PduRPduLengthHandlingStrategy = UNUSED
              PduRDestPduCrossPartitionDestination = false
              PduRDestPduRef = UDSFunRequest_oKAMA_FP_EPT_0303_807c682b_Rx
            PduRSrcPdu_8e65bd2a (PduRSrcPdu): PduRSourcePduHandleId=3, PduRSrcPduDirection=RECEIVE, PduRSrcPduRef=UDSFunRequest_oKAMA_FP_EPT_0303_50124e24_Rx
          APTC_TCU_oKAMA_FP_EPT_0303_d0971361_Rx: PduRRoutingPathCommunicationType=COMMUNICATION_INTERFACE, PduRLockRef=PduRLock_PduRExclusiveArea
            APTC_TCU_oKAMA_FP_EPT_0303_d0971361_Rx_b97db196_Rx (PduRDestPdu):
              PduRDestPduHandleId = 4
              PduRDestPduDirection = RECEIVE
              PduRDestPduRoutingType = API_FORWARDING
              PduRDestPduDataProcessing = IMMEDIATE
              PduRPduLengthHandlingStrategy = UNUSED
              PduRDestPduCrossPartitionDestination = false
              PduRDestPduRef = APTC_TCU_oKAMA_FP_EPT_0303_356cfb4a_Rx
              PduRDestPduPduRBswModulesRef = Com
            PduRSrcPdu_b97db196 (PduRSrcPdu): PduRSourcePduHandleId=4, PduRSrcPduDirection=RECEIVE, PduRSrcPduRef=APTC_TCU_oKAMA_FP_EPT_0303_d0971361_Rx, PduRSrcPduPduRBswModulesRef=CanIf
          IBS_Status2_oKAMA_FP_EPSChassis1_0303_af6cf736_Rx: PduRRoutingPathCommunicationType=COMMUNICATION_INTERFACE, PduRLockRef=PduRLock_PduRExclusiveArea
            PduRSrcPdu_06da13a2 (PduRSrcPdu):
              PduRSourcePduHandleId = 37
              PduRSrcPduDirection = RECEIVE
              PduRSrcPduRef = IBS_Status2_oKAMA_FP_EPSChassis1_0303_af6cf736_Rx
              PduRSrcPduPduRBswModulesRef = CanIf
            IBS_Status2_oKAMA_FP_EPSChassis1_0303_af6cf736_Rx_06da13a2_Rx (PduRDestPdu):
              PduRDestPduHandleId = 37
              PduRDestPduDirection = RECEIVE
              PduRDestPduRoutingType = API_FORWARDING
              PduRDestPduDataProcessing = IMMEDIATE
              PduRPduLengthHandlingStrategy = UNUSED
              PduRDestPduCrossPartitionDestination = false
              PduRDestPduRef = IBS_Status2_oKAMA_FP_EPSChassis1_0303_086e2ed2_Rx
              PduRDestPduPduRBswModulesRef = Com
          VCU_MCU02_oKAMA_FP_EPT_0303_e5ff9a82_Tx: PduRRoutingPathCommunicationType=COMMUNICATION_INTERFACE, PduRLockRef=PduRLock_PduRExclusiveArea
            PduRSrcPdu_83c3faba (PduRSrcPdu): PduRSourcePduHandleId=10, PduRSrcPduDirection=TRANSMIT, PduRSrcPduRef=VCU_MCU02_oKAMA_FP_EPT_0303_e5ff9a82_Tx, PduRSrcPduPduRBswModulesRef=Com
            VCU_MCU02_oKAMA_FP_EPT_0303_d8c95ab1_Tx (PduRDestPdu):
              PduRDestPduHandleId = 8
              PduRDestPduDirection = TRANSMIT
              PduRDestPduRoutingType = API_FORWARDING
              PduRDestPduDataProcessing = IMMEDIATE
              PduRPduLengthHandlingStrategy = UNUSED
              PduRDestPduCrossPartitionDestination = false
              PduRDestPduRef = VCU_MCU02_oKAMA_FP_EPT_0303_d8c95ab1_Tx
              PduRDestPduPduRBswModulesRef = CanIf
          BMS_DIRelayState_oKAMA_FP_EPT_0303_e4f455bd_Rx: PduRRoutingPathCommunicationType=COMMUNICATION_INTERFACE, PduRLockRef=PduRLock_PduRExclusiveArea
            BMS_DIRelayState_oKAMA_FP_EPT_0303_e4f455bd_Rx_3bad98dc_Rx (PduRDestPdu):
              PduRDestPduHandleId = 13
              PduRDestPduDirection = RECEIVE
              PduRDestPduRoutingType = API_FORWARDING
              PduRDestPduDataProcessing = IMMEDIATE
              PduRPduLengthHandlingStrategy = UNUSED
              PduRDestPduCrossPartitionDestination = false
              PduRDestPduRef = BMS_DIRelayState_oKAMA_FP_EPT_0303_081a63f8_Rx
              PduRDestPduPduRBswModulesRef = Com
            PduRSrcPdu_3bad98dc (PduRSrcPdu):
              PduRSourcePduHandleId = 13
              PduRSrcPduDirection = RECEIVE
              PduRSrcPduRef = BMS_DIRelayState_oKAMA_FP_EPT_0303_e4f455bd_Rx
              PduRSrcPduPduRBswModulesRef = CanIf
          AllFunctionRequest_oKAMA_FP_EPT_0303_783e25af_Rx: PduRRoutingPathCommunicationType=TRANSPORT_PROTOCOL, PduRLockRef=(unset)
            AllFunctionRequest_oKAMA_FP_EPT_0303_783e25af_Rx_387b23a4_Rx (PduRDestPdu):
              PduRDestPduHandleId = 0
              PduRDestPduDirection = RECEIVE
              PduRDestPduRoutingType = API_FORWARDING
              PduRDestPduDataProcessing = IMMEDIATE
              PduRPduLengthHandlingStrategy = UNUSED
              PduRDestPduCrossPartitionDestination = false
              PduRDestPduRef = AllFunctionRequest_oKAMA_FP_EPT_0303_a4f59624_Rx
            PduRSrcPdu_387b23a4 (PduRSrcPdu): PduRSourcePduHandleId=0, PduRSrcPduDirection=RECEIVE, PduRSrcPduRef=AllFunctionRequest_oKAMA_FP_EPT_0303_783e25af_Rx
          MCU_FailureCode_oKAMA_FP_EPT_0303_23e6845d_Rx: PduRRoutingPathCommunicationType=COMMUNICATION_INTERFACE, PduRLockRef=PduRLock_PduRExclusiveArea
            PduRSrcPdu_c1e2b86a (PduRSrcPdu):
              PduRSourcePduHandleId = 44
              PduRSrcPduDirection = RECEIVE
              PduRSrcPduRef = MCU_FailureCode_oKAMA_FP_EPT_0303_23e6845d_Rx
              PduRSrcPduPduRBswModulesRef = CanIf
            MCU_FailureCode_oKAMA_FP_EPT_0303_23e6845d_Rx_c1e2b86a_Rx (PduRDestPdu):
              PduRDestPduHandleId = 44
              PduRDestPduDirection = RECEIVE
              PduRDestPduRoutingType = API_FORWARDING
              PduRDestPduDataProcessing = IMMEDIATE
              PduRPduLengthHandlingStrategy = UNUSED
              PduRDestPduCrossPartitionDestination = false
              PduRDestPduRef = MCU_FailureCode_oKAMA_FP_EPT_0303_0ebb7936_Rx
              PduRDestPduPduRBswModulesRef = Com
          OBC_VCU_STATUS1_oKAMA_FP_EPT_0303_ee6e515c_Rx: PduRRoutingPathCommunicationType=COMMUNICATION_INTERFACE, PduRLockRef=PduRLock_PduRExclusiveArea
            OBC_VCU_STATUS1_oKAMA_FP_EPT_0303_ee6e515c_Rx_dc7bf7dd_Rx (PduRDestPdu):
              PduRDestPduHandleId = 53
              PduRDestPduDirection = RECEIVE
              PduRDestPduRoutingType = API_FORWARDING
              PduRDestPduDataProcessing = IMMEDIATE
              PduRPduLengthHandlingStrategy = UNUSED
              PduRDestPduCrossPartitionDestination = false
              PduRDestPduRef = OBC_VCU_STATUS1_oKAMA_FP_EPT_0303_95f7df0a_Rx
              PduRDestPduPduRBswModulesRef = Com
            PduRSrcPdu_dc7bf7dd (PduRSrcPdu):
              PduRSourcePduHandleId = 53
              PduRSrcPduDirection = RECEIVE
              PduRSrcPduRef = OBC_VCU_STATUS1_oKAMA_FP_EPT_0303_ee6e515c_Rx
              PduRSrcPduPduRBswModulesRef = CanIf
          BMS_TCU_oKAMA_FP_EPT_0303_2de3da2b_Rx: PduRRoutingPathCommunicationType=COMMUNICATION_INTERFACE, PduRLockRef=PduRLock_PduRExclusiveArea
            BMS_TCU_oKAMA_FP_EPT_0303_2de3da2b_Rx_f305f068_Rx (PduRDestPdu):
              PduRDestPduHandleId = 19
              PduRDestPduDirection = RECEIVE
              PduRDestPduRoutingType = API_FORWARDING
              PduRDestPduDataProcessing = IMMEDIATE
              PduRPduLengthHandlingStrategy = UNUSED
              PduRDestPduCrossPartitionDestination = false
              PduRDestPduRef = BMS_TCU_oKAMA_FP_EPT_0303_50945f58_Rx
              PduRDestPduPduRBswModulesRef = Com
            PduRSrcPdu_f305f068 (PduRSrcPdu): PduRSourcePduHandleId=19, PduRSrcPduDirection=RECEIVE, PduRSrcPduRef=BMS_TCU_oKAMA_FP_EPT_0303_2de3da2b_Rx, PduRSrcPduPduRBswModulesRef=CanIf
          DCDC_VCU_02_oKAMA_FP_EPT_0303_a764b53d_Rx: PduRRoutingPathCommunicationType=COMMUNICATION_INTERFACE, PduRLockRef=PduRLock_PduRExclusiveArea
            DCDC_VCU_02_oKAMA_FP_EPT_0303_a764b53d_Rx_325c4a3b_Rx (PduRDestPdu):
              PduRDestPduHandleId = 24
              PduRDestPduDirection = RECEIVE
              PduRDestPduRoutingType = API_FORWARDING
              PduRDestPduDataProcessing = IMMEDIATE
              PduRPduLengthHandlingStrategy = UNUSED
              PduRDestPduCrossPartitionDestination = false
              PduRDestPduRef = DCDC_VCU_02_oKAMA_FP_EPT_0303_0576f9fb_Rx
              PduRDestPduPduRBswModulesRef = Com
            PduRSrcPdu_325c4a3b (PduRSrcPdu): PduRSourcePduHandleId=24, PduRSrcPduDirection=RECEIVE, PduRSrcPduRef=DCDC_VCU_02_oKAMA_FP_EPT_0303_a764b53d_Rx, PduRSrcPduPduRBswModulesRef=CanIf
          BMS_Charge1_oKAMA_FP_EPT_0303_a3af9591_Rx: PduRRoutingPathCommunicationType=COMMUNICATION_INTERFACE, PduRLockRef=PduRLock_PduRExclusiveArea
            PduRSrcPdu_1f099a13 (PduRSrcPdu): PduRSourcePduHandleId=9, PduRSrcPduDirection=RECEIVE, PduRSrcPduRef=BMS_Charge1_oKAMA_FP_EPT_0303_a3af9591_Rx, PduRSrcPduPduRBswModulesRef=CanIf
            BMS_Charge1_oKAMA_FP_EPT_0303_a3af9591_Rx_1f099a13_Rx (PduRDestPdu):
              PduRDestPduHandleId = 9
              PduRDestPduDirection = RECEIVE
              PduRDestPduRoutingType = API_FORWARDING
              PduRDestPduDataProcessing = IMMEDIATE
              PduRPduLengthHandlingStrategy = UNUSED
              PduRDestPduCrossPartitionDestination = false
              PduRDestPduRef = BMS_Charge1_oKAMA_FP_EPT_0303_0f6fc3b3_Rx
              PduRDestPduPduRBswModulesRef = Com
          MCU_DeratingStatus_oKAMA_FP_EPT_0303_31c5eddc_Rx: PduRRoutingPathCommunicationType=COMMUNICATION_INTERFACE, PduRLockRef=PduRLock_PduRExclusiveArea
            PduRSrcPdu_4eabb308 (PduRSrcPdu):
              PduRSourcePduHandleId = 43
              PduRSrcPduDirection = RECEIVE
              PduRSrcPduRef = MCU_DeratingStatus_oKAMA_FP_EPT_0303_31c5eddc_Rx
              PduRSrcPduPduRBswModulesRef = CanIf
            MCU_DeratingStatus_oKAMA_FP_EPT_0303_31c5eddc_Rx_4eabb308_Rx (PduRDestPdu):
              PduRDestPduHandleId = 43
              PduRDestPduDirection = RECEIVE
              PduRDestPduRoutingType = API_FORWARDING
              PduRDestPduDataProcessing = IMMEDIATE
              PduRPduLengthHandlingStrategy = UNUSED
              PduRDestPduCrossPartitionDestination = false
              PduRDestPduRef = MCU_DeratingStatus_oKAMA_FP_EPT_0303_9e0fe5b3_Rx
              PduRDestPduPduRBswModulesRef = Com
          REPS_DM3_oKAMA_FP_EPSChassis1_0303_1b450c81_Rx: PduRRoutingPathCommunicationType=COMMUNICATION_INTERFACE, PduRLockRef=PduRLock_PduRExclusiveArea
            PduRSrcPdu_60b93a41 (PduRSrcPdu):
              PduRSourcePduHandleId = 59
              PduRSrcPduDirection = RECEIVE
              PduRSrcPduRef = REPS_DM3_oKAMA_FP_EPSChassis1_0303_1b450c81_Rx
              PduRSrcPduPduRBswModulesRef = CanIf
            REPS_DM3_oKAMA_FP_EPSChassis1_0303_1b450c81_Rx_60b93a41_Rx (PduRDestPdu):
              PduRDestPduHandleId = 59
              PduRDestPduDirection = RECEIVE
              PduRDestPduRoutingType = API_FORWARDING
              PduRDestPduDataProcessing = IMMEDIATE
              PduRPduLengthHandlingStrategy = UNUSED
              PduRDestPduCrossPartitionDestination = false
              PduRDestPduRef = REPS_DM3_oKAMA_FP_EPSChassis1_0303_4915bac6_Rx
              PduRDestPduPduRBswModulesRef = Com
          BMS_BatInfor2_oKAMA_FP_EPT_0303_8ac956d0_Rx: PduRRoutingPathCommunicationType=COMMUNICATION_INTERFACE, PduRLockRef=PduRLock_PduRExclusiveArea
            PduRSrcPdu_da150b7c (PduRSrcPdu): PduRSourcePduHandleId=6, PduRSrcPduDirection=RECEIVE, PduRSrcPduRef=BMS_BatInfor2_oKAMA_FP_EPT_0303_8ac956d0_Rx, PduRSrcPduPduRBswModulesRef=CanIf
            BMS_BatInfor2_oKAMA_FP_EPT_0303_8ac956d0_Rx_da150b7c_Rx (PduRDestPdu):
              PduRDestPduHandleId = 6
              PduRDestPduDirection = RECEIVE
              PduRDestPduRoutingType = API_FORWARDING
              PduRDestPduDataProcessing = IMMEDIATE
              PduRPduLengthHandlingStrategy = UNUSED
              PduRDestPduCrossPartitionDestination = false
              PduRDestPduRef = BMS_BatInfor2_oKAMA_FP_EPT_0303_e514bb91_Rx
              PduRDestPduPduRBswModulesRef = Com
          REPS_DM2_oKAMA_FP_EPSChassis1_0303_668841be_Rx: PduRRoutingPathCommunicationType=COMMUNICATION_INTERFACE, PduRLockRef=PduRLock_PduRExclusiveArea
            PduRSrcPdu_490026ec (PduRSrcPdu):
              PduRSourcePduHandleId = 58
              PduRSrcPduDirection = RECEIVE
              PduRSrcPduRef = REPS_DM2_oKAMA_FP_EPSChassis1_0303_668841be_Rx
              PduRSrcPduPduRBswModulesRef = CanIf
            REPS_DM2_oKAMA_FP_EPSChassis1_0303_668841be_Rx_490026ec_Rx (PduRDestPdu):
              PduRDestPduHandleId = 58
              PduRDestPduDirection = RECEIVE
              PduRDestPduRoutingType = API_FORWARDING
              PduRDestPduDataProcessing = IMMEDIATE
              PduRPduLengthHandlingStrategy = UNUSED
              PduRDestPduCrossPartitionDestination = false
              PduRDestPduRef = REPS_DM2_oKAMA_FP_EPSChassis1_0303_2799a187_Rx
              PduRDestPduPduRBswModulesRef = Com
          VCU_Fault_01_oKAMA_FP_EPT_0303_43d9780b_Tx: PduRRoutingPathCommunicationType=COMMUNICATION_INTERFACE, PduRLockRef=PduRLock_PduRExclusiveArea
            VCU_Fault_01_oKAMA_FP_EPT_0303_a4273bfe_Tx (PduRDestPdu):
              PduRDestPduHandleId = 4
              PduRDestPduDirection = TRANSMIT
              PduRDestPduRoutingType = API_FORWARDING
              PduRDestPduDataProcessing = IMMEDIATE
              PduRPduLengthHandlingStrategy = UNUSED
              PduRDestPduCrossPartitionDestination = false
              PduRDestPduRef = VCU_Fault_01_oKAMA_FP_EPT_0303_a4273bfe_Tx
              PduRDestPduPduRBswModulesRef = CanIf
            PduRSrcPdu_39b59a25 (PduRSrcPdu): PduRSourcePduHandleId=6, PduRSrcPduDirection=TRANSMIT, PduRSrcPduRef=VCU_Fault_01_oKAMA_FP_EPT_0303_43d9780b_Tx, PduRSrcPduPduRBswModulesRef=Com
          ADAS_CCU1_Ctrl_oKAMA_FP_EPSChassis1_0303_5fa8e2ee_Rx: PduRRoutingPathCommunicationType=COMMUNICATION_INTERFACE, PduRLockRef=PduRLock_PduRExclusiveArea
            ADAS_CCU1_Ctrl_oKAMA_FP_EPSChassis1_0303_5fa8e2ee_Rx_304f5640_Rx (PduRDestPdu):
              PduRDestPduHandleId = 3
              PduRDestPduDirection = RECEIVE
              PduRDestPduRoutingType = API_FORWARDING
              PduRDestPduDataProcessing = IMMEDIATE
              PduRPduLengthHandlingStrategy = UNUSED
              PduRDestPduCrossPartitionDestination = false
              PduRDestPduRef = ADAS_CCU1_Ctrl_oKAMA_FP_EPSChassis1_0303_f573a88f_Rx
              PduRDestPduPduRBswModulesRef = Com
            PduRSrcPdu_304f5640 (PduRSrcPdu):
              PduRSourcePduHandleId = 3
              PduRSrcPduDirection = RECEIVE
              PduRSrcPduRef = ADAS_CCU1_Ctrl_oKAMA_FP_EPSChassis1_0303_5fa8e2ee_Rx
              PduRSrcPduPduRBswModulesRef = CanIf
          VCU_TCU_oKAMA_FP_EPT_0303_7cc42e59_Tx: PduRRoutingPathCommunicationType=COMMUNICATION_INTERFACE, PduRLockRef=PduRLock_PduRExclusiveArea
            PduRSrcPdu_436b6ccd (PduRSrcPdu): PduRSourcePduHandleId=20, PduRSrcPduDirection=TRANSMIT, PduRSrcPduRef=VCU_TCU_oKAMA_FP_EPT_0303_7cc42e59_Tx, PduRSrcPduPduRBswModulesRef=Com
            VCU_TCU_oKAMA_FP_EPT_0303_67d6755c_Tx (PduRDestPdu):
              PduRDestPduHandleId = 18
              PduRDestPduDirection = TRANSMIT
              PduRDestPduRoutingType = API_FORWARDING
              PduRDestPduDataProcessing = IMMEDIATE
              PduRPduLengthHandlingStrategy = UNUSED
              PduRDestPduCrossPartitionDestination = false
              PduRDestPduRef = VCU_TCU_oKAMA_FP_EPT_0303_67d6755c_Tx
              PduRDestPduPduRBswModulesRef = CanIf
          MCU_Temperature2_oKAMA_FP_EPT_0303_65fcc7b6_Rx: PduRRoutingPathCommunicationType=COMMUNICATION_INTERFACE, PduRLockRef=PduRLock_PduRExclusiveArea
            PduRSrcPdu_beb2e3f0 (PduRSrcPdu):
              PduRSourcePduHandleId = 49
              PduRSrcPduDirection = RECEIVE
              PduRSrcPduRef = MCU_Temperature2_oKAMA_FP_EPT_0303_65fcc7b6_Rx
              PduRSrcPduPduRBswModulesRef = CanIf
            MCU_Temperature2_oKAMA_FP_EPT_0303_65fcc7b6_Rx_beb2e3f0_Rx (PduRDestPdu):
              PduRDestPduHandleId = 49
              PduRDestPduDirection = RECEIVE
              PduRDestPduRoutingType = API_FORWARDING
              PduRDestPduDataProcessing = IMMEDIATE
              PduRPduLengthHandlingStrategy = UNUSED
              PduRDestPduCrossPartitionDestination = false
              PduRDestPduRef = MCU_Temperature2_oKAMA_FP_EPT_0303_01c16f81_Rx
              PduRDestPduPduRBswModulesRef = Com
          BMS_status_oKAMA_FP_EPT_0303_1bdce01b_Rx: PduRRoutingPathCommunicationType=COMMUNICATION_INTERFACE, PduRLockRef=PduRLock_PduRExclusiveArea
            BMS_status_oKAMA_FP_EPT_0303_1bdce01b_Rx_fddd5531_Rx (PduRDestPdu):
              PduRDestPduHandleId = 22
              PduRDestPduDirection = RECEIVE
              PduRDestPduRoutingType = API_FORWARDING
              PduRDestPduDataProcessing = IMMEDIATE
              PduRPduLengthHandlingStrategy = UNUSED
              PduRDestPduCrossPartitionDestination = false
              PduRDestPduRef = BMS_status_oKAMA_FP_EPT_0303_43eba5da_Rx
              PduRDestPduPduRBswModulesRef = Com
            PduRSrcPdu_fddd5531 (PduRSrcPdu): PduRSourcePduHandleId=22, PduRSrcPduDirection=RECEIVE, PduRSrcPduRef=BMS_status_oKAMA_FP_EPT_0303_1bdce01b_Rx, PduRSrcPduPduRBswModulesRef=CanIf
          IBS_Torque_oKAMA_FP_EPSChassis1_0303_7caf766a_Rx: PduRRoutingPathCommunicationType=COMMUNICATION_INTERFACE, PduRLockRef=PduRLock_PduRExclusiveArea
            IBS_Torque_oKAMA_FP_EPSChassis1_0303_7caf766a_Rx_cc585297_Rx (PduRDestPdu):
              PduRDestPduHandleId = 39
              PduRDestPduDirection = RECEIVE
              PduRDestPduRoutingType = API_FORWARDING
              PduRDestPduDataProcessing = IMMEDIATE
              PduRPduLengthHandlingStrategy = UNUSED
              PduRDestPduCrossPartitionDestination = false
              PduRDestPduRef = IBS_Torque_oKAMA_FP_EPSChassis1_0303_98aca4f8_Rx
              PduRDestPduPduRBswModulesRef = Com
            PduRSrcPdu_cc585297 (PduRSrcPdu):
              PduRSourcePduHandleId = 39
              PduRSrcPduDirection = RECEIVE
              PduRSrcPduRef = IBS_Torque_oKAMA_FP_EPSChassis1_0303_7caf766a_Rx
              PduRSrcPduPduRBswModulesRef = CanIf
          VCU_PlugInChrgInfo2_oKAMA_FP_EPSChassis1_0303_433d97e6_Tx: PduRRoutingPathCommunicationType=COMMUNICATION_INTERFACE, PduRLockRef=PduRLock_PduRExclusiveArea
            VCU_PlugInChrgInfo2_oKAMA_FP_EPSChassis1_0303_0a4512a8_Tx (PduRDestPdu):
              PduRDestPduHandleId = 15
              PduRDestPduDirection = TRANSMIT
              PduRDestPduRoutingType = API_FORWARDING
              PduRDestPduDataProcessing = IMMEDIATE
              PduRPduLengthHandlingStrategy = UNUSED
              PduRDestPduCrossPartitionDestination = false
              PduRDestPduRef = VCU_PlugInChrgInfo2_oKAMA_FP_EPSChassis1_0303_0a4512a8_Tx
              PduRDestPduPduRBswModulesRef = CanIf
            PduRSrcPdu_b1e8c7e9 (PduRSrcPdu):
              PduRSourcePduHandleId = 17
              PduRSrcPduDirection = TRANSMIT
              PduRSrcPduRef = VCU_PlugInChrgInfo2_oKAMA_FP_EPSChassis1_0303_433d97e6_Tx
              PduRSrcPduPduRBswModulesRef = Com
      PduRLock_PduRExclusiveArea (PduRLock)
        PduRExclusiveArea: PduRExclusiveAreaId=0
    CanIf (PduRBswModules):
      PduRCancelReceive = false
      PduRCancelTransmit = false
      PduRChangeParameterRequestApi = false
      PduRCommunicationInterface = true
      PduRLowerModule = true
      PduRTransportProtocol = false
      PduRTriggertransmit = false
      PduRTxConfirmation = true
      PduRUpperModule = false
      PduRUseTag = false
      PduRBswModuleRef = CanIf
    Com (PduRBswModules):
      PduRCancelReceive = false
      PduRCancelTransmit = false
      PduRChangeParameterRequestApi = false
      PduRCommunicationInterface = true
      PduRLowerModule = false
      PduRTransportProtocol = false
      PduRTriggertransmit = false
      PduRTxConfirmation = true
      PduRUpperModule = true
      PduRUseTag = false
      PduRBswModuleRef = Com
