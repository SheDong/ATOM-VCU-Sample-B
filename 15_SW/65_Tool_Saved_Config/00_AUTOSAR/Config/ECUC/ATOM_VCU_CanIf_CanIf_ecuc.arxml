AUTOSAR XML (schema 00048)
package /ActiveEcuC
  module config CanIf: implementation-config-variant=VARIANT-PRE-COMPILE, module-description=CanIf_Impl
    CanIfCtrlDrvCfg_7d254554 (CanIfCtrlDrvCfg): CanIfCtrlDrvTxCancellation=false, CanIfCtrlDrvInitHohConfigRef=CanIfInitHohCfg, CanIfCtrlDrvNameRef=CanGeneral
      CT_KAMA_FP_EPSChassis1_0303_8c9dce8f (CanIfCtrlCfg): CanIfCtrlId=0, CanIfCtrlWakeupSupport=false, CanIfCtrlJ1939DynAddrSupport=DISABLED, CanIfCtrlCanCtrlRef=CT_KAMA_FP_EPSChassis1_0303_8c9dce8f
      CT_KAMA_FP_EPT_0303_1b7da7f9 (CanIfCtrlCfg): CanIfCtrlId=0, CanIfCtrlWakeupSupport=false, CanIfCtrlJ1939DynAddrSupport=DISABLED, CanIfCtrlCanCtrlRef=CT_KAMA_FP_EPT_0303_1b7da7f9
    CanIfDispatchCfg:
      CanIfDispatchUserCtrlBusOffName = CanSM_ControllerBusOff
      CanIfDispatchUserCtrlBusOffUL = CAN_SM
      CanIfDispatchUserCtrlModeIndicationName = CanSM_ControllerModeIndication
      CanIfDispatchUserCtrlModeIndicationUL = CAN_SM
    CanIfInitCfg
      CanIfInitHohCfg: CanIfInitRefCfgSet=CanConfigSet
        CN_KAMA_FP_EPT_0303_275b3e6e_Tx (CanIfHthCfg): CanIfHthCanCtrlIdRef=CT_KAMA_FP_EPT_0303_1b7da7f9, CanIfHthIdSymRef=CN_KAMA_FP_EPT_0303_275b3e6e_Tx
        CN_KAMA_FP_EPSChassis1_0303_085b9bf0_Rx (CanIfHrhCfg): CanIfHrhSoftwareFilter=true, CanIfHrhCanCtrlIdRef=CT_KAMA_FP_EPSChassis1_0303_8c9dce8f, CanIfHrhIdSymRef=CN_KAMA_FP_EPSChassis1_0303_085b9bf0_Rx
        CN_KAMA_FP_EPT_0303_c7999d11_Rx (CanIfHrhCfg): CanIfHrhSoftwareFilter=true, CanIfHrhCanCtrlIdRef=CT_KAMA_FP_EPT_0303_1b7da7f9, CanIfHrhIdSymRef=CN_KAMA_FP_EPT_0303_c7999d11_Rx
        CN_KAMA_FP_EPSChassis1_0303_66acf324_Tx (CanIfHthCfg): CanIfHthCanCtrlIdRef=CT_KAMA_FP_EPSChassis1_0303_8c9dce8f, CanIfHthIdSymRef=CN_KAMA_FP_EPSChassis1_0303_66acf324_Tx
      3 x CanIfRxPduCfg, all with CanIfRxPduCanIdType=STANDARD_CAN, CanIfRxPduDlc=8, CanIfRxPduUserRxIndicationName=PduR_CanIfRxIndication, CanIfRxPduUserRxIndicationUL=PDUR, CanIfRxPduId=0, CanIfRxPduReadData=false, CanIfRxPduReadNotifyStatus=false, CanIfRxPduDlcCheck=true:
        BMS_CellVoltage1_oKAMA_FP_EPT_0303_003565b2_Rx: CanIfRxPduCanId=666, CanIfRxPduHrhIdRef=CN_KAMA_FP_EPT_0303_c7999d11_Rx, CanIfRxPduRef=BMS_CellVoltage1_oKAMA_FP_EPT_0303_e96b50f3_Rx
        MCU_VCU_1_oKAMA_FP_EPT_0303_2dca0f64_Rx: CanIfRxPduCanId=122, CanIfRxPduHrhIdRef=CN_KAMA_FP_EPT_0303_c7999d11_Rx, CanIfRxPduRef=MCU_VCU_1_oKAMA_FP_EPT_0303_ea4e79f6_Rx
        ADAS_APA_oKAMA_FP_EPSChassis1_0303_69c11a72_Rx: CanIfRxPduCanId=419, CanIfRxPduHrhIdRef=CN_KAMA_FP_EPSChassis1_0303_085b9bf0_Rx, CanIfRxPduRef=ADAS_APA_oKAMA_FP_EPSChassis1_0303_4a70cc95_Rx
      VCU_MCU_7A_oKAMA_FP_EPSChassis1_0303_e023b66e_Tx (CanIfTxPduCfg):
        CanIfTxPduCanId = 122
        CanIfTxPduCanIdType = STANDARD_CAN
        CanIfTxPduDlc = 8
        CanIfTxPduUserTxConfirmationName = PduR_CanIfTxConfirmation
        CanIfTxPduUserTxConfirmationUL = PDUR
        CanIfTxPduId = 0
        CanIfTxPduReadNotifyStatus = false
        CanIfTxPduType = STATIC
        CanIfTxPduTruncation = true
        CanIfTxPduBufferRef = CHNL_c5d82a30
        CanIfTxPduRef = VCU_MCU_7A_oKAMA_FP_EPSChassis1_0303_8ee5ed3e_Tx
      3 x CanIfRxPduCfg, all with CanIfRxPduCanIdType=STANDARD_CAN, CanIfRxPduDlc=8, CanIfRxPduUserRxIndicationName=PduR_CanIfRxIndication, CanIfRxPduUserRxIndicationUL=PDUR, CanIfRxPduId=0, CanIfRxPduReadData=false, CanIfRxPduReadNotifyStatus=false, CanIfRxPduDlcCheck=true:
        IBS1_acceleration_oKAMA_FP_EPSChassis1_0303_318abbc6_Rx: CanIfRxPduCanId=92, CanIfRxPduHrhIdRef=CN_KAMA_FP_EPSChassis1_0303_085b9bf0_Rx, CanIfRxPduRef=IBS1_acceleration_oKAMA_FP_EPSChassis1_0303_2a04e229_Rx
        TCU_ACStatusInfo_oKAMA_FP_EPT_0303_3a36ca0c_Rx: CanIfRxPduCanId=754, CanIfRxPduHrhIdRef=CN_KAMA_FP_EPT_0303_c7999d11_Rx, CanIfRxPduRef=TCU_ACStatusInfo_oKAMA_FP_EPT_0303_5e6e4459_Rx
        DonorCar_MMI_Status_Infor_oKAMA_FP_EPSChassis1_0303_e23866d1_Rx: CanIfRxPduCanId=676, CanIfRxPduHrhIdRef=CN_KAMA_FP_EPSChassis1_0303_085b9bf0_Rx, CanIfRxPduRef=DonorCar_MMI_Status_Infor_oKAMA_FP_EPSChassis1_0303_e08f1a5b_Rx
      Uds_EPT_Boot_Response_oKAMA_FP_EPT_0303_638ab6e1_Tx (CanIfTxPduCfg):
        CanIfTxPduCanId = 1937
        CanIfTxPduCanIdType = STANDARD_CAN
        CanIfTxPduDlc = 8
        CanIfTxPduUserTxConfirmationName = PduR_CanIfTxConfirmation
        CanIfTxPduUserTxConfirmationUL = PDUR
        CanIfTxPduId = 0
        CanIfTxPduReadNotifyStatus = false
        CanIfTxPduType = STATIC
        CanIfTxPduTruncation = true
        CanIfTxPduBufferRef = CHNL_f95a0907
        CanIfTxPduRef = Uds_EPT_Boot_Response_oKAMA_FP_EPT_0303_ea2424f2_Tx
      REPS_DM2_oKAMA_FP_EPSChassis1_0303_6bfefe69_Rx (CanIfRxPduCfg):
        CanIfRxPduCanId = 1297
        CanIfRxPduCanIdType = STANDARD_CAN
        CanIfRxPduDlc = 8
        CanIfRxPduUserRxIndicationName = PduR_CanIfRxIndication
        CanIfRxPduUserRxIndicationUL = PDUR
        CanIfRxPduId = 0
        CanIfRxPduReadData = false
        CanIfRxPduReadNotifyStatus = false
        CanIfRxPduDlcCheck = true
        CanIfRxPduHrhIdRef = CN_KAMA_FP_EPSChassis1_0303_085b9bf0_Rx
        CanIfRxPduRef = REPS_DM2_oKAMA_FP_EPSChassis1_0303_668841be_Rx
      VCU_OdometerInfo_oKAMA_FP_EPSChassis1_0303_28515298_Tx (CanIfTxPduCfg):
        CanIfTxPduCanId = 633
        CanIfTxPduCanIdType = STANDARD_CAN
        CanIfTxPduDlc = 3
        CanIfTxPduUserTxConfirmationName = PduR_CanIfTxConfirmation
        CanIfTxPduUserTxConfirmationUL = PDUR
        CanIfTxPduId = 0
        CanIfTxPduReadNotifyStatus = false
        CanIfTxPduType = STATIC
        CanIfTxPduTruncation = true
        CanIfTxPduBufferRef = CHNL_c5d82a30
        CanIfTxPduRef = VCU_OdometerInfo_oKAMA_FP_EPSChassis1_0303_1b1e7931_Tx
      3 x CanIfRxPduCfg, all with CanIfRxPduCanIdType=STANDARD_CAN, CanIfRxPduDlc=8, CanIfRxPduUserRxIndicationName=PduR_CanIfRxIndication, CanIfRxPduUserRxIndicationUL=PDUR, CanIfRxPduId=0, CanIfRxPduReadData=false, CanIfRxPduReadNotifyStatus=false, CanIfRxPduDlcCheck=true:
        BMS_ChargeStop_oKAMA_FP_EPT_0303_1ceb81a2_Rx: CanIfRxPduCanId=660, CanIfRxPduHrhIdRef=CN_KAMA_FP_EPT_0303_c7999d11_Rx, CanIfRxPduRef=BMS_ChargeStop_oKAMA_FP_EPT_0303_5018d2ae_Rx
        DonorCar_ACM_Status_oKAMA_FP_EPSChassis1_0303_01a9ab30_Rx: CanIfRxPduCanId=896, CanIfRxPduHrhIdRef=CN_KAMA_FP_EPSChassis1_0303_085b9bf0_Rx, CanIfRxPduRef=DonorCar_ACM_Status_oKAMA_FP_EPSChassis1_0303_b1c292e5_Rx
        ADAS_ACC_oKAMA_FP_EPSChassis1_0303_7eade9a2_Rx: CanIfRxPduCanId=417, CanIfRxPduHrhIdRef=CN_KAMA_FP_EPSChassis1_0303_085b9bf0_Rx, CanIfRxPduRef=ADAS_ACC_oKAMA_FP_EPSChassis1_0303_0ad656f5_Rx
      VCU_Mileage_oKAMA_FP_EPT_0303_d4446e5b_Tx (CanIfTxPduCfg):
        CanIfTxPduCanId = 950
        CanIfTxPduCanIdType = STANDARD_CAN
        CanIfTxPduDlc = 8
        CanIfTxPduUserTxConfirmationName = PduR_CanIfTxConfirmation
        CanIfTxPduUserTxConfirmationUL = PDUR
        CanIfTxPduId = 0
        CanIfTxPduReadNotifyStatus = false
        CanIfTxPduType = STATIC
        CanIfTxPduTruncation = true
        CanIfTxPduBufferRef = CHNL_f95a0907
        CanIfTxPduRef = VCU_Mileage_oKAMA_FP_EPT_0303_cc59f83c_Tx
      6 x CanIfRxPduCfg, all with CanIfRxPduCanIdType=STANDARD_CAN, CanIfRxPduDlc=8, CanIfRxPduUserRxIndicationName=PduR_CanIfRxIndication, CanIfRxPduUserRxIndicationUL=PDUR, CanIfRxPduId=0, CanIfRxPduReadData=false, CanIfRxPduReadNotifyStatus=false, CanIfRxPduDlcCheck=true:
        MCU_HardwareNumber_oKAMA_FP_EPT_0303_4a44124e_Rx: CanIfRxPduCanId=1179, CanIfRxPduHrhIdRef=CN_KAMA_FP_EPT_0303_c7999d11_Rx, CanIfRxPduRef=MCU_HardwareNumber_oKAMA_FP_EPT_0303_4cd13962_Rx
        BMS_Charge1_oKAMA_FP_EPT_0303_14dbae87_Rx: CanIfRxPduCanId=661, CanIfRxPduHrhIdRef=CN_KAMA_FP_EPT_0303_c7999d11_Rx, CanIfRxPduRef=BMS_Charge1_oKAMA_FP_EPT_0303_a3af9591_Rx
        MCU_FailureCode_oKAMA_FP_EPT_0303_53fc0d63_Rx: CanIfRxPduCanId=710, CanIfRxPduHrhIdRef=CN_KAMA_FP_EPT_0303_c7999d11_Rx, CanIfRxPduRef=MCU_FailureCode_oKAMA_FP_EPT_0303_23e6845d_Rx
        OBC_VCU_STATUS2_oKAMA_FP_EPT_0303_b51864c0_Rx: CanIfRxPduCanId=888, CanIfRxPduHrhIdRef=CN_KAMA_FP_EPT_0303_c7999d11_Rx, CanIfRxPduRef=OBC_VCU_STATUS2_oKAMA_FP_EPT_0303_d1a52fc9_Rx
        EPS_FEEDBACK_oKAMA_FP_EPSChassis1_0303_17e17b5d_Rx: CanIfRxPduCanId=106, CanIfRxPduHrhIdRef=CN_KAMA_FP_EPSChassis1_0303_085b9bf0_Rx, CanIfRxPduRef=EPS_FEEDBACK_oKAMA_FP_EPSChassis1_0303_c3c7eb04_Rx
        MCU_Status_oKAMA_FP_EPT_0303_b7e357b8_Rx: CanIfRxPduCanId=125, CanIfRxPduHrhIdRef=CN_KAMA_FP_EPT_0303_c7999d11_Rx, CanIfRxPduRef=MCU_Status_oKAMA_FP_EPT_0303_7c8eb231_Rx
      VCU_PlugInChrgInfo2_oKAMA_FP_EPSChassis1_0303_f9c537c2_Tx (CanIfTxPduCfg):
        CanIfTxPduCanId = 637
        CanIfTxPduCanIdType = STANDARD_CAN
        CanIfTxPduDlc = 8
        CanIfTxPduUserTxConfirmationName = PduR_CanIfTxConfirmation
        CanIfTxPduUserTxConfirmationUL = PDUR
        CanIfTxPduId = 0
        CanIfTxPduReadNotifyStatus = false
        CanIfTxPduType = STATIC
        CanIfTxPduTruncation = true
        CanIfTxPduBufferRef = CHNL_c5d82a30
        CanIfTxPduRef = VCU_PlugInChrgInfo2_oKAMA_FP_EPSChassis1_0303_0a4512a8_Tx
      BMS_Temp_oKAMA_FP_EPT_0303_5cc55146_Rx (CanIfRxPduCfg):
        CanIfRxPduCanId = 801
        CanIfRxPduCanIdType = STANDARD_CAN
        CanIfRxPduDlc = 8
        CanIfRxPduUserRxIndicationName = PduR_CanIfRxIndication
        CanIfRxPduUserRxIndicationUL = PDUR
        CanIfRxPduId = 0
        CanIfRxPduReadData = false
        CanIfRxPduReadNotifyStatus = false
        CanIfRxPduDlcCheck = true
        CanIfRxPduHrhIdRef = CN_KAMA_FP_EPT_0303_c7999d11_Rx
        CanIfRxPduRef = BMS_Temp_oKAMA_FP_EPT_0303_acd24b10_Rx
      REPS_DM3_oKAMA_FP_EPSChassis1_0303_e15ad8da_Rx (CanIfRxPduCfg):
        CanIfRxPduCanId = 1298
        CanIfRxPduCanIdType = STANDARD_CAN
        CanIfRxPduDlc = 8
        CanIfRxPduUserRxIndicationName = PduR_CanIfRxIndication
        CanIfRxPduUserRxIndicationUL = PDUR
        CanIfRxPduId = 0
        CanIfRxPduReadData = false
        CanIfRxPduReadNotifyStatus = false
        CanIfRxPduDlcCheck = true
        CanIfRxPduHrhIdRef = CN_KAMA_FP_EPSChassis1_0303_085b9bf0_Rx
        CanIfRxPduRef = REPS_DM3_oKAMA_FP_EPSChassis1_0303_1b450c81_Rx
      VCU_DCDC_oKAMA_FP_EPT_0303_43dea208_Tx (CanIfTxPduCfg):
        CanIfTxPduCanId = 627
        CanIfTxPduCanIdType = STANDARD_CAN
        CanIfTxPduDlc = 8
        CanIfTxPduUserTxConfirmationName = PduR_CanIfTxConfirmation
        CanIfTxPduUserTxConfirmationUL = PDUR
        CanIfTxPduId = 0
        CanIfTxPduReadNotifyStatus = false
        CanIfTxPduType = STATIC
        CanIfTxPduTruncation = true
        CanIfTxPduBufferRef = CHNL_f95a0907
        CanIfTxPduRef = VCU_DCDC_oKAMA_FP_EPT_0303_5a1aa2b0_Tx
      6 x CanIfRxPduCfg, all with CanIfRxPduCanIdType=STANDARD_CAN, CanIfRxPduDlc=8, CanIfRxPduId=0, CanIfRxPduReadData=false, CanIfRxPduReadNotifyStatus=false, CanIfRxPduDlcCheck=true:
        ADAS_AEB_oKAMA_FP_EPSChassis1_0303_c1355d30_Rx: CanIfRxPduCanId=418, CanIfRxPduUserRxIndicationName=PduR_CanIfRxIndication, CanIfRxPduUserRxIndicationUL=PDUR, CanIfRxPduHrhIdRef=CN_KAMA_FP_EPSChassis1_0303_085b9bf0_Rx, CanIfRxPduRef=ADAS_AEB_oKAMA_FP_EPSChassis1_0303_75a15668_Rx
        BMS_PRO_oKAMA_FP_EPT_0303_ef03a68d_Rx: CanIfRxPduCanId=946, CanIfRxPduUserRxIndicationName=PduR_CanIfRxIndication, CanIfRxPduUserRxIndicationUL=PDUR, CanIfRxPduHrhIdRef=CN_KAMA_FP_EPT_0303_c7999d11_Rx, CanIfRxPduRef=BMS_PRO_oKAMA_FP_EPT_0303_04956e69_Rx
        OBDFunRequest_Tp_oKAMA_FP_EPT_0303_36b94ede_Rx: CanIfRxPduCanId=1843, CanIfRxPduUserRxIndicationName=CanTp_RxIndication, CanIfRxPduUserRxIndicationType=PDUID_PDUINFOPTR, CanIfRxPduUserRxIndicationUL=CAN_TP, CanIfRxPduHrhIdRef=CN_KAMA_FP_EPT_0303_c7999d11_Rx, CanIfRxPduRef=OBDFunRequest_Tp_oKAMA_FP_EPT_0303_6d77999b_Rx
        Uds_EPT_Boot_Request_oKAMA_FP_EPT_0303_2c46a1c3_Rx: CanIfRxPduCanId=1809, CanIfRxPduUserRxIndicationName=PduR_CanIfRxIndication, CanIfRxPduUserRxIndicationUL=PDUR, CanIfRxPduHrhIdRef=CN_KAMA_FP_EPT_0303_c7999d11_Rx, CanIfRxPduRef=Uds_EPT_Boot_Request_oKAMA_FP_EPT_0303_f415a987_Rx
        IBS_Status1_oKAMA_FP_EPSChassis1_0303_a121fd4b_Rx: CanIfRxPduCanId=90, CanIfRxPduUserRxIndicationName=PduR_CanIfRxIndication, CanIfRxPduUserRxIndicationUL=PDUR, CanIfRxPduHrhIdRef=CN_KAMA_FP_EPSChassis1_0303_085b9bf0_Rx, CanIfRxPduRef=IBS_Status1_oKAMA_FP_EPSChassis1_0303_293b2077_Rx
        IBS_Status3_oKAMA_FP_EPSChassis1_0303_94ac1a81_Rx: CanIfRxPduCanId=93, CanIfRxPduUserRxIndicationName=PduR_CanIfRxIndication, CanIfRxPduUserRxIndicationUL=PDUR, CanIfRxPduHrhIdRef=CN_KAMA_FP_EPSChassis1_0303_085b9bf0_Rx, CanIfRxPduRef=IBS_Status3_oKAMA_FP_EPSChassis1_0303_d2a1ba09_Rx
      VCU_TCU_oKAMA_FP_EPT_0303_ff5c3dc8_Tx (CanIfTxPduCfg):
        CanIfTxPduCanId = 630
        CanIfTxPduCanIdType = STANDARD_CAN
        CanIfTxPduDlc = 8
        CanIfTxPduUserTxConfirmationName = PduR_CanIfTxConfirmation
        CanIfTxPduUserTxConfirmationUL = PDUR
        CanIfTxPduId = 0
        CanIfTxPduReadNotifyStatus = false
        CanIfTxPduType = STATIC
        CanIfTxPduTruncation = true
        CanIfTxPduBufferRef = CHNL_f95a0907
        CanIfTxPduRef = VCU_TCU_oKAMA_FP_EPT_0303_67d6755c_Tx
      GW_BCM_oKAMA_FP_EPT_0303_7e60a1ee_Rx (CanIfRxPduCfg):
        CanIfRxPduCanId = 911
        CanIfRxPduCanIdType = STANDARD_CAN
        CanIfRxPduDlc = 8
        CanIfRxPduUserRxIndicationName = PduR_CanIfRxIndication
        CanIfRxPduUserRxIndicationUL = PDUR
        CanIfRxPduId = 0
        CanIfRxPduReadData = false
        CanIfRxPduReadNotifyStatus = false
        CanIfRxPduDlcCheck = true
        CanIfRxPduHrhIdRef = CN_KAMA_FP_EPT_0303_c7999d11_Rx
        CanIfRxPduRef = GW_BCM_oKAMA_FP_EPT_0303_49041fc8_Rx
      VCU_MCU01_oKAMA_FP_EPT_0303_e460abec_Tx (CanIfTxPduCfg):
        CanIfTxPduCanId = 70
        CanIfTxPduCanIdType = STANDARD_CAN
        CanIfTxPduDlc = 8
        CanIfTxPduUserTxConfirmationName = PduR_CanIfTxConfirmation
        CanIfTxPduUserTxConfirmationUL = PDUR
        CanIfTxPduId = 0
        CanIfTxPduReadNotifyStatus = false
        CanIfTxPduType = STATIC
        CanIfTxPduTruncation = true
        CanIfTxPduBufferRef = CHNL_f95a0907
        CanIfTxPduRef = VCU_MCU01_oKAMA_FP_EPT_0303_e7022424_Tx
      5 x CanIfRxPduCfg, all with CanIfRxPduCanIdType=STANDARD_CAN, CanIfRxPduDlc=8, CanIfRxPduUserRxIndicationName=PduR_CanIfRxIndication, CanIfRxPduUserRxIndicationUL=PDUR, CanIfRxPduId=0, CanIfRxPduReadData=false, CanIfRxPduReadNotifyStatus=false, CanIfRxPduDlcCheck=true:
        DonorCar_GSM_oKAMA_FP_EPSChassis1_0303_c1329406_Rx: CanIfRxPduCanId=325, CanIfRxPduHrhIdRef=CN_KAMA_FP_EPSChassis1_0303_085b9bf0_Rx, CanIfRxPduRef=DonorCar_GSM_oKAMA_FP_EPSChassis1_0303_7cec353b_Rx
        EVCOM_State_oKAMA_FP_EPT_0303_2c5fc2af_Rx: CanIfRxPduCanId=715, CanIfRxPduHrhIdRef=CN_KAMA_FP_EPT_0303_c7999d11_Rx, CanIfRxPduRef=EVCOM_State_oKAMA_FP_EPT_0303_d94c86f8_Rx
        MCU_SoftwareNumber_oKAMA_FP_EPT_0303_24a0ba77_Rx: CanIfRxPduCanId=1178, CanIfRxPduHrhIdRef=CN_KAMA_FP_EPT_0303_c7999d11_Rx, CanIfRxPduRef=MCU_SoftwareNumber_oKAMA_FP_EPT_0303_701182ec_Rx
        BMS_BatInfor1_oKAMA_FP_EPT_0303_1d33a15d_Rx: CanIfRxPduCanId=175, CanIfRxPduHrhIdRef=CN_KAMA_FP_EPT_0303_c7999d11_Rx, CanIfRxPduRef=BMS_BatInfor1_oKAMA_FP_EPT_0303_b5022845_Rx
        DCDC_VCU_01_oKAMA_FP_EPT_0303_b08551e5_Rx: CanIfRxPduCanId=885, CanIfRxPduHrhIdRef=CN_KAMA_FP_EPT_0303_c7999d11_Rx, CanIfRxPduRef=DCDC_VCU_01_oKAMA_FP_EPT_0303_98afcba8_Rx
      UDSResponse_Tp_oKAMA_FP_EPT_0303_fcc081e7_Tx (CanIfTxPduCfg):
        CanIfTxPduCanId = 1836
        CanIfTxPduCanIdType = STANDARD_CAN
        CanIfTxPduDlc = 8
        CanIfTxPduUserTxConfirmationName = CanTp_TxConfirmation
        CanIfTxPduUserTxConfirmationUL = CAN_TP
        CanIfTxPduId = 0
        CanIfTxPduReadNotifyStatus = false
        CanIfTxPduType = STATIC
        CanIfTxPduTruncation = true
        CanIfTxPduBufferRef = CHNL_f95a0907
        CanIfTxPduRef = UDSResponse_Tp_oKAMA_FP_EPT_0303_cf83fc46_Tx
      REPS_DM1_oKAMA_FP_EPSChassis1_0303_2f6393fd_Rx (CanIfRxPduCfg):
        CanIfRxPduCanId = 1296
        CanIfRxPduCanIdType = STANDARD_CAN
        CanIfRxPduDlc = 8
        CanIfRxPduUserRxIndicationName = PduR_CanIfRxIndication
        CanIfRxPduUserRxIndicationUL = PDUR
        CanIfRxPduId = 0
        CanIfRxPduReadData = false
        CanIfRxPduReadNotifyStatus = false
        CanIfRxPduDlcCheck = true
        CanIfRxPduHrhIdRef = CN_KAMA_FP_EPSChassis1_0303_085b9bf0_Rx
        CanIfRxPduRef = REPS_DM1_oKAMA_FP_EPSChassis1_0303_e0df96ff_Rx
      VCU_PlugInChrgInfo1_oKAMA_FP_EPSChassis1_0303_cc88d0e0_Tx (CanIfTxPduCfg):
        CanIfTxPduCanId = 638
        CanIfTxPduCanIdType = STANDARD_CAN
        CanIfTxPduDlc = 8
        CanIfTxPduUserTxConfirmationName = PduR_CanIfTxConfirmation
        CanIfTxPduUserTxConfirmationUL = PDUR
        CanIfTxPduId = 0
        CanIfTxPduReadNotifyStatus = false
        CanIfTxPduType = STATIC
        CanIfTxPduTruncation = true
        CanIfTxPduBufferRef = CHNL_c5d82a30
        CanIfTxPduRef = VCU_PlugInChrgInfo1_oKAMA_FP_EPSChassis1_0303_8c12c5e9_Tx
      6 x CanIfRxPduCfg, all with CanIfRxPduCanIdType=STANDARD_CAN, CanIfRxPduDlc=8, CanIfRxPduId=0, CanIfRxPduReadData=false, CanIfRxPduReadNotifyStatus=false, CanIfRxPduDlcCheck=true:
        POD_VCU_Status_01_oKAMA_FP_EPT_0303_c64791e3_Rx: CanIfRxPduCanId=880, CanIfRxPduUserRxIndicationName=PduR_CanIfRxIndication, CanIfRxPduUserRxIndicationUL=PDUR, CanIfRxPduHrhIdRef=CN_KAMA_FP_EPT_0303_c7999d11_Rx, CanIfRxPduRef=POD_VCU_Status_01_oKAMA_FP_EPT_0303_d96a2947_Rx
        UDSRequest_Tp_oKAMA_FP_EPT_0303_8126794a_Rx: CanIfRxPduCanId=1964, CanIfRxPduUserRxIndicationName=CanTp_RxIndication, CanIfRxPduUserRxIndicationType=PDUID_PDUINFOPTR, CanIfRxPduUserRxIndicationUL=CAN_TP, CanIfRxPduHrhIdRef=CN_KAMA_FP_EPT_0303_c7999d11_Rx, CanIfRxPduRef=UDSRequest_Tp_oKAMA_FP_EPT_0303_e2705bdf_Rx
        BMS_DisChargeEnergy_oKAMA_FP_EPT_0303_3673c66e_Rx: CanIfRxPduCanId=1172, CanIfRxPduUserRxIndicationName=PduR_CanIfRxIndication, CanIfRxPduUserRxIndicationUL=PDUR, CanIfRxPduHrhIdRef=CN_KAMA_FP_EPT_0303_c7999d11_Rx, CanIfRxPduRef=BMS_DisChargeEnergy_oKAMA_FP_EPT_0303_96fcbd4c_Rx
        POD_VCU_Status_02_oKAMA_FP_EPT_0303_ea75a520_Rx: CanIfRxPduCanId=881, CanIfRxPduUserRxIndicationName=PduR_CanIfRxIndication, CanIfRxPduUserRxIndicationUL=PDUR, CanIfRxPduHrhIdRef=CN_KAMA_FP_EPT_0303_c7999d11_Rx, CanIfRxPduRef=POD_VCU_Status_02_oKAMA_FP_EPT_0303_e6a157d2_Rx
        YRS_1_oKAMA_FP_EPSChassis1_0303_c431ecdd_Rx: CanIfRxPduCanId=304, CanIfRxPduUserRxIndicationName=PduR_CanIfRxIndication, CanIfRxPduUserRxIndicationUL=PDUR, CanIfRxPduHrhIdRef=CN_KAMA_FP_EPSChassis1_0303_085b9bf0_Rx, CanIfRxPduRef=YRS_1_oKAMA_FP_EPSChassis1_0303_2228b3b5_Rx
        IBS_Status2_oKAMA_FP_EPSChassis1_0303_8e6ae964_Rx: CanIfRxPduCanId=91, CanIfRxPduUserRxIndicationName=PduR_CanIfRxIndication, CanIfRxPduUserRxIndicationUL=PDUR, CanIfRxPduHrhIdRef=CN_KAMA_FP_EPSChassis1_0303_085b9bf0_Rx, CanIfRxPduRef=IBS_Status2_oKAMA_FP_EPSChassis1_0303_af6cf736_Rx
      CHNL_f95a0907 (CanIfBufferCfg):
        CanIfBufferSize = 0
        CanIfTxBufferHandlingType = NONE
        CanIfTxBufferMappedTxPdus = 12
        CanIfTxBufferMaxPduLength = 8
        CanIfBufferHthRef = CN_KAMA_FP_EPT_0303_275b3e6e_Tx
      8 x CanIfRxPduCfg, all with CanIfRxPduCanIdType=STANDARD_CAN, CanIfRxPduDlc=8, CanIfRxPduId=0, CanIfRxPduReadData=false, CanIfRxPduReadNotifyStatus=false, CanIfRxPduDlcCheck=true:
        OBC_Error_STATUS_oKAMA_FP_EPT_0303_0b7fcc08_Rx: CanIfRxPduCanId=890, CanIfRxPduUserRxIndicationName=PduR_CanIfRxIndication, CanIfRxPduUserRxIndicationUL=PDUR, CanIfRxPduHrhIdRef=CN_KAMA_FP_EPT_0303_c7999d11_Rx, CanIfRxPduRef=OBC_Error_STATUS_oKAMA_FP_EPT_0303_52154d12_Rx
        DCDC_VCU_02_oKAMA_FP_EPT_0303_73c3f134_Rx: CanIfRxPduCanId=886, CanIfRxPduUserRxIndicationName=PduR_CanIfRxIndication, CanIfRxPduUserRxIndicationUL=PDUR, CanIfRxPduHrhIdRef=CN_KAMA_FP_EPT_0303_c7999d11_Rx, CanIfRxPduRef=DCDC_VCU_02_oKAMA_FP_EPT_0303_a764b53d_Rx
        YRS_2_oKAMA_FP_EPSChassis1_0303_82aaf381_Rx: CanIfRxPduCanId=305, CanIfRxPduUserRxIndicationName=PduR_CanIfRxIndication, CanIfRxPduUserRxIndicationUL=PDUR, CanIfRxPduHrhIdRef=CN_KAMA_FP_EPSChassis1_0303_085b9bf0_Rx, CanIfRxPduRef=YRS_2_oKAMA_FP_EPSChassis1_0303_a47f64f4_Rx
        AllFunctionRequest_Tp_oKAMA_FP_EPT_0303_b8b29d63_Rx: CanIfRxPduCanId=2047, CanIfRxPduUserRxIndicationName=CanTp_RxIndication, CanIfRxPduUserRxIndicationType=PDUID_PDUINFOPTR, CanIfRxPduUserRxIndicationUL=CAN_TP, CanIfRxPduHrhIdRef=CN_KAMA_FP_EPT_0303_c7999d11_Rx, CanIfRxPduRef=AllFunctionRequest_Tp_oKAMA_FP_EPT_0303_75b1cd6d_Rx
        TCU_AmbientTemp_oKAMA_FP_EPT_0303_96196250_Rx: CanIfRxPduCanId=706, CanIfRxPduUserRxIndicationName=PduR_CanIfRxIndication, CanIfRxPduUserRxIndicationUL=PDUR, CanIfRxPduHrhIdRef=CN_KAMA_FP_EPT_0303_c7999d11_Rx, CanIfRxPduRef=TCU_AmbientTemp_oKAMA_FP_EPT_0303_b02dde55_Rx
        BMS_ErrorInfo1_oKAMA_FP_EPT_0303_62a1c363_Rx: CanIfRxPduCanId=898, CanIfRxPduUserRxIndicationName=PduR_CanIfRxIndication, CanIfRxPduUserRxIndicationUL=PDUR, CanIfRxPduHrhIdRef=CN_KAMA_FP_EPT_0303_c7999d11_Rx, CanIfRxPduRef=BMS_ErrorInfo1_oKAMA_FP_EPT_0303_6e0c791e_Rx
        BMS_Batcode_oKAMA_FP_EPT_0303_a118a926_Rx: CanIfRxPduCanId=897, CanIfRxPduUserRxIndicationName=PduR_CanIfRxIndication, CanIfRxPduUserRxIndicationUL=PDUR, CanIfRxPduHrhIdRef=CN_KAMA_FP_EPT_0303_c7999d11_Rx, CanIfRxPduRef=BMS_Batcode_oKAMA_FP_EPT_0303_bf81843e_Rx
        IBS_Torque_oKAMA_FP_EPSChassis1_0303_976c07b6_Rx: CanIfRxPduCanId=94, CanIfRxPduUserRxIndicationName=PduR_CanIfRxIndication, CanIfRxPduUserRxIndicationUL=PDUR, CanIfRxPduHrhIdRef=CN_KAMA_FP_EPSChassis1_0303_085b9bf0_Rx, CanIfRxPduRef=IBS_Torque_oKAMA_FP_EPSChassis1_0303_7caf766a_Rx
      VCU_PwrtrainRequests_oKAMA_FP_EPSChassis1_0303_7cd4eb88_Tx (CanIfTxPduCfg):
        CanIfTxPduCanId = 634
        CanIfTxPduCanIdType = STANDARD_CAN
        CanIfTxPduDlc = 8
        CanIfTxPduUserTxConfirmationName = PduR_CanIfTxConfirmation
        CanIfTxPduUserTxConfirmationUL = PDUR
        CanIfTxPduId = 0
        CanIfTxPduReadNotifyStatus = false
        CanIfTxPduType = STATIC
        CanIfTxPduTruncation = true
        CanIfTxPduBufferRef = CHNL_c5d82a30
        CanIfTxPduRef = VCU_PwrtrainRequests_oKAMA_FP_EPSChassis1_0303_ba8adde5_Tx
      DonorCar_BCM_LDoorWindowState_oKAMA_FP_EPSChassis1_0303_7e3d4313_Rx (CanIfRxPduCfg):
        CanIfRxPduCanId = 645
        CanIfRxPduCanIdType = STANDARD_CAN
        CanIfRxPduDlc = 8
        CanIfRxPduUserRxIndicationName = PduR_CanIfRxIndication
        CanIfRxPduUserRxIndicationUL = PDUR
        CanIfRxPduId = 0
        CanIfRxPduReadData = false
        CanIfRxPduReadNotifyStatus = false
        CanIfRxPduDlcCheck = true
        CanIfRxPduHrhIdRef = CN_KAMA_FP_EPSChassis1_0303_085b9bf0_Rx
        CanIfRxPduRef = DonorCar_BCM_LDoorWindowState_oKAMA_FP_EPSChassis1_0303_25e710b8_Rx
      IBS_WheelSpeed_oKAMA_FP_EPSChassis1_0303_613feb30_Rx (CanIfRxPduCfg):
        CanIfRxPduCanId = 88
        CanIfRxPduCanIdType = STANDARD_CAN
        CanIfRxPduDlc = 8
        CanIfRxPduUserRxIndicationName = PduR_CanIfRxIndication
        CanIfRxPduUserRxIndicationUL = PDUR
        CanIfRxPduId = 0
        CanIfRxPduReadData = false
        CanIfRxPduReadNotifyStatus = false
        CanIfRxPduDlcCheck = true
        CanIfRxPduHrhIdRef = CN_KAMA_FP_EPSChassis1_0303_085b9bf0_Rx
        CanIfRxPduRef = IBS_WheelSpeed_oKAMA_FP_EPSChassis1_0303_fab7be15_Rx
      VCU_OBC_oKAMA_FP_EPT_0303_c0892a4e_Tx (CanIfTxPduCfg):
        CanIfTxPduCanId = 628
        CanIfTxPduCanIdType = STANDARD_CAN
        CanIfTxPduDlc = 8
        CanIfTxPduUserTxConfirmationName = PduR_CanIfTxConfirmation
        CanIfTxPduUserTxConfirmationUL = PDUR
        CanIfTxPduId = 0
        CanIfTxPduReadNotifyStatus = false
        CanIfTxPduType = STATIC
        CanIfTxPduTruncation = true
        CanIfTxPduBufferRef = CHNL_f95a0907
        CanIfTxPduRef = VCU_OBC_oKAMA_FP_EPT_0303_39c153bb_Tx
      5 x CanIfRxPduCfg, all with CanIfRxPduCanIdType=STANDARD_CAN, CanIfRxPduDlc=8, CanIfRxPduUserRxIndicationName=PduR_CanIfRxIndication, CanIfRxPduUserRxIndicationUL=PDUR, CanIfRxPduId=0, CanIfRxPduReadData=false, CanIfRxPduReadNotifyStatus=false, CanIfRxPduDlcCheck=true:
        TCU_Cmd_oKAMA_FP_EPT_0303_e185f0f9_Rx: CanIfRxPduCanId=705, CanIfRxPduHrhIdRef=CN_KAMA_FP_EPT_0303_c7999d11_Rx, CanIfRxPduRef=TCU_Cmd_oKAMA_FP_EPT_0303_4f820fd2_Rx
        ADAS_CCU1_Ctrl_oKAMA_FP_EPSChassis1_0303_bdc96711_Rx: CanIfRxPduCanId=416, CanIfRxPduHrhIdRef=CN_KAMA_FP_EPSChassis1_0303_085b9bf0_Rx, CanIfRxPduRef=ADAS_CCU1_Ctrl_oKAMA_FP_EPSChassis1_0303_5fa8e2ee_Rx
        IBS_VCUVLC_oKAMA_FP_EPSChassis1_0303_7f8d1548_Rx: CanIfRxPduCanId=95, CanIfRxPduHrhIdRef=CN_KAMA_FP_EPSChassis1_0303_085b9bf0_Rx, CanIfRxPduRef=IBS_VCUVLC_oKAMA_FP_EPSChassis1_0303_65a003e7_Rx
        BMS_TCU_oKAMA_FP_EPT_0303_c1758a45_Rx: CanIfRxPduCanId=803, CanIfRxPduHrhIdRef=CN_KAMA_FP_EPT_0303_c7999d11_Rx, CanIfRxPduRef=BMS_TCU_oKAMA_FP_EPT_0303_2de3da2b_Rx
        OBC_VCU_STATUS1_oKAMA_FP_EPT_0303_886fb7bf_Rx: CanIfRxPduCanId=887, CanIfRxPduHrhIdRef=CN_KAMA_FP_EPT_0303_c7999d11_Rx, CanIfRxPduRef=OBC_VCU_STATUS1_oKAMA_FP_EPT_0303_ee6e515c_Rx
      CHNL_c5d82a30 (CanIfBufferCfg):
        CanIfBufferSize = 0
        CanIfTxBufferHandlingType = NONE
        CanIfTxBufferMappedTxPdus = 10
        CanIfTxBufferMaxPduLength = 8
        CanIfBufferHthRef = CN_KAMA_FP_EPSChassis1_0303_66acf324_Tx
      VCU_HVbattStatus1_oKAMA_FP_EPSChassis1_0303_f4774873_Tx (CanIfTxPduCfg):
        CanIfTxPduCanId = 636
        CanIfTxPduCanIdType = STANDARD_CAN
        CanIfTxPduDlc = 8
        CanIfTxPduUserTxConfirmationName = PduR_CanIfTxConfirmation
        CanIfTxPduUserTxConfirmationUL = PDUR
        CanIfTxPduId = 0
        CanIfTxPduReadNotifyStatus = false
        CanIfTxPduType = STATIC
        CanIfTxPduTruncation = true
        CanIfTxPduBufferRef = CHNL_c5d82a30
        CanIfTxPduRef = VCU_HVbattStatus1_oKAMA_FP_EPSChassis1_0303_2775eb4c_Tx
      VCU_HMIsignals_oKAMA_FP_EPSChassis1_0303_6dacd0a9_Tx (CanIfTxPduCfg):
        CanIfTxPduCanId = 635
        CanIfTxPduCanIdType = STANDARD_CAN
        CanIfTxPduDlc = 8
        CanIfTxPduUserTxConfirmationName = PduR_CanIfTxConfirmation
        CanIfTxPduUserTxConfirmationUL = PDUR
        CanIfTxPduId = 0
        CanIfTxPduReadNotifyStatus = false
        CanIfTxPduType = STATIC
        CanIfTxPduTruncation = true
        CanIfTxPduBufferRef = CHNL_c5d82a30
        CanIfTxPduRef = VCU_HMIsignals_oKAMA_FP_EPSChassis1_0303_e417f061_Tx
      APTC_TCU_oKAMA_FP_EPT_0303_bf4381d8_Rx (CanIfRxPduCfg):
        CanIfRxPduCanId = 714
        CanIfRxPduCanIdType = STANDARD_CAN
        CanIfRxPduDlc = 8
        CanIfRxPduUserRxIndicationName = PduR_CanIfRxIndication
        CanIfRxPduUserRxIndicationUL = PDUR
        CanIfRxPduId = 0
        CanIfRxPduReadData = false
        CanIfRxPduReadNotifyStatus = false
        CanIfRxPduDlcCheck = true
        CanIfRxPduHrhIdRef = CN_KAMA_FP_EPT_0303_c7999d11_Rx
        CanIfRxPduRef = APTC_TCU_oKAMA_FP_EPT_0303_d0971361_Rx
      OBDRequest_Tp_oKAMA_FP_EPT_0303_4140ff42_Rx (CanIfRxPduCfg):
        CanIfRxPduCanId = 2016
        CanIfRxPduCanIdType = STANDARD_CAN
        CanIfRxPduDlc = 8
        CanIfRxPduUserRxIndicationName = CanTp_RxIndication
        CanIfRxPduUserRxIndicationType = PDUID_PDUINFOPTR
        CanIfRxPduUserRxIndicationUL = CAN_TP
        CanIfRxPduId = 0
        CanIfRxPduReadData = false
        CanIfRxPduReadNotifyStatus = false
        CanIfRxPduDlcCheck = true
        CanIfRxPduHrhIdRef = CN_KAMA_FP_EPT_0303_c7999d11_Rx
        CanIfRxPduRef = OBDRequest_Tp_oKAMA_FP_EPT_0303_a9730677_Rx
      VCU_chassis_oKAMA_FP_EPSChassis1_0303_fe288dbd_Tx (CanIfTxPduCfg):
        CanIfTxPduCanId = 338
        CanIfTxPduCanIdType = STANDARD_CAN
        CanIfTxPduDlc = 8
        CanIfTxPduUserTxConfirmationName = PduR_CanIfTxConfirmation
        CanIfTxPduUserTxConfirmationUL = PDUR
        CanIfTxPduId = 0
        CanIfTxPduReadNotifyStatus = false
        CanIfTxPduType = STATIC
        CanIfTxPduTruncation = true
        CanIfTxPduBufferRef = CHNL_c5d82a30
        CanIfTxPduRef = VCU_chassis_oKAMA_FP_EPSChassis1_0303_66946541_Tx
      4 x CanIfRxPduCfg, all with CanIfRxPduCanIdType=STANDARD_CAN, CanIfRxPduDlc=8, CanIfRxPduUserRxIndicationName=PduR_CanIfRxIndication, CanIfRxPduUserRxIndicationUL=PDUR, CanIfRxPduId=0, CanIfRxPduReadData=false, CanIfRxPduReadNotifyStatus=false, CanIfRxPduDlcCheck=true, CanIfRxPduHrhIdRef=CN_KAMA_FP_EPT_0303_c7999d11_Rx:
        BMS_ChargeEnergy_oKAMA_FP_EPT_0303_141839fe_Rx: CanIfRxPduCanId=1171, CanIfRxPduRef=BMS_ChargeEnergy_oKAMA_FP_EPT_0303_3ac5a6c0_Rx
        BMS_Insulation_oKAMA_FP_EPT_0303_420b5f11_Rx: CanIfRxPduCanId=912, CanIfRxPduRef=BMS_Insulation_oKAMA_FP_EPT_0303_66d8098f_Rx
        DonorCar_MMI_AC_Command_oKAMA_FP_EPT_0303_1f43d018_Rx: CanIfRxPduCanId=677, CanIfRxPduRef=DonorCar_MMI_AC_Command_oKAMA_FP_EPT_0303_0dbdd94d_Rx
        OBC_VCU_CHRGSTATION_ST_oKAMA_FP_EPT_0303_74e6df47_Rx: CanIfRxPduCanId=889, CanIfRxPduRef=OBC_VCU_CHRGSTATION_ST_oKAMA_FP_EPT_0303_a723cdbe_Rx
      VCU_PwrtrainHVbattStatus2_oKAMA_FP_EPSChassis1_0303_2356483b_Tx (CanIfTxPduCfg):
        CanIfTxPduCanId = 639
        CanIfTxPduCanIdType = STANDARD_CAN
        CanIfTxPduDlc = 8
        CanIfTxPduUserTxConfirmationName = PduR_CanIfTxConfirmation
        CanIfTxPduUserTxConfirmationUL = PDUR
        CanIfTxPduId = 0
        CanIfTxPduReadNotifyStatus = false
        CanIfTxPduType = STATIC
        CanIfTxPduTruncation = true
        CanIfTxPduBufferRef = CHNL_c5d82a30
        CanIfTxPduRef = VCU_PwrtrainHVbattStatus2_oKAMA_FP_EPSChassis1_0303_f8d9f820_Tx
      5 x CanIfRxPduCfg, all with CanIfRxPduCanIdType=STANDARD_CAN, CanIfRxPduDlc=8, CanIfRxPduId=0, CanIfRxPduReadData=false, CanIfRxPduReadNotifyStatus=false, CanIfRxPduDlcCheck=true:
        BMS_VersionInfor_oKAMA_FP_EPT_0303_63b58f3d_Rx: CanIfRxPduCanId=945, CanIfRxPduUserRxIndicationName=PduR_CanIfRxIndication, CanIfRxPduUserRxIndicationUL=PDUR, CanIfRxPduHrhIdRef=CN_KAMA_FP_EPT_0303_c7999d11_Rx, CanIfRxPduRef=BMS_VersionInfor_oKAMA_FP_EPT_0303_ee97b4a4_Rx
        BMS_PackVoltage_oKAMA_FP_EPT_0303_5ac5bfb8_Rx: CanIfRxPduCanId=665, CanIfRxPduUserRxIndicationName=PduR_CanIfRxIndication, CanIfRxPduUserRxIndicationUL=PDUR, CanIfRxPduHrhIdRef=CN_KAMA_FP_EPT_0303_c7999d11_Rx, CanIfRxPduRef=BMS_PackVoltage_oKAMA_FP_EPT_0303_97e1c558_Rx
        DonorCar_PEPS_Message_Sts_oKAMA_FP_EPSChassis1_0303_c892d5de_Rx: CanIfRxPduCanId=482, CanIfRxPduUserRxIndicationName=PduR_CanIfRxIndication, CanIfRxPduUserRxIndicationUL=PDUR, CanIfRxPduHrhIdRef=CN_KAMA_FP_EPSChassis1_0303_085b9bf0_Rx, CanIfRxPduRef=DonorCar_PEPS_Message_Sts_oKAMA_FP_EPSChassis1_0303_6824d552_Rx
        UDSFunRequest_Tp_oKAMA_FP_EPT_0303_be17c5a6_Rx: CanIfRxPduCanId=2015, CanIfRxPduUserRxIndicationName=CanTp_RxIndication, CanIfRxPduUserRxIndicationType=PDUID_PDUINFOPTR, CanIfRxPduUserRxIndicationUL=CAN_TP, CanIfRxPduHrhIdRef=CN_KAMA_FP_EPT_0303_c7999d11_Rx, CanIfRxPduRef=UDSFunRequest_Tp_oKAMA_FP_EPT_0303_2c00e7ab_Rx
        BMS_CurrentLimit_oKAMA_FP_EPT_0303_19e6c67a_Rx: CanIfRxPduCanId=662, CanIfRxPduUserRxIndicationName=PduR_CanIfRxIndication, CanIfRxPduUserRxIndicationUL=PDUR, CanIfRxPduHrhIdRef=CN_KAMA_FP_EPT_0303_c7999d11_Rx, CanIfRxPduRef=BMS_CurrentLimit_oKAMA_FP_EPT_0303_70231bec_Rx
      OBDResponse_Tp_oKAMA_FP_EPT_0303_72cc7b63_Tx (CanIfTxPduCfg):
        CanIfTxPduCanId = 2024
        CanIfTxPduCanIdType = STANDARD_CAN
        CanIfTxPduDlc = 8
        CanIfTxPduUserTxConfirmationName = CanTp_TxConfirmation
        CanIfTxPduUserTxConfirmationUL = CAN_TP
        CanIfTxPduId = 0
        CanIfTxPduReadNotifyStatus = false
        CanIfTxPduType = STATIC
        CanIfTxPduTruncation = true
        CanIfTxPduBufferRef = CHNL_f95a0907
        CanIfTxPduRef = OBDResponse_Tp_oKAMA_FP_EPT_0303_17c5d4c1_Tx
      VCU_AccPedal_oKAMA_FP_EPSChassis1_0303_37705ca5_Tx (CanIfTxPduCfg):
        CanIfTxPduCanId = 337
        CanIfTxPduCanIdType = STANDARD_CAN
        CanIfTxPduDlc = 8
        CanIfTxPduUserTxConfirmationName = PduR_CanIfTxConfirmation
        CanIfTxPduUserTxConfirmationUL = PDUR
        CanIfTxPduId = 0
        CanIfTxPduReadNotifyStatus = false
        CanIfTxPduType = STATIC
        CanIfTxPduTruncation = true
        CanIfTxPduBufferRef = CHNL_c5d82a30
        CanIfTxPduRef = VCU_AccPedal_oKAMA_FP_EPSChassis1_0303_6cab291a_Tx
      BMS_DIRelayState_oKAMA_FP_EPT_0303_801d8d3f_Rx (CanIfRxPduCfg):
        CanIfRxPduCanId = 659
        CanIfRxPduCanIdType = STANDARD_CAN
        CanIfRxPduDlc = 8
        CanIfRxPduUserRxIndicationName = PduR_CanIfRxIndication
        CanIfRxPduUserRxIndicationUL = PDUR
        CanIfRxPduId = 0
        CanIfRxPduReadData = false
        CanIfRxPduReadNotifyStatus = false
        CanIfRxPduDlcCheck = true
        CanIfRxPduHrhIdRef = CN_KAMA_FP_EPT_0303_c7999d11_Rx
        CanIfRxPduRef = BMS_DIRelayState_oKAMA_FP_EPT_0303_e4f455bd_Rx
      VCU_MCU02_oKAMA_FP_EPT_0303_8cbc4532_Tx (CanIfTxPduCfg):
        CanIfTxPduCanId = 71
        CanIfTxPduCanIdType = STANDARD_CAN
        CanIfTxPduDlc = 8
        CanIfTxPduUserTxConfirmationName = PduR_CanIfTxConfirmation
        CanIfTxPduUserTxConfirmationUL = PDUR
        CanIfTxPduId = 0
        CanIfTxPduReadNotifyStatus = false
        CanIfTxPduType = STATIC
        CanIfTxPduTruncation = true
        CanIfTxPduBufferRef = CHNL_f95a0907
        CanIfTxPduRef = VCU_MCU02_oKAMA_FP_EPT_0303_d8c95ab1_Tx
      BMS_BatInfor2_oKAMA_FP_EPT_0303_c889da4e_Rx (CanIfRxPduCfg):
        CanIfRxPduCanId = 1170
        CanIfRxPduCanIdType = STANDARD_CAN
        CanIfRxPduDlc = 8
        CanIfRxPduUserRxIndicationName = PduR_CanIfRxIndication
        CanIfRxPduUserRxIndicationUL = PDUR
        CanIfRxPduId = 0
        CanIfRxPduReadData = false
        CanIfRxPduReadNotifyStatus = false
        CanIfRxPduDlcCheck = true
        CanIfRxPduHrhIdRef = CN_KAMA_FP_EPT_0303_c7999d11_Rx
        CanIfRxPduRef = BMS_BatInfor2_oKAMA_FP_EPT_0303_8ac956d0_Rx
      VCU_Fault_01_oKAMA_FP_EPT_0303_7d915701_Tx (CanIfTxPduCfg):
        CanIfTxPduCanId = 949
        CanIfTxPduCanIdType = STANDARD_CAN
        CanIfTxPduDlc = 8
        CanIfTxPduUserTxConfirmationName = PduR_CanIfTxConfirmation
        CanIfTxPduUserTxConfirmationUL = PDUR
        CanIfTxPduId = 0
        CanIfTxPduReadNotifyStatus = false
        CanIfTxPduType = STATIC
        CanIfTxPduTruncation = true
        CanIfTxPduBufferRef = CHNL_f95a0907
        CanIfTxPduRef = VCU_Fault_01_oKAMA_FP_EPT_0303_a4273bfe_Tx
      MCU_DeratingStatus_oKAMA_FP_EPT_0303_fae78653_Rx (CanIfRxPduCfg):
        CanIfRxPduCanId = 709
        CanIfRxPduCanIdType = STANDARD_CAN
        CanIfRxPduDlc = 8
        CanIfRxPduUserRxIndicationName = PduR_CanIfRxIndication
        CanIfRxPduUserRxIndicationUL = PDUR
        CanIfRxPduId = 0
        CanIfRxPduReadData = false
        CanIfRxPduReadNotifyStatus = false
        CanIfRxPduDlcCheck = true
        CanIfRxPduHrhIdRef = CN_KAMA_FP_EPT_0303_c7999d11_Rx
        CanIfRxPduRef = MCU_DeratingStatus_oKAMA_FP_EPT_0303_31c5eddc_Rx
      VCU_BMS_oKAMA_FP_EPT_0303_c6405919_Tx (CanIfTxPduCfg):
        CanIfTxPduCanId = 161
        CanIfTxPduCanIdType = STANDARD_CAN
        CanIfTxPduDlc = 8
        CanIfTxPduUserTxConfirmationName = PduR_CanIfTxConfirmation
        CanIfTxPduUserTxConfirmationUL = PDUR
        CanIfTxPduId = 0
        CanIfTxPduReadNotifyStatus = false
        CanIfTxPduType = STATIC
        CanIfTxPduTruncation = true
        CanIfTxPduBufferRef = CHNL_f95a0907
        CanIfTxPduRef = VCU_BMS_oKAMA_FP_EPT_0303_0668934d_Tx
      3 x CanIfRxPduCfg, all with CanIfRxPduCanIdType=STANDARD_CAN, CanIfRxPduDlc=8, CanIfRxPduUserRxIndicationName=PduR_CanIfRxIndication, CanIfRxPduUserRxIndicationUL=PDUR, CanIfRxPduId=0, CanIfRxPduReadData=false, CanIfRxPduReadNotifyStatus=false, CanIfRxPduDlcCheck=true:
        IBS_WheelPulse_oKAMA_FP_EPSChassis1_0303_b5f3d735_Rx: CanIfRxPduCanId=89, CanIfRxPduHrhIdRef=CN_KAMA_FP_EPSChassis1_0303_085b9bf0_Rx, CanIfRxPduRef=IBS_WheelPulse_oKAMA_FP_EPSChassis1_0303_0327ced1_Rx
        MCU_Temperature2_oKAMA_FP_EPT_0303_9b13e1a5_Rx: CanIfRxPduCanId=124, CanIfRxPduHrhIdRef=CN_KAMA_FP_EPT_0303_c7999d11_Rx, CanIfRxPduRef=MCU_Temperature2_oKAMA_FP_EPT_0303_65fcc7b6_Rx
        TCU_Status_oKAMA_FP_EPT_0303_340eac49_Rx: CanIfRxPduCanId=704, CanIfRxPduHrhIdRef=CN_KAMA_FP_EPT_0303_c7999d11_Rx, CanIfRxPduRef=TCU_Status_oKAMA_FP_EPT_0303_6a5ccd57_Rx
      VCU_POD_oKAMA_FP_EPT_0303_6e454b54_Tx (CanIfTxPduCfg):
        CanIfTxPduCanId = 629
        CanIfTxPduCanIdType = STANDARD_CAN
        CanIfTxPduDlc = 8
        CanIfTxPduUserTxConfirmationName = PduR_CanIfTxConfirmation
        CanIfTxPduUserTxConfirmationUL = PDUR
        CanIfTxPduId = 0
        CanIfTxPduReadNotifyStatus = false
        CanIfTxPduType = STATIC
        CanIfTxPduTruncation = true
        CanIfTxPduBufferRef = CHNL_f95a0907
        CanIfTxPduRef = VCU_POD_oKAMA_FP_EPT_0303_efe06d9c_Tx
      4 x CanIfRxPduCfg, all with CanIfRxPduCanIdType=STANDARD_CAN, CanIfRxPduDlc=8, CanIfRxPduUserRxIndicationName=PduR_CanIfRxIndication, CanIfRxPduUserRxIndicationUL=PDUR, CanIfRxPduId=0, CanIfRxPduReadData=false, CanIfRxPduReadNotifyStatus=false, CanIfRxPduDlcCheck=true:
        YRS_7_oKAMA_FP_EPSChassis1_0303_4907d265_Rx: CanIfRxPduCanId=832, CanIfRxPduHrhIdRef=CN_KAMA_FP_EPSChassis1_0303_085b9bf0_Rx, CanIfRxPduRef=YRS_7_oKAMA_FP_EPSChassis1_0303_f5f61b76_Rx
        BMS_status_oKAMA_FP_EPT_0303_df11e831_Rx: CanIfRxPduCanId=174, CanIfRxPduHrhIdRef=CN_KAMA_FP_EPT_0303_c7999d11_Rx, CanIfRxPduRef=BMS_status_oKAMA_FP_EPT_0303_1bdce01b_Rx
        GW_TCU_AmbientTemp_oKAMA_FP_EPSChassis1_0303_3ea1f702_Rx: CanIfRxPduCanId=706, CanIfRxPduHrhIdRef=CN_KAMA_FP_EPSChassis1_0303_085b9bf0_Rx, CanIfRxPduRef=GW_TCU_AmbientTemp_oKAMA_FP_EPSChassis1_0303_3f0a1e15_Rx
        MCU_Temperature1_oKAMA_FP_EPT_0303_e9b0f8a2_Rx: CanIfRxPduCanId=123, CanIfRxPduHrhIdRef=CN_KAMA_FP_EPT_0303_c7999d11_Rx, CanIfRxPduRef=MCU_Temperature1_oKAMA_FP_EPT_0303_5a37b923_Rx
    CanIfPrivateCfg:
      CanIfPrivateSoftwareFilterType = LINEAR
      CanIfPrivateDlcCheck = true
      CanIfSupportTTCAN = false
      CanIfTransceiverMapping = false
      CanIfTransceiverHandling = false
      CanIfSupportExtendedIds = false
      CanIfSupportNmOsek = false
      CanIfTxBufferType = NONE
      CanIfWakeupSupport = false
      CanIfStaticFdTxBufferSupport = false
      CanIfRxSearchConsiderMsgType = false
      CanIfTxBufferFifoSupport = false
      CanIfSetPduReceptionModeSupport = false
      CanIfCheckWakeupCanRetType = false
      CanIfDataChecksumRxSupport = false
      CanIfDataChecksumTxSupport = false
    CanIfPublicCfg:
      CanIfPublicPnSupport = false
      CanIfPublicCancelTransmitSupport = false
      CanIfPublicDevErrorDetect = true
      CanIfPublicHandleTypeEnum = UINT8
      CanIfPublicMultipleDrvSupport = false
      CanIfPublicNumberOfCanHwUnits = 1
      CanIfPublicReadRxPduDataApi = false
      CanIfPublicReadRxPduNotifyStatusApi = false
      CanIfPublicReadTxPduNotifyStatusApi = false
      CanIfPublicSetDynamicTxIdApi = false
      CanIfPublicTxBuffering = true
      CanIfPublicTxConfirmPollingSupport = false
      CanIfPublicVersionInfoApi = false
      CanIfPublicWakeupCheckValidSupport = false
      CanIfPnWakeupTxPduFilterSupport = false
      CanIfPnTrcvHandlingSupport = false
      CanIfJ1939DynAddrSupport = DISABLED
      CanIfSafeBswChecks = false
      CanIfBusMirroringSupport = false
      CanIfEnableSecurityEventReporting = false
      CanIfSupportCanDrvAsr440 = false
      CanIfSetBaudrateApi = false
