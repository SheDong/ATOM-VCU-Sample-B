[part 1 of 2: package /ActiveEcuC]
AUTOSAR XML (schema 00048)
package /ActiveEcuC
  module config Com: implementation-config-variant=VARIANT-PRE-COMPILE, module-description=Com_Impl
    ComGeneration:
      ComOutOfBoundsWriteProtectionStrategy = NONE
      ComOutOfBoundsWriteSanitizer = false
      ComOutOfBoundsReadSanitizer = false
      ComReduceConstantData2Define = false
      ComBoolDataInArrayOfStructStrategy = BOOLEAN
      ComDeduplicateIndirectedData = true
      ComDataDeduplicationStrategy = WITH_CAST
      ComReduceBoolDataByNegationThreshold = 2
      ComReduceBoolDataByNumericalComparisonThreshold = 2
      ComReduceBoolDataByNumericalRelationThreshold = 2
      ComReduceBoolDataByNumericalOperandStrategy = WITH_ANY_VALUE
      ComReduceNumericalDataByOffsetThreshold = 2
      ComReduceNumericalDataByArraySubtractionThreshold = 2
      ComReduceDataByStreaming = false
      ComShortSymbols = false
      ComInterfacesForDeactivatedData = false
      ComReferringKeysInComments = false
    ComOptimization:
      ComTxProcessingISRLockThreshold = 1
      ComRxProcessingISRLockThreshold = 1
      ComGatewayProcessingISRLockThreshold = 1
      ComGatewayDescriptionProcessingISRLockThreshold = 1
      ComIPduGroupISRLockThreshold = 1
    ComConfig: ComConfigurationId=0, ComRxDeferredNotificationCacheSize=0, ComRxImmediateNotificationCacheSize=0
      IBS_VCUVLC_oKAMA_FP_EPSChassis1_0303_ba73f862_Rx (ComIPdu):
        ComIPduDirection = RECEIVE
        ComIPduType = NORMAL
        ComIPduHandleId = 40
        ComIPduSignalProcessing = DEFERRED
        ComIPduCancellationSupport = false
        ComIPduGroupRef = VCU_oKAMA_FP_EPSChassis1_0303_Rx_00807295
        ComIPduSignalRef = Checksum_5F_oIBS_VCUVLC_oKAMA_FP_EPSChassis1_0303_7ca73c24_Rx
        ComIPduSignalRef = IBS_VLCTorqueRequestValid_oIBS_VCUVLC_oKAMA_FP_EPSChassis1_0303_ed047cb9_Rx
        ComIPduSignalRef = IBS_VLCTorqueRequest_oIBS_VCUVLC_oKAMA_FP_EPSChassis1_0303_838cb94f_Rx
        ComIPduSignalRef = IBS_VehicleStandstill_Valid_oIBS_VCUVLC_oKAMA_FP_EPSChassis1_0303_03b42b1b_Rx
        ComIPduSignalRef = IBS_VehicleStandstill_oIBS_VCUVLC_oKAMA_FP_EPSChassis1_0303_a4c07af4_Rx
        ComIPduSignalRef = MessageCounter_5F_oIBS_VCUVLC_oKAMA_FP_EPSChassis1_0303_05563a9a_Rx
        ComPduIdRef = IBS_VCUVLC_oKAMA_FP_EPSChassis1_0303_ba73f862_Rx
      3 x ComSignal, all with ComSignalEndianness=BIG_ENDIAN, ComTimeout=0, ComSignalAccess=ACCESS_UNCLEAR:
        BMS_StateDI3_oBMS_DIRelayState_oKAMA_FP_EPT_0303_8c88f020_Rx: ComBitPosition=19, ComBitSize=2, ComSignalInitValue=0, ComSignalType=UINT8, ComHandleId=163, ComSystemTemplateSystemSignalRef=BMS_StateDI3
        OBC_DCVoltHighFault_oOBC_Error_STATUS_oKAMA_FP_EPT_0303_e7cb9c12_Rx: ComBitPosition=0, ComBitSize=1, ComSignalInitValue=0, ComSignalType=BOOLEAN, ComHandleId=449, ComSystemTemplateSystemSignalRef=OBC_DCVoltHighFault
        MCU_IGBTTempW_oMCU_Temperature1_oKAMA_FP_EPT_0303_ad54f439_Rx: ComBitPosition=23, ComBitSize=8, ComSignalInitValue=255, ComSignalType=UINT8, ComHandleId=363, ComSystemTemplateSystemSignalRef=MCU_IGBTTempW
      BMS_status_oKAMA_FP_EPT_0303_43eba5da_Rx (ComIPdu):
        ComIPduDirection = RECEIVE
        ComIPduType = NORMAL
        ComIPduHandleId = 22
        ComIPduSignalProcessing = DEFERRED
        ComIPduCancellationSupport = false
        ComIPduGroupRef = VCU_oKAMA_FP_EPT_0303_Rx_07e8d111
        ComIPduSignalRef = BMS_BalancingStatus_oBMS_status_oKAMA_FP_EPT_0303_b7466fbf_Rx
        ComIPduSignalRef = BMS_BatStatus_oBMS_status_oKAMA_FP_EPT_0303_3284b8ff_Rx
        ComIPduSignalRef = BMS_ChargeStatus_oBMS_status_oKAMA_FP_EPT_0303_65537a1e_Rx
        ComIPduSignalRef = BMS_ErrorLevel_oBMS_status_oKAMA_FP_EPT_0303_ecafdd61_Rx
        ComIPduSignalRef = BMS_HVinterlockState_oBMS_status_oKAMA_FP_EPT_0303_0e2d87b0_Rx
        ComIPduSignalRef = BMS_PreCharge_oBMS_status_oKAMA_FP_EPT_0303_314f9283_Rx
        ComIPduSignalRef = BMS_RunHeatStatus_oBMS_status_oKAMA_FP_EPT_0303_03521515_Rx
        ComIPduSignalRef = BMS_SOH_oBMS_status_oKAMA_FP_EPT_0303_3df0ba2b_Rx
        ComIPduSignalRef = BMS_status_oBMS_status_oKAMA_FP_EPT_0303_249dab61_Rx
        ComIPduSignalRef = Checksum_AE_oBMS_status_oKAMA_FP_EPT_0303_0c390b19_Rx
        ComIPduSignalRef = MessageCounter_AE_oBMS_status_oKAMA_FP_EPT_0303_23fec4ce_Rx
        ComPduIdRef = BMS_status_oKAMA_FP_EPT_0303_43eba5da_Rx
      23 x ComSignal, all with ComSignalEndianness=BIG_ENDIAN, ComTimeout=0, ComSignalAccess=ACCESS_UNCLEAR:
        BMS_SoftVsesion_oBMS_VersionInfor_oKAMA_FP_EPT_0303_e5dc0b22_Rx: ComBitPosition=7, ComBitSize=8, ComSignalInitValue=0, ComSignalType=UINT8, ComHandleId=161, ComSystemTemplateSystemSignalRef=BMS_SoftVsesion
        VCU_RegenTorqueActive_oVCU_chassis_oKAMA_FP_EPSChassis1_0303_818e9954_Tx: ComBitPosition=11, ComBitSize=1, ComSignalInitValue=0, ComSignalType=BOOLEAN, ComTransferProperty=PENDING, ComHandleId=101, ComSystemTemplateSystemSignalRef=VCU_RegenTorqueActive
        IBS_EPBFunctionLamp_oIBS_Status2_oKAMA_FP_EPSChassis1_0303_f0c81de1_Rx: ComBitPosition=41, ComBitSize=2, ComSignalInitValue=0, ComSignalType=UINT8, ComHandleId=293, ComSystemTemplateSystemSignalRef=IBS_EPBFunctionLamp
        MCU_OfsAl_oMCU_Status_oKAMA_FP_EPT_0303_bb17883f_Rx: ComBitPosition=7, ComBitSize=12, ComSignalInitValue=0, ComSignalType=UINT16, ComHandleId=367, ComSystemTemplateSystemSignalRef=MCU_OfsAl
        VCU_RegenTorqueCap_oVCU_chassis_oKAMA_FP_EPSChassis1_0303_c66ed8e8_Tx: ComBitPosition=23, ComBitSize=16, ComSignalInitValue=20000, ComSignalType=UINT16, ComTransferProperty=PENDING, ComHandleId=102, ComSystemTemplateSystemSignalRef=VCU_RegenTorqueCap
        VCU_UnavailHVChgReason_oVCU_PlugInChrgInfo1_oKAMA_FP_EPSChassis1_0303_200fdde8_Tx: ComBitPosition=2, ComBitSize=3, ComSignalInitValue=0, ComSignalType=UINT8, ComTransferProperty=PENDING, ComHandleId=117, ComSystemTemplateSystemSignalRef=VCU_UnavailHVChgReason
        VCU_EnergyReturnedRegen_oVCU_HVbattStatus1_oKAMA_FP_EPSChassis1_0303_7b2a2c28_Tx: ComBitPosition=9, ComBitSize=10, ComSignalInitValue=0, ComSignalType=UINT16, ComTransferProperty=PENDING, ComHandleId=65, ComSystemTemplateSystemSignalRef=VCU_EnergyReturnedRegen
        IBS_VehiclespeedValid_oIBS_Status3_oKAMA_FP_EPSChassis1_0303_f440bf11_Rx: ComBitPosition=6, ComBitSize=1, ComSignalInitValue=0, ComSignalType=BOOLEAN, ComHandleId=342, ComSystemTemplateSystemSignalRef=IBS_VehiclespeedValid
        TCU_EVCompState_oTCU_Status_oKAMA_FP_EPT_0303_a8408b47_Rx: ComBitPosition=44, ComBitSize=2, ComSignalInitValue=0, ComSignalType=UINT8, ComHandleId=498, ComSystemTemplateSystemSignalRef=TCU_EVCompState
        MessageCounter_27F_oVCU_PwrtrainHVbattStatus2_oKAMA_FP_EPSChassis1_0303_417f5ce3_Tx: ComBitPosition=51, ComBitSize=4, ComSignalInitValue=0, ComSignalType=UINT8, ComTransferProperty=PENDING, ComHandleId=17, ComSystemTemplateSystemSignalRef=MessageCounter_27F
        BMS_ErrorDisChaCurrentOver_oBMS_ErrorInfo1_oKAMA_FP_EPT_0303_79378d5b_Rx: ComBitPosition=9, ComBitSize=2, ComSignalInitValue=0, ComSignalType=UINT8, ComHandleId=110, ComSystemTemplateSystemSignalRef=BMS_ErrorDisChaCurrentOver
        BMS_StateDI4_oBMS_DIRelayState_oKAMA_FP_EPT_0303_b8ba99ff_Rx: ComBitPosition=17, ComBitSize=2, ComSignalInitValue=0, ComSignalType=UINT8, ComHandleId=164, ComSystemTemplateSystemSignalRef=BMS_StateDI4
        Checksum_27B_oVCU_HMIsignals_oKAMA_FP_EPSChassis1_0303_432e646f_Tx: ComBitPosition=63, ComBitSize=8, ComSignalInitValue=0, ComSignalType=UINT8, ComTransferProperty=PENDING, ComHandleId=3, ComSystemTemplateSystemSignalRef=Checksum_27B
        BMS_FlowRate_oBMS_TCU_oKAMA_FP_EPT_0303_f631a605_Rx: ComBitPosition=39, ComBitSize=8, ComSignalInitValue=255, ComSignalType=UINT8, ComHandleId=126, ComSystemTemplateSystemSignalRef=BMS_FlowRate
        POD_DCFCVoltage_oPOD_VCU_Status_01_oKAMA_FP_EPT_0303_617cb974_Rx: ComBitPosition=12, ComBitSize=13, ComSignalInitValue=0, ComSignalType=UINT16, ComHandleId=479, ComSystemTemplateSystemSignalRef=POD_DCFCVoltage
        VCU_EnableOBC_oVCU_OBC_oKAMA_FP_EPT_0303_9539dbc0_Tx: ComBitPosition=5, ComBitSize=2, ComSignalInitValue=0, ComSignalType=UINT8, ComTransferProperty=PENDING, ComHandleId=62, ComSystemTemplateSystemSignalRef=VCU_EnableOBC
        BMS_RatCapacity_oBMS_BatInfor2_oKAMA_FP_EPT_0303_3d73ca16_Rx: ComBitPosition=23, ComBitSize=16, ComSignalInitValue=0, ComSignalType=UINT16, ComHandleId=153, ComSystemTemplateSystemSignalRef=BMS_RatCapacity
        Checksum_046_oVCU_MCU01_oKAMA_FP_EPT_0303_bbfb4183_Tx: ComBitPosition=63, ComBitSize=8, ComSignalInitValue=0, ComSignalType=UINT8, ComTransferProperty=PENDING, ComHandleId=6, ComSystemTemplateSystemSignalRef=Checksum_046
        MCU_FailCode1_oMCU_FailureCode_oKAMA_FP_EPT_0303_5dfb51a4_Rx: ComBitPosition=7, ComBitSize=3, ComSignalInitValue=0, ComSignalType=UINT8, ComHandleId=352, ComSystemTemplateSystemSignalRef=MCU_FailCode1
        BMS_BatProRights_oBMS_VersionInfor_oKAMA_FP_EPT_0303_4b15e936_Rx: ComBitPosition=51, ComBitSize=1, ComSignalInitValue=0, ComSignalType=BOOLEAN, ComHandleId=80, ComSystemTemplateSystemSignalRef=BMS_BatProRights
        Checksum_152_oVCU_chassis_oKAMA_FP_EPSChassis1_0303_aaea44e9_Tx: ComBitPosition=63, ComBitSize=8, ComSignalInitValue=0, ComSignalType=UINT8, ComTransferProperty=PENDING, ComHandleId=9, ComSystemTemplateSystemSignalRef=Checksum_152
        MCU_Isq_oMCU_Status_oKAMA_FP_EPT_0303_eb32f0f6_Rx: ComBitPosition=31, ComBitSize=12, ComSignalInitValue=2047, ComSignalType=UINT16, ComHandleId=366, ComSystemTemplateSystemSignalRef=MCU_Isq
        DCDC_InputVoltLowFault_oDCDC_VCU_02_oKAMA_FP_EPT_0303_9ef01f25_Rx: ComBitPosition=3, ComBitSize=1, ComSignalInitValue=0, ComSignalType=BOOLEAN, ComHandleId=209, ComSystemTemplateSystemSignalRef=DCDC_InputVoltLowFault
      VCU_Fault_01_oKAMA_FP_EPT_0303_43d9780b_Tx (ComIPdu):
        ComIPduDirection = SEND
        ComIPduType = NORMAL
        ComIPduHandleId = 4
        ComIPduSignalProcessing = DEFERRED
        ComIPduCancellationSupport = false
        ComIPduGroupRef = VCU_oKAMA_FP_EPT_0303_Tx_51b27697
        ComIPduSignalRef = PWT_ErrorLevel_oVCU_Fault_01_oKAMA_FP_EPT_0303_1b57c33e_Tx
        ComIPduSignalRef = VCU_CriSysFailure_oVCU_Fault_01_oKAMA_FP_EPT_0303_b5dca0b8_Tx
        ComIPduSignalRef = VCU_LimpHome_oVCU_Fault_01_oKAMA_FP_EPT_0303_68b92c58_Tx
        ComPduIdRef = VCU_Fault_01_oKAMA_FP_EPT_0303_43d9780b_Tx
        ComTxIPdu: ComMinimumDelayTime=0, ComTxIPduUnusedAreasDefault=0
          ComTxModeTrue
            ComTxMode: ComTxModeMode=PERIODIC, ComTxModeTimeOffset=0, ComTxModeTimePeriod=0.01
          ComTxModeFalse
            ComTxMode: ComTxModeMode=PERIODIC, ComTxModeTimeOffset=0, ComTxModeTimePeriod=0.01
      IBS_Torque_oKAMA_FP_EPSChassis1_0303_98aca4f8_Rx (ComIPdu):
        ComIPduDirection = RECEIVE
        ComIPduType = NORMAL
        ComIPduHandleId = 39
        ComIPduSignalProcessing = DEFERRED
        ComIPduCancellationSupport = false
        ComIPduGroupRef = VCU_oKAMA_FP_EPSChassis1_0303_Rx_00807295
        ComIPduSignalRef = Checksum_5E_oIBS_Torque_oKAMA_FP_EPSChassis1_0303_8de37c45_Rx
        ComIPduSignalRef = IBS_RBSSTATUS_oIBS_Torque_oKAMA_FP_EPSChassis1_0303_1ebb9465_Rx
        ComIPduSignalRef = IBS_TorqueIncreaseRequest_oIBS_Torque_oKAMA_FP_EPSChassis1_0303_f97bc0bb_Rx
        ComIPduSignalRef = IBS_TorqueIncreaseStatus_oIBS_Torque_oKAMA_FP_EPSChassis1_0303_e3a146fa_Rx
        ComIPduSignalRef = IBS_TorqueRBSReqValid_oIBS_Torque_oKAMA_FP_EPSChassis1_0303_6c3cd008_Rx
        ComIPduSignalRef = IBS_TorqueRBSReq_oIBS_Torque_oKAMA_FP_EPSChassis1_0303_a4d38ebf_Rx
        ComIPduSignalRef = IBS_TorqueReductionRequestValid_oIBS_Torque_oKAMA_FP_EPSChassis1_0303_55560d50_Rx
        ComIPduSignalRef = IBS_TorqueReductionRequest_oIBS_Torque_oKAMA_FP_EPSChassis1_0303_9e6a500f_Rx
        ComIPduSignalRef = MessageCounter_5E_oIBS_Torque_oKAMA_FP_EPSChassis1_0303_f4127afb_Rx
        ComPduIdRef = IBS_Torque_oKAMA_FP_EPSChassis1_0303_98aca4f8_Rx
      OBC_ACPortTempASensValid_oOBC_Error_STATUS_oKAMA_FP_EPT_0303_c1c6e070_Rx (ComSignal):
        ComBitPosition = 7
        ComBitSize = 2
        ComSignalEndianness = BIG_ENDIAN
        ComSignalInitValue = 0
        ComSignalType = UINT8
        ComTimeout = 0
        ComSignalAccess = ACCESS_UNCLEAR
        ComHandleId = 427
        ComSystemTemplateSystemSignalRef = OBC_ACPortTempASensValid
      APTC_TCU_oKAMA_FP_EPT_0303_356cfb4a_Rx (ComIPdu):
        ComIPduDirection = RECEIVE
        ComIPduType = NORMAL
        ComIPduHandleId = 4
        ComIPduSignalProcessing = DEFERRED
        ComIPduCancellationSupport = false
        ComIPduGroupRef = VCU_oKAMA_FP_EPT_0303_Rx_07e8d111
        ComIPduSignalRef = APTC_Core1TempSensorFaltStatus_oAPTC_TCU_oKAMA_FP_EPT_0303_0ff89cce_Rx
        ComIPduSignalRef = APTC_Core2TempSensorFaltStatus_oAPTC_TCU_oKAMA_FP_EPT_0303_4561ebba_Rx
        ComIPduSignalRef = APTC_DriveFaltStatus_oAPTC_TCU_oKAMA_FP_EPT_0303_1739c731_Rx
        ComIPduSignalRef = APTC_HVBusVoltage_oAPTC_TCU_oKAMA_FP_EPT_0303_e132457a_Rx
        ComIPduSignalRef = APTC_HVPowerUpReq_oAPTC_TCU_oKAMA_FP_EPT_0303_36343390_Rx
        ComIPduSignalRef = APTC_HeatingFaltStatus_oAPTC_TCU_oKAMA_FP_EPT_0303_88ff119c_Rx
        ComIPduSignalRef = APTC_IGBTFaltStatus_oAPTC_TCU_oKAMA_FP_EPT_0303_f2b8632d_Rx
        ComIPduSignalRef = APTC_LeftCoreTemp_oAPTC_TCU_oKAMA_FP_EPT_0303_35b239ff_Rx
        ComIPduSignalRef = APTC_LostCommuFaltStatus_oAPTC_TCU_oKAMA_FP_EPT_0303_d69f2899_Rx
        ComIPduSignalRef = APTC_PowerConsumption_oAPTC_TCU_oKAMA_FP_EPT_0303_55aa242f_Rx
        ComIPduSignalRef = APTC_RightCoreTemp_oAPTC_TCU_oKAMA_FP_EPT_0303_a6faa87a_Rx
        ComPduIdRef = APTC_TCU_oKAMA_FP_EPT_0303_356cfb4a_Rx
      EGSM_ShifterLevelFailSts_oDonorCar_GSM_oKAMA_FP_EPSChassis1_0303_2c60d3b8_Rx (ComSignal):
        ComBitPosition = 4
        ComBitSize = 3
        ComSignalEndianness = BIG_ENDIAN
        ComSignalInitValue = 0
        ComSignalType = UINT8
        ComTimeout = 0
        ComSignalAccess = ACCESS_UNCLEAR
        ComHandleId = 252
        ComSystemTemplateSystemSignalRef = EGSM_ShifterLevelFailSts
      ADAS_CCU1_Ctrl_oKAMA_FP_EPSChassis1_0303_f573a88f_Rx (ComIPdu):
        ComIPduDirection = RECEIVE
        ComIPduType = NORMAL
        ComIPduHandleId = 3
        ComIPduSignalProcessing = DEFERRED
        ComIPduCancellationSupport = false
        ComIPduGroupRef = VCU_oKAMA_FP_EPSChassis1_0303_Rx_00807295
        ComIPduSignalRef = ADAS_ReqValid_oADAS_CCU1_Ctrl_oKAMA_FP_EPSChassis1_0303_8cb910c6_Rx
        ComIPduSignalRef = ADAS_State_oADAS_CCU1_Ctrl_oKAMA_FP_EPSChassis1_0303_1cc17bb6_Rx
        ComIPduSignalRef = ADAS_SteerSpeedReq_oADAS_CCU1_Ctrl_oKAMA_FP_EPSChassis1_0303_f9180253_Rx
        ComIPduSignalRef = ADAS_SteeringAngleReq_oADAS_CCU1_Ctrl_oKAMA_FP_EPSChassis1_0303_843b362b_Rx
        ComIPduSignalRef = ADAS_SteeringWheel_Vibration_oADAS_CCU1_Ctrl_oKAMA_FP_EPSChassis1_0303_fe57db2a_Rx
        ComIPduSignalRef = ADAS_WorkModeReq_oADAS_CCU1_Ctrl_oKAMA_FP_EPSChassis1_0303_2245bd6a_Rx
        ComIPduSignalRef = Checksum_101_oADAS_CCU1_Ctrl_oKAMA_FP_EPSChassis1_0303_deec224a_Rx
        ComIPduSignalRef = MessageCounter_101_oADAS_CCU1_Ctrl_oKAMA_FP_EPSChassis1_0303_1e8b10bb_Rx
        ComPduIdRef = ADAS_CCU1_Ctrl_oKAMA_FP_EPSChassis1_0303_f573a88f_Rx
      3 x ComSignal, all with ComSignalInitValue=0, ComTimeout=0, ComSignalAccess=ACCESS_UNCLEAR:
        VCU_onepedalstatusActive_oVCU_AccPedal_oKAMA_FP_EPSChassis1_0303_5ec19509_Tx: ComBitPosition=45, ComBitSize=1, ComSignalEndianness=BIG_ENDIAN, ComSignalType=BOOLEAN, ComTransferProperty=PENDING, ComHandleId=131, ComSystemTemplateSystemSignalRef=VCU_onepedalstatusActive
        POD_DCNegRelayState_oPOD_VCU_Status_02_oKAMA_FP_EPT_0303_ee2b9564_Rx: ComBitPosition=9, ComBitSize=2, ComSignalEndianness=BIG_ENDIAN, ComSignalType=UINT8, ComHandleId=482, ComSystemTemplateSystemSignalRef=POD_DCNegRelayState
        Uds_EPT_bootResponse_Byte6_oUds_EPT_Boot_Response_oKAMA_FP_EPT_0303_685bc390_Tx: ComBitPosition=48, ComBitSize=8, ComSignalEndianness=LITTLE_ENDIAN, ComSignalType=UINT8, ComTransferProperty=TRIGGERED_WITHOUT_REPETITION, ComHandleId=31, ComSystemTemplateSystemSignalRef=Uds_EPT_bootResponse_Byte6
      IBS_Status3_oKAMA_FP_EPSChassis1_0303_66e23593_Rx (ComIPdu):
        ComIPduDirection = RECEIVE
        ComIPduType = NORMAL
        ComIPduHandleId = 38
        ComIPduSignalProcessing = DEFERRED
        ComIPduCancellationSupport = false
        ComIPduGroupRef = VCU_oKAMA_FP_EPSChassis1_0303_Rx_00807295
        ComIPduSignalRef = Checksum_5D_oIBS_Status3_oKAMA_FP_EPSChassis1_0303_7c63273d_Rx
        ComIPduSignalRef = IBS_ABSACTIVEABS_oIBS_Status3_oKAMA_FP_EPSChassis1_0303_d92cee2f_Rx
        ComIPduSignalRef = IBS_ABSFault_oIBS_Status3_oKAMA_FP_EPSChassis1_0303_dc759a55_Rx
        ComIPduSignalRef = IBS_EBDActive_oIBS_Status3_oKAMA_FP_EPSChassis1_0303_ed1a3441_Rx
        ComIPduSignalRef = IBS_EBDFault_oIBS_Status3_oKAMA_FP_EPSChassis1_0303_472cc7a8_Rx
        ComIPduSignalRef = IBS_ESPEnableSts_oIBS_Status3_oKAMA_FP_EPSChassis1_0303_0b5f88eb_Rx
        ComIPduSignalRef = IBS_ESPInfoLamp_oIBS_Status3_oKAMA_FP_EPSChassis1_0303_92916012_Rx
        ComIPduSignalRef = IBS_TCSFault_oIBS_Status3_oKAMA_FP_EPSChassis1_0303_95758863_Rx
        ComIPduSignalRef = IBS_VDCFault_oIBS_Status3_oKAMA_FP_EPSChassis1_0303_da46f95f_Rx
        ComIPduSignalRef = IBS_VehicleSpeed_oIBS_Status3_oKAMA_FP_EPSChassis1_0303_af4591ed_Rx
        ComIPduSignalRef = IBS_VehiclespeedValid_oIBS_Status3_oKAMA_FP_EPSChassis1_0303_f440bf11_Rx
        ComIPduSignalRef = MessageCounter_5D_oIBS_Status3_oKAMA_FP_EPSChassis1_0303_50c348b0_Rx
        ComPduIdRef = IBS_Status3_oKAMA_FP_EPSChassis1_0303_66e23593_Rx
      15 x ComSignal, all with ComSignalEndianness=BIG_ENDIAN, ComTimeout=0, ComSignalAccess=ACCESS_UNCLEAR:
        EVCOM_CompDeratingOprtStatus_oEVCOM_State_oKAMA_FP_EPT_0303_fd129c66_Rx: ComBitPosition=55, ComBitSize=1, ComSignalInitValue=0, ComSignalType=BOOLEAN, ComHandleId=267, ComSystemTemplateSystemSignalRef=EVCOM_CompDeratingOprtStatus
        POD_DCFCCurrent_oPOD_VCU_Status_01_oKAMA_FP_EPT_0303_9507f5ee_Rx: ComBitPosition=7, ComBitSize=11, ComSignalInitValue=0, ComSignalType=UINT16, ComHandleId=478, ComSystemTemplateSystemSignalRef=POD_DCFCCurrent
        IBS_FRWheelSpeed_oIBS_WheelSpeed_oKAMA_FP_EPSChassis1_0303_2e18f492_Rx: ComBitPosition=4, ComBitSize=13, ComSignalInitValue=0, ComSignalType=UINT16, ComHandleId=310, ComSystemTemplateSystemSignalRef=IBS_FRWheelSpeed
        BMS_AbortFaultBMSTemp_oBMS_ChargeStop_oKAMA_FP_EPT_0303_57447d3c_Rx: ComBitPosition=15, ComBitSize=2, ComSignalInitValue=0, ComSignalType=UINT8, ComHandleId=60, ComSystemTemplateSystemSignalRef=BMS_AbortFaultBMSTemp
        BMS_BatCodeFrameLength_oBMS_Batcode_oKAMA_FP_EPT_0303_18e1f1a2_Rx: ComBitPosition=15, ComBitSize=8, ComSignalInitValue=0, ComSignalType=UINT8, ComHandleId=75, ComSystemTemplateSystemSignalRef=BMS_BatCodeFrameLength
        BMS_BatStatus_oBMS_status_oKAMA_FP_EPT_0303_3284b8ff_Rx: ComBitPosition=3, ComBitSize=4, ComSignalInitValue=0, ComSignalType=UINT8, ComHandleId=81, ComSystemTemplateSystemSignalRef=BMS_BatStatus
        VCU_BrakepedalStatus_oVCU_MCU01_oKAMA_FP_EPT_0303_a6222693_Tx: ComBitPosition=11, ComBitSize=1, ComSignalInitValue=0, ComSignalType=BOOLEAN, ComTransferProperty=PENDING, ComHandleId=47, ComSystemTemplateSystemSignalRef=VCU_BrakepedalStatus
        OBC_ACPortTempB_oOBC_VCU_STATUS2_oKAMA_FP_EPT_0303_9fe0fc1b_Rx: ComBitPosition=39, ComBitSize=8, ComSignalInitValue=255, ComSignalType=UINT8, ComHandleId=431, ComSystemTemplateSystemSignalRef=OBC_ACPortTempB
        MessageCounter_0A1_oVCU_BMS_oKAMA_FP_EPT_0303_9662047a_Tx: ComBitPosition=51, ComBitSize=4, ComSignalInitValue=0, ComSignalType=UINT8, ComTransferProperty=PENDING, ComHandleId=12, ComSystemTemplateSystemSignalRef=MessageCounter_0A1
        TCU_TMSTotoalPwrReq_oTCU_Status_oKAMA_FP_EPT_0303_ea3f14b8_Rx: ComBitPosition=31, ComBitSize=8, ComSignalInitValue=0, ComSignalType=UINT8, ComHandleId=507, ComSystemTemplateSystemSignalRef=TCU_TMSTotoalPwrReq
        MCU_TempCurrStr1_oMCU_Temperature2_oKAMA_FP_EPT_0303_04a68532_Rx: ComBitPosition=15, ComBitSize=8, ComSignalInitValue=255, ComSignalType=UINT8, ComHandleId=371, ComSystemTemplateSystemSignalRef=MCU_TempCurrStr1
        OBC_InputPhaseStatus_oOBC_Error_STATUS_oKAMA_FP_EPT_0303_76c7d8d9_Rx: ComBitPosition=22, ComBitSize=1, ComSignalInitValue=0, ComSignalType=BOOLEAN, ComHandleId=459, ComSystemTemplateSystemSignalRef=OBC_InputPhaseStatus
        BMS_TempInlet_oBMS_TCU_oKAMA_FP_EPT_0303_07b2a4fc_Rx: ComBitPosition=23, ComBitSize=8, ComSignalInitValue=255, ComSignalType=UINT8, ComHandleId=178, ComSystemTemplateSystemSignalRef=BMS_TempInlet
        IBS_FLWheelSpeed_oIBS_WheelSpeed_oKAMA_FP_EPSChassis1_0303_33d2c0cb_Rx: ComBitPosition=20, ComBitSize=13, ComSignalInitValue=0, ComSignalType=UINT16, ComHandleId=306, ComSystemTemplateSystemSignalRef=IBS_FLWheelSpeed
        BMS_ErrorIsolationSingleLow_oBMS_ErrorInfo1_oKAMA_FP_EPT_0303_0101487b_Rx: ComBitPosition=39, ComBitSize=2, ComSignalInitValue=0, ComSignalType=UINT8, ComHandleId=115, ComSystemTemplateSystemSignalRef=BMS_ErrorIsolationSingleLow
      BMS_Insulation_oKAMA_FP_EPT_0303_6e3c9b8a_Rx (ComIPdu):
        ComIPduDirection = RECEIVE
        ComIPduType = NORMAL
        ComIPduHandleId = 16
        ComIPduSignalProcessing = DEFERRED
        ComIPduCancellationSupport = false
        ComIPduGroupRef = VCU_oKAMA_FP_EPT_0303_Rx_07e8d111
        ComIPduSignalRef = BMS_InsulationDetectionStatus_oBMS_Insulation_oKAMA_FP_EPT_0303_583ee5db_Rx
        ComIPduSignalRef = BMS_SysRegInsulationValue_oBMS_Insulation_oKAMA_FP_EPT_0303_00598d60_Rx
        ComPduIdRef = BMS_Insulation_oKAMA_FP_EPT_0303_6e3c9b8a_Rx
      10 x ComSignal, all with ComTimeout=0, ComSignalAccess=ACCESS_UNCLEAR:
        OBC_CCCurrentLimit_oOBC_VCU_CHRGSTATION_ST_oKAMA_FP_EPT_0303_fbd61b32_Rx: ComBitPosition=23, ComBitSize=8, ComSignalEndianness=BIG_ENDIAN, ComSignalInitValue=0, ComSignalType=UINT8, ComHandleId=435, ComSystemTemplateSystemSignalRef=OBC_CCCurrentLimit
        VCU_SystemReady_oVCU_AccPedal_oKAMA_FP_EPSChassis1_0303_b046fea1_Tx: ComBitPosition=24, ComBitSize=1, ComSignalEndianness=BIG_ENDIAN, ComSignalInitValue=0, ComSignalType=BOOLEAN, ComTransferProperty=PENDING, ComHandleId=107, ComSystemTemplateSystemSignalRef=VCU_SystemReady
        MCU_IGBTTempRiseW_oMCU_Temperature1_oKAMA_FP_EPT_0303_bdf907a1_Rx: ComBitPosition=55, ComBitSize=8, ComSignalEndianness=BIG_ENDIAN, ComSignalInitValue=255, ComSignalType=UINT8, ComHandleId=360, ComSystemTemplateSystemSignalRef=MCU_IGBTTempRiseW
        MessageCounter_1A1_oADAS_ACC_oKAMA_FP_EPSChassis1_0303_6a58d890_Rx: ComBitPosition=51, ComBitSize=4, ComSignalEndianness=BIG_ENDIAN, ComSignalInitValue=0, ComSignalType=UINT8, ComHandleId=405, ComSystemTemplateSystemSignalRef=MessageCounter_1A1
        MessageCounter_5C_oIBS1_acceleration_oKAMA_FP_EPSChassis1_0303_8ed323bd_Rx: ComBitPosition=51, ComBitSize=4, ComSignalEndianness=BIG_ENDIAN, ComSignalInitValue=0, ComSignalType=UINT8, ComHandleId=412, ComSystemTemplateSystemSignalRef=MessageCounter_5C
        VCU_MaxTorqueGradient_oVCU_MCU02_oKAMA_FP_EPT_0303_429d7ce1_Tx: ComBitPosition=12, ComBitSize=14, ComSignalEndianness=BIG_ENDIAN, ComSignalInitValue=0, ComSignalType=UINT16, ComTransferProperty=PENDING, ComHandleId=88, ComSystemTemplateSystemSignalRef=VCU_MaxTorqueGradient
        ACC_DeceToStop_Request_oADAS_ACC_oKAMA_FP_EPSChassis1_0303_458df742_Rx: ComBitPosition=0, ComBitSize=1, ComSignalEndianness=BIG_ENDIAN, ComSignalInitValue=0, ComSignalType=BOOLEAN, ComHandleId=2, ComSystemTemplateSystemSignalRef=ACC_DeceToStop_Request
        OBC_DCCurHighFault_oOBC_Error_STATUS_oKAMA_FP_EPT_0303_d1d1fc26_Rx: ComBitPosition=13, ComBitSize=1, ComSignalEndianness=BIG_ENDIAN, ComSignalInitValue=0, ComSignalType=BOOLEAN, ComHandleId=447, ComSystemTemplateSystemSignalRef=OBC_DCCurHighFault
        TCU_HVACACState_oTCU_Status_oKAMA_FP_EPT_0303_509ba018_Rx: ComBitPosition=34, ComBitSize=2, ComSignalEndianness=BIG_ENDIAN, ComSignalInitValue=0, ComSignalType=UINT8, ComHandleId=499, ComSystemTemplateSystemSignalRef=TCU_HVACACState
        MessageCounter_340_oYRS_7_oKAMA_FP_EPSChassis1_0303_c1e387d0_Rx: ComBitPosition=48, ComBitSize=4, ComSignalEndianness=LITTLE_ENDIAN, ComSignalInitValue=0, ComSignalType=UINT8, ComHandleId=423, ComSystemTemplateSystemSignalRef=MessageCounter_340
      ADAS_ACC_oKAMA_FP_EPSChassis1_0303_a710a036_Rx (ComIPdu):
        ComIPduDirection = RECEIVE
        ComIPduType = NORMAL
        ComIPduHandleId = 0
        ComIPduSignalProcessing = DEFERRED
        ComIPduCancellationSupport = false
        ComIPduGroupRef = VCU_oKAMA_FP_EPSChassis1_0303_Rx_00807295
        ComIPduSignalRef = ACC_ComfortLowBand_oADAS_ACC_oKAMA_FP_EPSChassis1_0303_177d56f3_Rx
        ComIPduSignalRef = ACC_ComfortUpBand_oADAS_ACC_oKAMA_FP_EPSChassis1_0303_aaa37ee6_Rx
        ComIPduSignalRef = ACC_DeceToStop_Request_oADAS_ACC_oKAMA_FP_EPSChassis1_0303_458df742_Rx
        ComIPduSignalRef = ACC_Driveoff_Request_oADAS_ACC_oKAMA_FP_EPSChassis1_0303_720c9928_Rx
        ComIPduSignalRef = ACC_MaxJerkA_oADAS_ACC_oKAMA_FP_EPSChassis1_0303_25044b1d_Rx
        ComIPduSignalRef = ACC_MinJerkA_oADAS_ACC_oKAMA_FP_EPSChassis1_0303_1349898e_Rx
        ComIPduSignalRef = ACC_Mode_oADAS_ACC_oKAMA_FP_EPSChassis1_0303_0a5e9b31_Rx
        ComIPduSignalRef = ACC_ParkShiftReq_oADAS_ACC_oKAMA_FP_EPSChassis1_0303_b4a43305_Rx
        ComIPduSignalRef = ACC_TargetAcceleration_oADAS_ACC_oKAMA_FP_EPSChassis1_0303_3c74e9c8_Rx
        ComIPduSignalRef = Checksum_1A1_oADAS_ACC_oKAMA_FP_EPSChassis1_0303_47e6c299_Rx
        ComIPduSignalRef = MessageCounter_1A1_oADAS_ACC_oKAMA_FP_EPSChassis1_0303_6a58d890_Rx
        ComPduIdRef = ADAS_ACC_oKAMA_FP_EPSChassis1_0303_a710a036_Rx
      5 x ComSignal, all with ComSignalInitValue=0, ComTimeout=0, ComSignalAccess=ACCESS_UNCLEAR:
        OBC_ACPortTempBerror_oOBC_Error_STATUS_oKAMA_FP_EPT_0303_93824d32_Rx: ComBitPosition=24, ComBitSize=1, ComSignalEndianness=BIG_ENDIAN, ComSignalType=BOOLEAN, ComHandleId=432, ComSystemTemplateSystemSignalRef=OBC_ACPortTempBerror
        BMS_BatSupName_oBMS_BatInfor2_oKAMA_FP_EPT_0303_db5464c5_Rx: ComBitPosition=3, ComBitSize=4, ComSignalEndianness=BIG_ENDIAN, ComSignalType=UINT8, ComHandleId=82, ComSystemTemplateSystemSignalRef=BMS_BatSupName
        Uds_EPT_bootResponse_Byte0_oUds_EPT_Boot_Response_oKAMA_FP_EPT_0303_182cd576_Tx: ComBitPosition=0, ComBitSize=8, ComSignalEndianness=LITTLE_ENDIAN, ComSignalType=UINT8, ComTransferProperty=TRIGGERED_WITHOUT_REPETITION, ComHandleId=25, ComSystemTemplateSystemSignalRef=Uds_EPT_bootResponse_Byte0
        EVCOM_CompActlCnsmpCurValid_oEVCOM_State_oKAMA_FP_EPT_0303_adf77ccd_Rx: ComBitPosition=22, ComBitSize=1, ComSignalEndianness=BIG_ENDIAN, ComSignalType=BOOLEAN, ComHandleId=261, ComSystemTemplateSystemSignalRef=EVCOM_CompActlCnsmpCurValid
        MessageCounter_1A2_oADAS_AEB_oKAMA_FP_EPSChassis1_0303_5b09f2ff_Rx: ComBitPosition=51, ComBitSize=4, ComSignalEndianness=BIG_ENDIAN, ComSignalType=UINT8, ComHandleId=406, ComSystemTemplateSystemSignalRef=MessageCounter_1A2
      MCU_DeratingStatus_oKAMA_FP_EPT_0303_9e0fe5b3_Rx (ComIPdu):
        ComIPduDirection = RECEIVE
        ComIPduType = NORMAL
        ComIPduHandleId = 43
        ComIPduSignalProcessing = DEFERRED
        ComIPduCancellationSupport = false
        ComIPduGroupRef = VCU_oKAMA_FP_EPT_0303_Rx_07e8d111
        ComIPduSignalRef = MCU_TrqAbsMax_oMCU_DeratingStatus_oKAMA_FP_EPT_0303_c307bb83_Rx
        ComIPduSignalRef = MCU_TrqAbsMin_oMCU_DeratingStatus_oKAMA_FP_EPT_0303_f685aadd_Rx
        ComIPduSignalRef = MCU_UT15Curr_oMCU_DeratingStatus_oKAMA_FP_EPT_0303_ff91b861_Rx
        ComIPduSignalRef = MCU_bDernN_oMCU_DeratingStatus_oKAMA_FP_EPT_0303_cda63925_Rx
        ComIPduSignalRef = MCU_bDernOvrIdc_oMCU_DeratingStatus_oKAMA_FP_EPT_0303_e4315287_Rx
        ComIPduSignalRef = MCU_bDernOvrUdc_oMCU_DeratingStatus_oKAMA_FP_EPT_0303_8504b895_Rx
        ComIPduSignalRef = MCU_bDernStrTemp_oMCU_DeratingStatus_oKAMA_FP_EPT_0303_c104cc08_Rx
        ComIPduSignalRef = MCU_bDernTempCool_oMCU_DeratingStatus_oKAMA_FP_EPT_0303_bc6d3c4a_Rx
        ComIPduSignalRef = MCU_bDernTempIGBT_oMCU_DeratingStatus_oKAMA_FP_EPT_0303_ce671c37_Rx
        ComIPduSignalRef = MCU_bDernTrqMax_oMCU_DeratingStatus_oKAMA_FP_EPT_0303_b0e37eb5_Rx
        ComIPduSignalRef = MCU_bDernTrqMin_oMCU_DeratingStatus_oKAMA_FP_EPT_0303_85616feb_Rx
        ComIPduSignalRef = MCU_bDernUndrIdc_oMCU_DeratingStatus_oKAMA_FP_EPT_0303_a1c5846c_Rx
        ComIPduSignalRef = MCU_bDernUndrUdc_oMCU_DeratingStatus_oKAMA_FP_EPT_0303_c0f06e7e_Rx
        ComIPduSignalRef = MCU_bReadyHv_oMCU_DeratingStatus_oKAMA_FP_EPT_0303_1d3c6b43_Rx
        ComIPduSignalRef = MCU_stDischg_oMCU_DeratingStatus_oKAMA_FP_EPT_0303_34fcacdf_Rx
        ComPduIdRef = MCU_DeratingStatus_oKAMA_FP_EPT_0303_9e0fe5b3_Rx
      MessageCounter_375_oDCDC_VCU_01_oKAMA_FP_EPT_0303_ef087066_Rx (ComSignal):
        ComBitPosition = 51
        ComBitSize = 4
        ComSignalEndianness = BIG_ENDIAN
        ComSignalInitValue = 0
        ComSignalType = UINT8
        ComTimeout = 0
        ComSignalAccess = ACCESS_UNCLEAR
        ComHandleId = 424
        ComSystemTemplateSystemSignalRef = MessageCounter_375
      EVCOM_State_oKAMA_FP_EPT_0303_b23a01c5_Rx (ComIPdu):
        ComIPduDirection = RECEIVE
        ComIPduType = NORMAL
        ComIPduHandleId = 32
        ComIPduSignalProcessing = DEFERRED
        ComIPduCancellationSupport = false
        ComIPduGroupRef = VCU_oKAMA_FP_EPT_0303_Rx_07e8d111
        ComIPduSignalRef = EVCOM_ActlOprtMode_oEVCOM_State_oKAMA_FP_EPT_0303_99e07245_Rx
        ComIPduSignalRef = EVCOM_CommunicationError_oEVCOM_State_oKAMA_FP_EPT_0303_549edb5d_Rx
        ComIPduSignalRef = EVCOM_CompActlCnsmpCurValid_oEVCOM_State_oKAMA_FP_EPT_0303_adf77ccd_Rx
        ComIPduSignalRef = EVCOM_CompActlCnsmpCur_oEVCOM_State_oKAMA_FP_EPT_0303_9620a508_Rx
        ComIPduSignalRef = EVCOM_CompActlPwrCnsmpValid_oEVCOM_State_oKAMA_FP_EPT_0303_d7acbb26_Rx
        ComIPduSignalRef = EVCOM_CompActlPwrCnsmp_oEVCOM_State_oKAMA_FP_EPT_0303_736c4b6e_Rx
        ComIPduSignalRef = EVCOM_CompActlSpdValid_oEVCOM_State_oKAMA_FP_EPT_0303_777fbcfb_Rx
        ComIPduSignalRef = EVCOM_CompActlSpd_oEVCOM_State_oKAMA_FP_EPT_0303_255dac2c_Rx
        ComIPduSignalRef = EVCOM_CompDeratingOprtStatus_oEVCOM_State_oKAMA_FP_EPT_0303_fd129c66_Rx
        ComIPduSignalRef = EVCOM_CompDeviceInternTempError_oEVCOM_State_oKAMA_FP_EPT_0303_c90eb0b4_Rx
        ComIPduSignalRef = EVCOM_FailStatus_oEVCOM_State_oKAMA_FP_EPT_0303_7d468baf_Rx
        ComIPduSignalRef = EVCOM_OverCurDropFreqError_oEVCOM_State_oKAMA_FP_EPT_0303_a0df61a8_Rx
        ComIPduSignalRef = EVCOM_OverCurrentError_oEVCOM_State_oKAMA_FP_EPT_0303_40ef81df_Rx
        ComIPduSignalRef = EVCOM_OverPwrDropFreqError_oEVCOM_State_oKAMA_FP_EPT_0303_c5e2e234_Rx
        ComIPduSignalRef = EVCOM_OverVoltageError_oEVCOM_State_oKAMA_FP_EPT_0303_ef164ac9_Rx
        ComIPduSignalRef = EVCOM_StandByOverVolError_oEVCOM_State_oKAMA_FP_EPT_0303_a407716c_Rx
        ComIPduSignalRef = EVCOM_StandByUnderVolError_oEVCOM_State_oKAMA_FP_EPT_0303_7587ae67_Rx
        ComIPduSignalRef = EVCOM_UnderVoltageError_oEVCOM_State_oKAMA_FP_EPT_0303_07486fd6_Rx
        ComPduIdRef = EVCOM_State_oKAMA_FP_EPT_0303_b23a01c5_Rx
      11 x ComSignal, all with ComSignalEndianness=BIG_ENDIAN, ComTimeout=0, ComSignalAccess=ACCESS_UNCLEAR:
        MessageCounter_151_oVCU_AccPedal_oKAMA_FP_EPSChassis1_0303_ab84cc60_Tx: ComBitPosition=51, ComBitSize=4, ComSignalInitValue=0, ComSignalType=UINT8, ComTransferProperty=PENDING, ComHandleId=20, ComSystemTemplateSystemSignalRef=MessageCounter_151
        BMS_BatCode5_oBMS_Batcode_oKAMA_FP_EPT_0303_8d9a4e14_Rx: ComBitPosition=55, ComBitSize=8, ComSignalInitValue=0, ComSignalType=UINT8, ComHandleId=73, ComSystemTemplateSystemSignalRef=BMS_BatCode5
        BMS_DCChgMode_oBMS_ChargeStop_oKAMA_FP_EPT_0303_3d963533_Rx: ComBitPosition=3, ComBitSize=2, ComSignalInitValue=0, ComSignalType=UINT8, ComHandleId=92, ComSystemTemplateSystemSignalRef=BMS_DCChgMode
        BMS_ErrorCellTempOffline_oBMS_ErrorInfo1_oKAMA_FP_EPT_0303_96e84a72_Rx: ComBitPosition=27, ComBitSize=1, ComSignalInitValue=0, ComSignalType=BOOLEAN, ComHandleId=105, ComSystemTemplateSystemSignalRef=BMS_ErrorCellTempOffline
        VCU_HVBatCurrent_VCU_oVCU_PwrtrainHVbattStatus2_oKAMA_FP_EPSChassis1_0303_b43a3dd3_Tx: ComBitPosition=15, ComBitSize=14, ComSignalInitValue=8190, ComSignalType=UINT16, ComTransferProperty=PENDING, ComHandleId=69, ComSystemTemplateSystemSignalRef=VCU_HVBatCurrent_VCU
        DCDC_StopFault_oDCDC_VCU_02_oKAMA_FP_EPT_0303_807b748b_Rx: ComBitPosition=11, ComBitSize=1, ComSignalInitValue=0, ComSignalType=BOOLEAN, ComHandleId=224, ComSystemTemplateSystemSignalRef=DCDC_StopFault
        BMS_MinCellTemp_oBMS_Temp_oKAMA_FP_EPT_0303_787f543b_Rx: ComBitPosition=31, ComBitSize=8, ComSignalInitValue=255, ComSignalType=UINT8, ComHandleId=142, ComSystemTemplateSystemSignalRef=BMS_MinCellTemp
        IBS_MasterCylinderPressure_oIBS_Status1_oKAMA_FP_EPSChassis1_0303_f5093d5f_Rx: ComBitPosition=3, ComBitSize=12, ComSignalInitValue=0, ComSignalType=UINT16, ComHandleId=316, ComSystemTemplateSystemSignalRef=IBS_MasterCylinderPressure
        BMS_PTCRelayStatus_oBMS_DIRelayState_oKAMA_FP_EPT_0303_3e30196d_Rx: ComBitPosition=5, ComBitSize=2, ComSignalInitValue=0, ComSignalType=UINT8, ComHandleId=147, ComSystemTemplateSystemSignalRef=BMS_PTCRelayStatus
        IBS_TCSFault_oIBS_Status3_oKAMA_FP_EPSChassis1_0303_95758863_Rx: ComBitPosition=5, ComBitSize=1, ComSignalInitValue=0, ComSignalType=BOOLEAN, ComHandleId=328, ComSystemTemplateSystemSignalRef=IBS_TCSFault
        MessageCounter_5F_oIBS_VCUVLC_oKAMA_FP_EPSChassis1_0303_05563a9a_Rx: ComBitPosition=51, ComBitSize=4, ComSignalInitValue=0, ComSignalType=UINT8, ComHandleId=415, ComSystemTemplateSystemSignalRef=MessageCounter_5F
      VCU_oKAMA_FP_EPT_0303_Tx_51b27697 (ComIPduGroup): ComIPduGroupHandleId=3
      8 x ComSignal, all with ComSignalEndianness=BIG_ENDIAN, ComTimeout=0, ComSignalAccess=ACCESS_UNCLEAR:
        ACC_Mode_oADAS_ACC_oKAMA_FP_EPSChassis1_0303_0a5e9b31_Rx: ComBitPosition=4, ComBitSize=3, ComSignalInitValue=0, ComSignalType=UINT8, ComHandleId=6, ComSystemTemplateSystemSignalRef=ACC_Mode
        MCU_bDmpCActv_oMCU_Status_oKAMA_FP_EPT_0303_fc5ef79c_Rx: ComBitPosition=35, ComBitSize=1, ComSignalInitValue=0, ComSignalType=BOOLEAN, ComHandleId=391, ComSystemTemplateSystemSignalRef=MCU_bDmpCActv
        TCU_CompTargetSpeed_oTCU_Cmd_oKAMA_FP_EPT_0303_c78c1b78_Rx: ComBitPosition=31, ComBitSize=13, ComSignalInitValue=0, ComSignalType=SINT16, ComHandleId=497, ComSystemTemplateSystemSignalRef=TCU_CompTargetSpeed
        ADAS_SteerSpeedReq_oADAS_CCU1_Ctrl_oKAMA_FP_EPSChassis1_0303_f9180253_Rx: ComBitPosition=47, ComBitSize=8, ComSignalInitValue=0, ComSignalType=UINT8, ComHandleId=20, ComSystemTemplateSystemSignalRef=ADAS_SteerSpeedReq
        Checksum_5_oBMS_TCU_oKAMA_FP_EPT_0303_f406a118_Rx: ComBitPosition=63, ComBitSize=8, ComSignalInitValue=0, ComSignalType=UINT8, ComHandleId=194, ComSystemTemplateSystemSignalRef=Checksum_5
        VCU_DegradedHVCharging_oVCU_PlugInChrgInfo1_oKAMA_FP_EPSChassis1_0303_56c601cc_Tx: ComBitPosition=16, ComBitSize=1, ComSignalInitValue=0, ComSignalType=BOOLEAN, ComTransferProperty=PENDING, ComHandleId=53, ComSystemTemplateSystemSignalRef=VCU_DegradedHVCharging
        MCU_Sensor_Fault_oMCU_FailureCode_oKAMA_FP_EPT_0303_81a23755_Rx: ComBitPosition=55, ComBitSize=8, ComSignalInitValue=0, ComSignalType=UINT8, ComHandleId=368, ComSystemTemplateSystemSignalRef=MCU_Sensor_Fault
        IBS_TorqueIncreaseRequest_oIBS_Torque_oKAMA_FP_EPSChassis1_0303_f97bc0bb_Rx: ComBitPosition=23, ComBitSize=15, ComSignalInitValue=5400, ComSignalType=UINT16, ComHandleId=329, ComSystemTemplateSystemSignalRef=IBS_TorqueIncreaseRequest
      MCU_SoftwareNumber_oKAMA_FP_EPT_0303_560144a5_Rx (ComIPdu):
        ComIPduDirection = RECEIVE
        ComIPduType = NORMAL
        ComIPduHandleId = 46
        ComIPduSignalProcessing = DEFERRED
        ComIPduCancellationSupport = false
        ComIPduGroupRef = VCU_oKAMA_FP_EPT_0303_Rx_07e8d111
        ComIPduSignalRef = MCU_CodeVer_oMCU_SoftwareNumber_oKAMA_FP_EPT_0303_efc3a3ec_Rx
        ComIPduSignalRef = MCU_CpldVer_oMCU_SoftwareNumber_oKAMA_FP_EPT_0303_880e7a85_Rx
        ComIPduSignalRef = MCU_DataVer_oMCU_SoftwareNumber_oKAMA_FP_EPT_0303_066f41da_Rx
        ComIPduSignalRef = MCU_HvMcuVer_oMCU_SoftwareNumber_oKAMA_FP_EPT_0303_43ec3028_Rx
        ComPduIdRef = MCU_SoftwareNumber_oKAMA_FP_EPT_0303_560144a5_Rx
      10 x ComSignal, all with ComSignalEndianness=BIG_ENDIAN, ComTimeout=0, ComSignalAccess=ACCESS_UNCLEAR:
        ACC_TargetAcceleration_oADAS_ACC_oKAMA_FP_EPSChassis1_0303_3c74e9c8_Rx: ComBitPosition=47, ComBitSize=8, ComSignalInitValue=140, ComSignalType=UINT8, ComHandleId=8, ComSystemTemplateSystemSignalRef=ACC_TargetAcceleration
        VCU_ActiveEnergyProfile_oVCU_PwrtrainRequests_oKAMA_FP_EPSChassis1_0303_0adc2a54_Tx: ComBitPosition=15, ComBitSize=3, ComSignalInitValue=0, ComSignalType=UINT8, ComTransferProperty=PENDING, ComHandleId=38, ComSystemTemplateSystemSignalRef=VCU_ActiveEnergyProfile
        DM3_Byte7_oREPS_DM3_oKAMA_FP_EPSChassis1_0303_306c4930_Rx: ComBitPosition=63, ComBitSize=8, ComSignalInitValue=0, ComSignalType=UINT8, ComHandleId=249, ComSystemTemplateSystemSignalRef=DM3_Byte7
        IBS_FRMovingDirection_oIBS_WheelSpeed_oKAMA_FP_EPSChassis1_0303_3e6eabf9_Rx: ComBitPosition=6, ComBitSize=2, ComSignalInitValue=0, ComSignalType=UINT8, ComHandleId=307, ComSystemTemplateSystemSignalRef=IBS_FRMovingDirection
        BMS_StateDI7_oBMS_DIRelayState_oKAMA_FP_EPT_0303_e2dba69f_Rx: ComBitPosition=27, ComBitSize=2, ComSignalInitValue=0, ComSignalType=UINT8, ComHandleId=167, ComSystemTemplateSystemSignalRef=BMS_StateDI7
        BMS_ErrorHighSoc_oBMS_ErrorInfo1_oKAMA_FP_EPT_0303_c722d2b8_Rx: ComBitPosition=35, ComBitSize=1, ComSignalInitValue=0, ComSignalType=BOOLEAN, ComHandleId=114, ComSystemTemplateSystemSignalRef=BMS_ErrorHighSoc
        VCU_HVBatOvrTemp_oVCU_HMIsignals_oKAMA_FP_EPSChassis1_0303_8e116b77_Tx: ComBitPosition=1, ComBitSize=1, ComSignalInitValue=0, ComSignalType=BOOLEAN, ComTransferProperty=PENDING, ComHandleId=71, ComSystemTemplateSystemSignalRef=VCU_HVBatOvrTemp
        OBC_FaultLevel_oOBC_Error_STATUS_oKAMA_FP_EPT_0303_bdd2e9f5_Rx: ComBitPosition=2, ComBitSize=2, ComSignalInitValue=0, ComSignalType=UINT8, ComHandleId=452, ComSystemTemplateSystemSignalRef=OBC_FaultLevel
        APA_GearShiftReq_oADAS_APA_oKAMA_FP_EPSChassis1_0303_072f4f7b_Rx: ComBitPosition=31, ComBitSize=3, ComSignalInitValue=0, ComSignalType=UINT8, ComHandleId=34, ComSystemTemplateSystemSignalRef=APA_GearShiftReq
        EVCOM_OverPwrDropFreqError_oEVCOM_State_oKAMA_FP_EPT_0303_c5e2e234_Rx: ComBitPosition=0, ComBitSize=1, ComSignalInitValue=0, ComSignalType=BOOLEAN, ComHandleId=272, ComSystemTemplateSystemSignalRef=EVCOM_OverPwrDropFreqError
      VCU_Mileage_oKAMA_FP_EPT_0303_701fd8da_Tx (ComIPdu):
        ComIPduDirection = SEND
        ComIPduType = NORMAL
        ComIPduHandleId = 10
        ComIPduSignalProcessing = DEFERRED
        ComIPduCancellationSupport = false
        ComIPduGroupRef = VCU_oKAMA_FP_EPT_0303_Tx_51b27697
        ComIPduSignalRef = VCU_AvaDrvRange_oVCU_Mileage_oKAMA_FP_EPT_0303_eb1e8818_Tx
        ComIPduSignalRef = VCU_DynamicMileage_oVCU_Mileage_oKAMA_FP_EPT_0303_3c741a1c_Tx
        ComIPduSignalRef = VCU_MCUPower_oVCU_Mileage_oKAMA_FP_EPT_0303_c1ddf1db_Tx
        ComPduIdRef = VCU_Mileage_oKAMA_FP_EPT_0303_701fd8da_Tx
        ComTxIPdu: ComMinimumDelayTime=0, ComTxIPduUnusedAreasDefault=0
          ComTxModeTrue
            ComTxMode: ComTxModeMode=PERIODIC, ComTxModeTimeOffset=0, ComTxModeTimePeriod=0.1
          ComTxModeFalse
            ComTxMode: ComTxModeMode=PERIODIC, ComTxModeTimeOffset=0, ComTxModeTimePeriod=0.1
      VCU_chassis_oKAMA_FP_EPSChassis1_0303_187d50df_Tx (ComIPdu):
        ComIPduDirection = SEND
        ComIPduType = NORMAL
        ComIPduHandleId = 19
        ComIPduSignalProcessing = DEFERRED
        ComIPduCancellationSupport = false
        ComIPduGroupRef = VCU_oKAMA_FP_EPSChassis1_0303_Tx_56dad513
        ComIPduSignalRef = Checksum_152_oVCU_chassis_oKAMA_FP_EPSChassis1_0303_aaea44e9_Tx
        ComIPduSignalRef = MessageCounter_152_oVCU_chassis_oKAMA_FP_EPSChassis1_0303_39cf1b1b_Tx
        ComIPduSignalRef = VCU_RegenTorqueActive_oVCU_chassis_oKAMA_FP_EPSChassis1_0303_818e9954_Tx
        ComIPduSignalRef = VCU_RegenTorqueCap_oVCU_chassis_oKAMA_FP_EPSChassis1_0303_c66ed8e8_Tx
        ComIPduSignalRef = VCU_RegenTorqueValid_oVCU_chassis_oKAMA_FP_EPSChassis1_0303_fb5a2330_Tx
        ComIPduSignalRef = VCU_TorqueRequestActive_oVCU_chassis_oKAMA_FP_EPSChassis1_0303_8ff9daa5_Tx
        ComIPduSignalRef = VCU_TorqueRequestAvailable_oVCU_chassis_oKAMA_FP_EPSChassis1_0303_cd911a5c_Tx
        ComIPduSignalRef = VCU_WheelTrqACT_oVCU_chassis_oKAMA_FP_EPSChassis1_0303_a917e36b_Tx
        ComIPduSignalRef = VCU_driverTorqueRequest_oVCU_chassis_oKAMA_FP_EPSChassis1_0303_2cc8e1fb_Tx
        ComPduIdRef = VCU_chassis_oKAMA_FP_EPSChassis1_0303_187d50df_Tx
        ComTxIPdu: ComMinimumDelayTime=0, ComTxIPduUnusedAreasDefault=0
          ComTxModeTrue
            ComTxMode: ComTxModeMode=PERIODIC, ComTxModeTimeOffset=0, ComTxModeTimePeriod=0.02
          ComTxModeFalse
            ComTxMode: ComTxModeMode=PERIODIC, ComTxModeTimeOffset=0, ComTxModeTimePeriod=0.02
      IBS_RRMovingDirection_oIBS_WheelSpeed_oKAMA_FP_EPSChassis1_0303_625afa29_Rx (ComSignal):
        ComBitPosition = 38
        ComBitSize = 2
        ComSignalEndianness = BIG_ENDIAN
        ComSignalInitValue = 0
        ComSignalType = UINT8
        ComTimeout = 0
        ComSignalAccess = ACCESS_UNCLEAR
        ComHandleId = 323
        ComSystemTemplateSystemSignalRef = IBS_RRMovingDirection
      VCU_oKAMA_FP_EPSChassis1_0303_Rx_00807295 (ComIPduGroup): ComIPduGroupHandleId=0
      BMS_ErrorCellVoltDiff_oBMS_ErrorInfo1_oKAMA_FP_EPT_0303_2ebca49f_Rx (ComSignal):
        ComBitPosition = 19
        ComBitSize = 2
        ComSignalEndianness = BIG_ENDIAN
        ComSignalInitValue = 0
        ComSignalType = UINT8
        ComTimeout = 0
        ComSignalAccess = ACCESS_UNCLEAR
        ComHandleId = 107
        ComSystemTemplateSystemSignalRef = BMS_ErrorCellVoltDiff
      BMS_CurrentLimit_oKAMA_FP_EPT_0303_4d8e4c2e_Rx (ComIPdu):
        ComIPduDirection = RECEIVE
        ComIPduType = NORMAL
        ComIPduHandleId = 12
        ComIPduSignalProcessing = DEFERRED
        ComIPduCancellationSupport = false
        ComIPduGroupRef = VCU_oKAMA_FP_EPT_0303_Rx_07e8d111
        ComIPduSignalRef = BMS_DisChgCurr_oBMS_CurrentLimit_oKAMA_FP_EPT_0303_85919879_Rx
        ComIPduSignalRef = BMS_FeedbackCurr_oBMS_CurrentLimit_oKAMA_FP_EPT_0303_f61f9a51_Rx
        ComPduIdRef = BMS_CurrentLimit_oKAMA_FP_EPT_0303_4d8e4c2e_Rx
      11 x ComSignal, all with ComSignalInitValue=0, ComTimeout=0, ComSignalAccess=ACCESS_UNCLEAR:
        Checksum_340_oYRS_7_oKAMA_FP_EPSChassis1_0303_cff9ab5d_Rx: ComBitPosition=56, ComBitSize=8, ComSignalEndianness=LITTLE_ENDIAN, ComSignalType=UINT8, ComHandleId=200, ComSystemTemplateSystemSignalRef=Checksum_340
        Checksum_AE_oBMS_status_oKAMA_FP_EPT_0303_0c390b19_Rx: ComBitPosition=63, ComBitSize=8, ComSignalEndianness=BIG_ENDIAN, ComSignalType=UINT8, ComHandleId=202, ComSystemTemplateSystemSignalRef=Checksum_AE
        VCU_DynamicMileage_oVCU_Mileage_oKAMA_FP_EPT_0303_3c741a1c_Tx: ComBitPosition=39, ComBitSize=9, ComSignalEndianness=BIG_ENDIAN, ComSignalType=UINT16, ComTransferProperty=PENDING, ComHandleId=60, ComSystemTemplateSystemSignalRef=VCU_DynamicMileage
        VCU_NeutralLockExitReason_oVCU_PwrtrainRequests_oKAMA_FP_EPSChassis1_0303_9d0551c7_Tx: ComBitPosition=11, ComBitSize=3, ComSignalEndianness=BIG_ENDIAN, ComSignalType=UINT8, ComTransferProperty=PENDING, ComHandleId=92, ComSystemTemplateSystemSignalRef=VCU_NeutralLockExitReason
        BMS_SumChgkwh_oBMS_ChargeEnergy_oKAMA_FP_EPT_0303_c03c2779_Rx: ComBitPosition=15, ComBitSize=24, ComSignalEndianness=BIG_ENDIAN, ComSignalType=UINT32, ComHandleId=174, ComSystemTemplateSystemSignalRef=BMS_SumChgkwh
        EVCOM_OverCurrentError_oEVCOM_State_oKAMA_FP_EPT_0303_40ef81df_Rx: ComBitPosition=7, ComBitSize=1, ComSignalEndianness=BIG_ENDIAN, ComSignalType=BOOLEAN, ComHandleId=271, ComSystemTemplateSystemSignalRef=EVCOM_OverCurrentError
        IBS_HDCActive_oIBS_Status2_oKAMA_FP_EPSChassis1_0303_7674e9aa_Rx: ComBitPosition=19, ComBitSize=2, ComSignalEndianness=BIG_ENDIAN, ComSignalType=UINT8, ComHandleId=311, ComSystemTemplateSystemSignalRef=IBS_HDCActive
        IBS_VDCFault_oIBS_Status3_oKAMA_FP_EPSChassis1_0303_da46f95f_Rx: ComBitPosition=4, ComBitSize=1, ComSignalEndianness=BIG_ENDIAN, ComSignalType=BOOLEAN, ComHandleId=336, ComSystemTemplateSystemSignalRef=IBS_VDCFault
        IBS_FRWheelPulseCounter_oIBS_WheelPulse_oKAMA_FP_EPSChassis1_0303_1c68419b_Rx: ComBitPosition=15, ComBitSize=8, ComSignalEndianness=BIG_ENDIAN, ComSignalType=UINT8, ComHandleId=308, ComSystemTemplateSystemSignalRef=IBS_FRWheelPulseCounter
        PEPS_PowerModeValidity_oDonorCar_PEPS_Message_Sts_oKAMA_FP_EPSChassis1_0303_896cd32f_Rx: ComBitPosition=1, ComBitSize=2, ComSignalEndianness=BIG_ENDIAN, ComSignalType=UINT8, ComHandleId=476, ComSystemTemplateSystemSignalRef=PEPS_PowerModeValidity
        Checksum_5D_oIBS_Status3_oKAMA_FP_EPSChassis1_0303_7c63273d_Rx: ComBitPosition=63, ComBitSize=8, ComSignalEndianness=BIG_ENDIAN, ComSignalType=UINT8, ComHandleId=191, ComSystemTemplateSystemSignalRef=Checksum_5D
      BMS_CellVoltage1_oKAMA_FP_EPT_0303_fc77b879_Rx (ComIPdu):
        ComIPduDirection = RECEIVE
        ComIPduType = NORMAL
        ComIPduHandleId = 8
        ComIPduSignalProcessing = DEFERRED
        ComIPduCancellationSupport = false
        ComIPduGroupRef = VCU_oKAMA_FP_EPT_0303_Rx_07e8d111
        ComIPduSignalRef = BMS_MaxCellVoltageModuleNO_oBMS_CellVoltage1_oKAMA_FP_EPT_0303_0d97a828_Rx
        ComIPduSignalRef = BMS_MaxCellVoltageNO_oBMS_CellVoltage1_oKAMA_FP_EPT_0303_3c12aa06_Rx
        ComIPduSignalRef = BMS_MaxCellVoltage_oBMS_CellVoltage1_oKAMA_FP_EPT_0303_0e72448e_Rx
        ComIPduSignalRef = BMS_MinCellVoltageModlueNO_oBMS_CellVoltage1_oKAMA_FP_EPT_0303_39d14c38_Rx
        ComIPduSignalRef = BMS_MinCellVoltageNO_oBMS_CellVoltage1_oKAMA_FP_EPT_0303_5b38c322_Rx
        ComIPduSignalRef = BMS_MinCellVoltage_oBMS_CellVoltage1_oKAMA_FP_EPT_0303_4fcd821a_Rx
        ComPduIdRef = BMS_CellVoltage1_oKAMA_FP_EPT_0303_fc77b879_Rx
      3 x ComSignal, all with ComSignalEndianness=BIG_ENDIAN, ComSignalInitValue=0, ComTimeout=0, ComSignalAccess=ACCESS_UNCLEAR:
        MessageCounter_5_oBMS_TCU_oKAMA_FP_EPT_0303_c3903e71_Rx: ComBitPosition=51, ComBitSize=4, ComSignalType=UINT8, ComHandleId=416, ComSystemTemplateSystemSignalRef=MessageCounter_5
        DM2_Byte4_oREPS_DM2_oKAMA_FP_EPSChassis1_0303_43929bea_Rx: ComBitPosition=39, ComBitSize=8, ComSignalType=UINT8, ComHandleId=238, ComSystemTemplateSystemSignalRef=DM2_Byte4
        AEB_ABPReq_oADAS_AEB_oKAMA_FP_EPSChassis1_0303_3ae93c17_Rx: ComBitPosition=7, ComBitSize=1, ComSignalType=BOOLEAN, ComHandleId=26, ComSystemTemplateSystemSignalRef=AEB_ABPReq
      MCU_VCU_1_oKAMA_FP_EPT_0303_4d7e305c_Rx (ComIPdu):
        ComIPduDirection = RECEIVE
        ComIPduType = NORMAL
        ComIPduHandleId = 50
        ComIPduSignalProcessing = DEFERRED
        ComIPduCancellationSupport = false
        ComIPduGroupRef = VCU_oKAMA_FP_EPT_0303_Rx_07e8d111
        ComIPduSignalRef = MCU_ActTrqValid_oMCU_VCU_1_oKAMA_FP_EPT_0303_0ddbe723_Rx
        ComIPduSignalRef = MCU_ActualSpeedValid_oMCU_VCU_1_oKAMA_FP_EPT_0303_09eff7d8_Rx
        ComIPduSignalRef = MCU_ActualSpeed_oMCU_VCU_1_oKAMA_FP_EPT_0303_0995a35d_Rx
        ComIPduSignalRef = MCU_ActualTorque_oMCU_VCU_1_oKAMA_FP_EPT_0303_1c271734_Rx
        ComIPduSignalRef = MCU_IsCurr_oMCU_VCU_1_oKAMA_FP_EPT_0303_14da0f17_Rx
        ComIPduSignalRef = MCU_UdcCurr_oMCU_VCU_1_oKAMA_FP_EPT_0303_ad4a2a55_Rx
        ComIPduSignalRef = MessageCounter_7A_oMCU_VCU_1_oKAMA_FP_EPT_0303_d9a8a6b6_Rx
        ComPduIdRef = MCU_VCU_1_oKAMA_FP_EPT_0303_4d7e305c_Rx
      VCU_MCUPower_oVCU_Mileage_oKAMA_FP_EPT_0303_c1ddf1db_Tx (ComSignal):
        ComBitPosition = 7
        ComBitSize = 9
        ComSignalEndianness = BIG_ENDIAN
        ComSignalInitValue = 200
        ComSignalType = UINT16
        ComTimeout = 0
        ComTransferProperty = PENDING
        ComSignalAccess = ACCESS_UNCLEAR
        ComHandleId = 85
        ComSystemTemplateSystemSignalRef = VCU_MCUPower
      BMS_BatCode1_oBMS_Batcode_oKAMA_FP_EPT_0303_fc10543e_Rx (ComSignal):
        ComBitPosition = 23
        ComBitSize = 8
        ComSignalEndianness = BIG_ENDIAN
        ComSignalInitValue = 0
        ComSignalType = UINT8
        ComTimeout = 0
        ComSignalAccess = ACCESS_UNCLEAR
        ComHandleId = 69
        ComSystemTemplateSystemSignalRef = BMS_BatCode1
      TCU_ACStatusInfo_oKAMA_FP_EPT_0303_1e9c334e_Rx (ComIPdu):
        ComIPduDirection = RECEIVE
        ComIPduType = NORMAL
        ComIPduHandleId = 60
        ComIPduSignalProcessing = DEFERRED
        ComIPduCancellationSupport = false
        ComIPduGroupRef = VCU_oKAMA_FP_EPT_0303_Rx_07e8d111
        ComIPduSignalRef = AC_AirDistributionMode_oTCU_ACStatusInfo_oKAMA_FP_EPT_0303_c0475caf_Rx
        ComIPduSignalRef = AC_BlowerLevel_oTCU_ACStatusInfo_oKAMA_FP_EPT_0303_fb35f94a_Rx
        ComIPduSignalRef = AC_FrontDefrostState_oTCU_ACStatusInfo_oKAMA_FP_EPT_0303_1b119bb6_Rx
        ComIPduSignalRef = AC_IntakeAirState_oTCU_ACStatusInfo_oKAMA_FP_EPT_0303_9da5f179_Rx
        ComIPduSignalRef = AC_LeftSetTemperature_oTCU_ACStatusInfo_oKAMA_FP_EPT_0303_b1cc7bda_Rx
        ComIPduSignalRef = AC_MaxAcState_oTCU_ACStatusInfo_oKAMA_FP_EPT_0303_4417deab_Rx
        ComIPduSignalRef = AC_OnState_oTCU_ACStatusInfo_oKAMA_FP_EPT_0303_e706dad0_Rx
        ComPduIdRef = TCU_ACStatusInfo_oKAMA_FP_EPT_0303_1e9c334e_Rx
      9 x ComSignal, all with ComSignalEndianness=BIG_ENDIAN, ComTimeout=0, ComSignalAccess=ACCESS_UNCLEAR:
        MCU_IGBTTempRiseMax_oMCU_Temperature1_oKAMA_FP_EPT_0303_14d3b7fa_Rx: ComBitPosition=63, ComBitSize=8, ComSignalInitValue=255, ComSignalType=UINT8, ComHandleId=357, ComSystemTemplateSystemSignalRef=MCU_IGBTTempRiseMax
        EVCOM_CompActlPwrCnsmpValid_oEVCOM_State_oKAMA_FP_EPT_0303_d7acbb26_Rx: ComBitPosition=23, ComBitSize=1, ComSignalInitValue=0, ComSignalType=BOOLEAN, ComHandleId=263, ComSystemTemplateSystemSignalRef=EVCOM_CompActlPwrCnsmpValid
        MessageCounter_274_oVCU_OBC_oKAMA_FP_EPT_0303_9935717b_Tx: ComBitPosition=51, ComBitSize=4, ComSignalInitValue=0, ComSignalType=UINT8, ComTransferProperty=PENDING, ComHandleId=23, ComSystemTemplateSystemSignalRef=MessageCounter_274
        TCU_TMSState_oTCU_Status_oKAMA_FP_EPT_0303_e5c86ed2_Rx: ComBitPosition=7, ComBitSize=4, ComSignalInitValue=0, ComSignalType=UINT8, ComHandleId=506, ComSystemTemplateSystemSignalRef=TCU_TMSState
        EVCOM_UnderVoltageError_oEVCOM_State_oKAMA_FP_EPT_0303_07486fd6_Rx: ComBitPosition=5, ComBitSize=1, ComSignalInitValue=0, ComSignalType=BOOLEAN, ComHandleId=276, ComSystemTemplateSystemSignalRef=EVCOM_UnderVoltageError
        VCU_OBC_ChargeCurrentCommand_oVCU_OBC_oKAMA_FP_EPT_0303_80f77f00_Tx: ComBitPosition=3, ComBitSize=13, ComSignalInitValue=0, ComSignalType=UINT16, ComTransferProperty=PENDING, ComHandleId=94, ComSystemTemplateSystemSignalRef=VCU_OBC_ChargeCurrentCommand
        BMS_BatProDatMonth_oBMS_PRO_oKAMA_FP_EPT_0303_b57a5485_Rx: ComBitPosition=15, ComBitSize=8, ComSignalInitValue=0, ComSignalType=UINT8, ComHandleId=78, ComSystemTemplateSystemSignalRef=BMS_BatProDatMonth
        VCU_MCUDesiredTorque_oVCU_MCU01_oKAMA_FP_EPT_0303_77ea20f3_Tx: ComBitPosition=7, ComBitSize=11, ComSignalInitValue=1023, ComSignalType=UINT16, ComTransferProperty=PENDING, ComHandleId=84, ComSystemTemplateSystemSignalRef=VCU_MCUDesiredTorque
        Checksum_274_oVCU_OBC_oKAMA_FP_EPT_0303_4dba18d6_Tx: ComBitPosition=63, ComBitSize=8, ComSignalInitValue=0, ComSignalType=UINT8, ComTransferProperty=PENDING, ComHandleId=11, ComSystemTemplateSystemSignalRef=Checksum_274
      TCU_AmbientTemp_oKAMA_FP_EPT_0303_16fc04eb_Rx (ComIPdu):
        ComIPduDirection = RECEIVE
        ComIPduType = NORMAL
        ComIPduHandleId = 61
        ComIPduSignalProcessing = DEFERRED
        ComIPduCancellationSupport = false
        ComIPduGroupRef = VCU_oKAMA_FP_EPT_0303_Rx_07e8d111
        ComIPduSignalRef = TCU_AmbientTemperature_oTCU_AmbientTemp_oKAMA_FP_EPT_0303_efb8be2a_Rx
        ComPduIdRef = TCU_AmbientTemp_oKAMA_FP_EPT_0303_16fc04eb_Rx
      25 x ComSignal, all with ComTimeout=0, ComSignalAccess=ACCESS_UNCLEAR:
        BMS_AllowChagCurrent_oBMS_Charge1_oKAMA_FP_EPT_0303_2005bfb9_Rx: ComBitPosition=55, ComBitSize=16, ComSignalEndianness=BIG_ENDIAN, ComSignalInitValue=10000, ComSignalType=UINT16, ComHandleId=63, ComSystemTemplateSystemSignalRef=BMS_AllowChagCurrent
        MessageCounter_5E_oIBS_Torque_oKAMA_FP_EPSChassis1_0303_f4127afb_Rx: ComBitPosition=51, ComBitSize=4, ComSignalEndianness=BIG_ENDIAN, ComSignalInitValue=0, ComSignalType=UINT8, ComHandleId=414, ComSystemTemplateSystemSignalRef=MessageCounter_5E
        OBC_ACPortTempBSensValid_oOBC_Error_STATUS_oKAMA_FP_EPT_0303_419c4cc5_Rx: ComBitPosition=5, ComBitSize=2, ComSignalEndianness=BIG_ENDIAN, ComSignalInitValue=0, ComSignalType=UINT8, ComHandleId=430, ComSystemTemplateSystemSignalRef=OBC_ACPortTempBSensValid
        OBC_OBCMaxPermOutpCrrt_oOBC_VCU_STATUS1_oKAMA_FP_EPT_0303_2b78d0ea_Rx: ComBitPosition=55, ComBitSize=9, ComSignalEndianness=BIG_ENDIAN, ComSignalInitValue=0, ComSignalType=UINT16, ComHandleId=461, ComSystemTemplateSystemSignalRef=OBC_OBCMaxPermOutpCrrt
        VCU_AvaDrvRange_oVCU_HVbattStatus1_oKAMA_FP_EPSChassis1_0303_18b832e7_Tx: ComBitPosition=7, ComBitSize=10, ComSignalEndianness=BIG_ENDIAN, ComSignalInitValue=0, ComSignalType=UINT16, ComTransferProperty=PENDING, ComHandleId=44, ComSystemTemplateSystemSignalRef=VCU_AvaDrvRange
        BMS_ErrorRelay_oBMS_ErrorInfo1_oKAMA_FP_EPT_0303_abd512da_Rx: ComBitPosition=25, ComBitSize=1, ComSignalEndianness=BIG_ENDIAN, ComSignalInitValue=0, ComSignalType=BOOLEAN, ComHandleId=121, ComSystemTemplateSystemSignalRef=BMS_ErrorRelay
        DCDC_OutputCurrentSensorFault_oDCDC_VCU_02_oKAMA_FP_EPT_0303_a94a7b3c_Rx: ComBitPosition=14, ComBitSize=1, ComSignalEndianness=BIG_ENDIAN, ComSignalInitValue=0, ComSignalType=BOOLEAN, ComHandleId=216, ComSystemTemplateSystemSignalRef=DCDC_OutputCurrentSensorFault
        ACC_Driveoff_Request_oADAS_ACC_oKAMA_FP_EPSChassis1_0303_720c9928_Rx: ComBitPosition=1, ComBitSize=1, ComSignalEndianness=BIG_ENDIAN, ComSignalInitValue=0, ComSignalType=BOOLEAN, ComHandleId=3, ComSystemTemplateSystemSignalRef=ACC_Driveoff_Request
        APA_SpeedLimit_oADAS_APA_oKAMA_FP_EPSChassis1_0303_cd13b2ad_Rx: ComBitPosition=23, ComBitSize=7, ComSignalEndianness=BIG_ENDIAN, ComSignalInitValue=0, ComSignalType=UINT8, ComHandleId=35, ComSystemTemplateSystemSignalRef=APA_SpeedLimit
        BMS_FeedbackCurr_oBMS_CurrentLimit_oKAMA_FP_EPT_0303_f61f9a51_Rx: ComBitPosition=7, ComBitSize=16, ComSignalEndianness=BIG_ENDIAN, ComSignalInitValue=10000, ComSignalType=UINT16, ComHandleId=125, ComSystemTemplateSystemSignalRef=BMS_FeedbackCurr
        OBC_ChargeStatus_oOBC_VCU_STATUS1_oKAMA_FP_EPT_0303_04c7e1f4_Rx: ComBitPosition=10, ComBitSize=3, ComSignalEndianness=BIG_ENDIAN, ComSignalInitValue=0, ComSignalType=UINT8, ComHandleId=442, ComSystemTemplateSystemSignalRef=OBC_ChargeStatus
        VCU_ActDriverMode_oVCU_PwrtrainRequests_oKAMA_FP_EPSChassis1_0303_f53b302a_Tx: ComBitPosition=37, ComBitSize=3, ComSignalEndianness=BIG_ENDIAN, ComSignalInitValue=0, ComSignalType=UINT8, ComTransferProperty=PENDING, ComHandleId=36, ComSystemTemplateSystemSignalRef=VCU_ActDriverMode
        VCU_HVBatLowSocWar_oVCU_HMIsignals_oKAMA_FP_EPSChassis1_0303_85c9d405_Tx: ComBitPosition=15, ComBitSize=1, ComSignalEndianness=BIG_ENDIAN, ComSignalInitValue=0, ComSignalType=BOOLEAN, ComTransferProperty=PENDING, ComHandleId=70, ComSystemTemplateSystemSignalRef=VCU_HVBatLowSocWar
        MCU_IGBTTempU_oMCU_Temperature1_oKAMA_FP_EPT_0303_77c5dc46_Rx: ComBitPosition=7, ComBitSize=8, ComSignalEndianness=BIG_ENDIAN, ComSignalInitValue=255, ComSignalType=UINT8, ComHandleId=361, ComSystemTemplateSystemSignalRef=MCU_IGBTTempU
        OBC_InputOverCurrentstatus_R_oOBC_Error_STATUS_oKAMA_FP_EPT_0303_4580bb0c_Rx: ComBitPosition=21, ComBitSize=1, ComSignalEndianness=BIG_ENDIAN, ComSignalInitValue=0, ComSignalType=BOOLEAN, ComHandleId=456, ComSystemTemplateSystemSignalRef=OBC_InputOverCurrentstatus_R
        APTC_HeatingFaltStatus_oAPTC_TCU_oKAMA_FP_EPT_0303_88ff119c_Rx: ComBitPosition=1, ComBitSize=1, ComSignalEndianness=BIG_ENDIAN, ComSignalInitValue=0, ComSignalType=BOOLEAN, ComHandleId=42, ComSystemTemplateSystemSignalRef=APTC_HeatingFaltStatus
        DM2_Byte0_oREPS_DM2_oKAMA_FP_EPSChassis1_0303_2dc1cd55_Rx: ComBitPosition=7, ComBitSize=8, ComSignalEndianness=BIG_ENDIAN, ComSignalInitValue=0, ComSignalType=UINT8, ComHandleId=234, ComSystemTemplateSystemSignalRef=DM2_Byte0
        EVCOM_CompActlSpdValid_oEVCOM_State_oKAMA_FP_EPT_0303_777fbcfb_Rx: ComBitPosition=21, ComBitSize=1, ComSignalEndianness=BIG_ENDIAN, ComSignalInitValue=0, ComSignalType=BOOLEAN, ComHandleId=265, ComSystemTemplateSystemSignalRef=EVCOM_CompActlSpdValid
        BMS_RemChagTime_oBMS_Charge1_oKAMA_FP_EPT_0303_1cc78fa1_Rx: ComBitPosition=7, ComBitSize=16, ComSignalEndianness=BIG_ENDIAN, ComSignalInitValue=0, ComSignalType=UINT16, ComHandleId=155, ComSystemTemplateSystemSignalRef=BMS_RemChagTime
        TCU_CompEnable_oTCU_Cmd_oKAMA_FP_EPT_0303_f170584d_Rx: ComBitPosition=17, ComBitSize=1, ComSignalEndianness=BIG_ENDIAN, ComSignalInitValue=0, ComSignalType=BOOLEAN, ComHandleId=495, ComSystemTemplateSystemSignalRef=TCU_CompEnable
        Checksum_131_oYRS_2_oKAMA_FP_EPSChassis1_0303_166f48bf_Rx: ComBitPosition=56, ComBitSize=8, ComSignalEndianness=LITTLE_ENDIAN, ComSignalInitValue=0, ComSignalType=UINT8, ComHandleId=199, ComSystemTemplateSystemSignalRef=Checksum_131
        VCU_AvaDrvRange_oVCU_Mileage_oKAMA_FP_EPT_0303_eb1e8818_Tx: ComBitPosition=23, ComBitSize=9, ComSignalEndianness=BIG_ENDIAN, ComSignalInitValue=0, ComSignalType=UINT16, ComTransferProperty=PENDING, ComHandleId=45, ComSystemTemplateSystemSignalRef=VCU_AvaDrvRange
        ADAS_SteeringWheel_Vibration_oADAS_CCU1_Ctrl_oKAMA_FP_EPSChassis1_0303_fe57db2a_Rx: ComBitPosition=17, ComBitSize=1, ComSignalEndianness=BIG_ENDIAN, ComSignalInitValue=0, ComSignalType=BOOLEAN, ComHandleId=22, ComSystemTemplateSystemSignalRef=ADAS_SteeringWheel_Vibration
        Checksum_5A_oIBS_Status1_oKAMA_FP_EPSChassis1_0303_debec027_Rx: ComBitPosition=63, ComBitSize=8, ComSignalEndianness=BIG_ENDIAN, ComSignalInitValue=0, ComSignalType=UINT8, ComHandleId=188, ComSystemTemplateSystemSignalRef=Checksum_5A
        IBS_RLWheelPulseCounter_oIBS_WheelPulse_oKAMA_FP_EPSChassis1_0303_a94c2f35_Rx: ComBitPosition=31, ComBitSize=8, ComSignalEndianness=BIG_ENDIAN, ComSignalInitValue=0, ComSignalType=UINT8, ComHandleId=320, ComSystemTemplateSystemSignalRef=IBS_RLWheelPulseCounter
      IBS_Status2_oKAMA_FP_EPSChassis1_0303_086e2ed2_Rx (ComIPdu):
        ComIPduDirection = RECEIVE
        ComIPduType = NORMAL
        ComIPduHandleId = 37
        ComIPduSignalProcessing = DEFERRED
        ComIPduCancellationSupport = false
        ComIPduGroupRef = VCU_oKAMA_FP_EPSChassis1_0303_Rx_00807295
        ComIPduSignalRef = BBF_failurestatus_oIBS_Status2_oKAMA_FP_EPSChassis1_0303_48ab3311_Rx
        ComIPduSignalRef = Checksum_5B_oIBS_Status2_oKAMA_FP_EPSChassis1_0303_47965d6c_Rx
        ComIPduSignalRef = EPB_failurestatus_oIBS_Status2_oKAMA_FP_EPSChassis1_0303_1779b30f_Rx
        ComIPduSignalRef = IBS_AEBActive_oIBS_Status2_oKAMA_FP_EPSChassis1_0303_6b8bf521_Rx
        ComIPduSignalRef = IBS_AVHActive_oIBS_Status2_oKAMA_FP_EPSChassis1_0303_4618a6a7_Rx
        ComIPduSignalRef = IBS_AVHAvailable_oIBS_Status2_oKAMA_FP_EPSChassis1_0303_b75bd207_Rx
        ComIPduSignalRef = IBS_AVHStandbySts_oIBS_Status2_oKAMA_FP_EPSChassis1_0303_60b379df_Rx
        ComIPduSignalRef = IBS_BrakeLightRequest_oIBS_Status2_oKAMA_FP_EPSChassis1_0303_d5ca8e90_Rx
        ComIPduSignalRef = IBS_CDPActive_oIBS_Status2_oKAMA_FP_EPSChassis1_0303_175fb0ee_Rx
        ComIPduSignalRef = IBS_CDPAvailable_oIBS_Status2_oKAMA_FP_EPSChassis1_0303_3c3005fd_Rx
        ComIPduSignalRef = IBS_ECDActive_oIBS_Status2_oKAMA_FP_EPSChassis1_0303_eaef2465_Rx
        ComIPduSignalRef = IBS_EPBFailureLamp_oIBS_Status2_oKAMA_FP_EPSChassis1_0303_e214c490_Rx
        ComIPduSignalRef = IBS_EPBFunctionLamp_oIBS_Status2_oKAMA_FP_EPSChassis1_0303_f0c81de1_Rx
        ComIPduSignalRef = IBS_EPBSwitchPositionValid_oIBS_Status2_oKAMA_FP_EPSChassis1_0303_fb017e88_Rx
        ComIPduSignalRef = IBS_EPBSwitchPosition_oIBS_Status2_oKAMA_FP_EPSChassis1_0303_053602ab_Rx
        ComIPduSignalRef = IBS_EPBTxtdisplay_oIBS_Status2_oKAMA_FP_EPSChassis1_0303_a23c4ae6_Rx
        ComIPduSignalRef = IBS_EPBworkingStatus_oIBS_Status2_oKAMA_FP_EPSChassis1_0303_4cf5ad2b_Rx
        ComIPduSignalRef = IBS_HDCActive_oIBS_Status2_oKAMA_FP_EPSChassis1_0303_7674e9aa_Rx
        ComIPduSignalRef = IBS_HDCAvailable_oIBS_Status2_oKAMA_FP_EPSChassis1_0303_8c663fdd_Rx
        ComIPduSignalRef = IBS_HHCActive_oIBS_Status2_oKAMA_FP_EPSChassis1_0303_f5cb95d5_Rx
        ComIPduSignalRef = IBS_HHCAvailable_oIBS_Status2_oKAMA_FP_EPSChassis1_0303_0b9f88d4_Rx
        ComIPduSignalRef = IBS_LiquidAlarm_oIBS_Status2_oKAMA_FP_EPSChassis1_0303_652223f4_Rx
        ComIPduSignalRef = IBS_TCSActive_oIBS_Status2_oKAMA_FP_EPSChassis1_0303_8ff26d77_Rx
        ComIPduSignalRef = IBS_VDCActive_oIBS_Status2_oKAMA_FP_EPSChassis1_0303_a0d22281_Rx
        ComIPduSignalRef = MessageCounter_5B_oIBS_Status2_oKAMA_FP_EPSChassis1_0303_6b3632e1_Rx
        ComPduIdRef = IBS_Status2_oKAMA_FP_EPSChassis1_0303_086e2ed2_Rx
      12 x ComSignal, all with ComSignalEndianness=BIG_ENDIAN, ComSignalInitValue=0, ComTimeout=0, ComSignalAccess=ACCESS_UNCLEAR:
        IBS_RRWheelSpeed_Fault_oIBS_WheelSpeed_oKAMA_FP_EPSChassis1_0303_7badf24c_Rx: ComBitPosition=39, ComBitSize=1, ComSignalType=BOOLEAN, ComHandleId=325, ComSystemTemplateSystemSignalRef=IBS_RRWheelSpeed_Fault
        MCU_CodeVer_oMCU_SoftwareNumber_oKAMA_FP_EPT_0303_efc3a3ec_Rx: ComBitPosition=7, ComBitSize=16, ComSignalType=UINT16, ComHandleId=348, ComSystemTemplateSystemSignalRef=MCU_CodeVer
        MCU_bDernN_oMCU_DeratingStatus_oKAMA_FP_EPT_0303_cda63925_Rx: ComBitPosition=12, ComBitSize=1, ComSignalType=BOOLEAN, ComHandleId=381, ComSystemTemplateSystemSignalRef=MCU_bDernN
        DM2_Byte1_oREPS_DM2_oKAMA_FP_EPSChassis1_0303_ad31da4a_Rx: ComBitPosition=15, ComBitSize=8, ComSignalType=UINT8, ComHandleId=235, ComSystemTemplateSystemSignalRef=DM2_Byte1
        APTC_PowerConsumption_oAPTC_TCU_oKAMA_FP_EPT_0303_55aa242f_Rx: ComBitPosition=31, ComBitSize=8, ComSignalType=UINT8, ComHandleId=46, ComSystemTemplateSystemSignalRef=APTC_PowerConsumption
        VCU_VirtualPedalValid_oVCU_AccPedal_oKAMA_FP_EPSChassis1_0303_6044ac51_Tx: ComBitPosition=18, ComBitSize=1, ComSignalType=BOOLEAN, ComTransferProperty=PENDING, ComHandleId=121, ComSystemTemplateSystemSignalRef=VCU_VirtualPedalValid
        BMS_ThermalRunawayFault_oBMS_ErrorInfo1_oKAMA_FP_EPT_0303_29f4ecd4_Rx: ComBitPosition=56, ComBitSize=1, ComSignalType=BOOLEAN, ComHandleId=180, ComSystemTemplateSystemSignalRef=BMS_ThermalRunawayFault
        BMS_BalancingStatus_oBMS_status_oKAMA_FP_EPT_0303_b7466fbf_Rx: ComBitPosition=47, ComBitSize=1, ComSignalType=BOOLEAN, ComHandleId=67, ComSystemTemplateSystemSignalRef=BMS_BalancingStatus
        MCU_UT15Curr_oMCU_DeratingStatus_oKAMA_FP_EPT_0303_ff91b861_Rx: ComBitPosition=63, ComBitSize=6, ComSignalType=UINT8, ComHandleId=378, ComSystemTemplateSystemSignalRef=MCU_UT15Curr
        VCU_RegenTorqueValid_oVCU_chassis_oKAMA_FP_EPSChassis1_0303_fb5a2330_Tx: ComBitPosition=12, ComBitSize=1, ComSignalType=BOOLEAN, ComTransferProperty=PENDING, ComHandleId=103, ComSystemTemplateSystemSignalRef=VCU_RegenTorqueValid
        Checksum_27F_oVCU_PwrtrainHVbattStatus2_oKAMA_FP_EPSChassis1_0303_27901d10_Tx: ComBitPosition=63, ComBitSize=8, ComSignalType=UINT8, ComTransferProperty=PENDING, ComHandleId=5, ComSystemTemplateSystemSignalRef=Checksum_27F
        EVCOM_CompActlPwrCnsmp_oEVCOM_State_oKAMA_FP_EPT_0303_736c4b6e_Rx: ComBitPosition=47, ComBitSize=8, ComSignalType=UINT8, ComHandleId=264, ComSystemTemplateSystemSignalRef=EVCOM_CompActlPwrCnsmp
      VCU_OBC_oKAMA_FP_EPT_0303_8235bc7f_Tx (ComIPdu):
        ComIPduDirection = SEND
        ComIPduType = NORMAL
        ComIPduHandleId = 11
        ComIPduSignalProcessing = DEFERRED
        ComIPduCancellationSupport = false
        ComIPduGroupRef = VCU_oKAMA_FP_EPT_0303_Tx_51b27697
        ComIPduSignalRef = Checksum_274_oVCU_OBC_oKAMA_FP_EPT_0303_4dba18d6_Tx
        ComIPduSignalRef = MessageCounter_274_oVCU_OBC_oKAMA_FP_EPT_0303_9935717b_Tx
        ComIPduSignalRef = VCU_EnableOBC_oVCU_OBC_oKAMA_FP_EPT_0303_9539dbc0_Tx
        ComIPduSignalRef = VCU_OBC_ChargeCurrentCommand_oVCU_OBC_oKAMA_FP_EPT_0303_80f77f00_Tx
        ComIPduSignalRef = VCU_OBC_Control_of_S2_SW_oVCU_OBC_oKAMA_FP_EPT_0303_a9c3a188_Tx
        ComIPduSignalRef = VCU_OBC_Control_of_em_lock_oVCU_OBC_oKAMA_FP_EPT_0303_fc5c407f_Tx
        ComPduIdRef = VCU_OBC_oKAMA_FP_EPT_0303_8235bc7f_Tx
        ComTxIPdu: ComMinimumDelayTime=0, ComTxIPduUnusedAreasDefault=0
          ComTxModeTrue
            ComTxMode: ComTxModeMode=PERIODIC, ComTxModeTimeOffset=0, ComTxModeTimePeriod=0.1
          ComTxModeFalse
            ComTxMode: ComTxModeMode=PERIODIC, ComTxModeTimeOffset=0, ComTxModeTimePeriod=0.1
      MCU_bDernTrqMax_oMCU_DeratingStatus_oKAMA_FP_EPT_0303_b0e37eb5_Rx (ComSignal):
        ComBitPosition = 3
        ComBitSize = 1
        ComSignalEndianness = BIG_ENDIAN
        ComSignalInitValue = 0
        ComSignalType = BOOLEAN
        ComTimeout = 0
        ComSignalAccess = ACCESS_UNCLEAR
        ComHandleId = 387
        ComSystemTemplateSystemSignalRef = MCU_bDernTrqMax
      MCU_ActualTorque_oMCU_VCU_1_oKAMA_FP_EPT_0303_1c271734_Rx (ComSignal):
        ComBitPosition = 7
        ComBitSize = 11
        ComSignalEndianness = BIG_ENDIAN
        ComSignalInitValue = 1024
        ComSignalType = UINT16
        ComTimeout = 0
        ComSignalAccess = ACCESS_UNCLEAR
        ComHandleId = 346
        ComSystemTemplateSystemSignalRef = MCU_ActualTorque
      BMS_DIRelayState_oKAMA_FP_EPT_0303_081a63f8_Rx (ComIPdu):
        ComIPduDirection = RECEIVE
        ComIPduType = NORMAL
        ComIPduHandleId = 13
        ComIPduSignalProcessing = DEFERRED
        ComIPduCancellationSupport = false
        ComIPduGroupRef = VCU_oKAMA_FP_EPT_0303_Rx_07e8d111
        ComIPduSignalRef = BMS_NegRelayStatus_oBMS_DIRelayState_oKAMA_FP_EPT_0303_942155bb_Rx
        ComIPduSignalRef = BMS_PTCRelayStatus_oBMS_DIRelayState_oKAMA_FP_EPT_0303_3e30196d_Rx
        ComIPduSignalRef = BMS_PosRelayStatus_oBMS_DIRelayState_oKAMA_FP_EPT_0303_11fa2207_Rx
        ComIPduSignalRef = BMS_PreRelayStatus_oBMS_DIRelayState_oKAMA_FP_EPT_0303_1751a172_Rx
        ComIPduSignalRef = BMS_StateDI2_oBMS_DIRelayState_oKAMA_FP_EPT_0303_0c78e73f_Rx
        ComIPduSignalRef = BMS_StateDI3_oBMS_DIRelayState_oKAMA_FP_EPT_0303_8c88f020_Rx
        ComIPduSignalRef = BMS_StateDI4_oBMS_DIRelayState_oKAMA_FP_EPT_0303_b8ba99ff_Rx
        ComIPduSignalRef = BMS_StateDI5_oBMS_DIRelayState_oKAMA_FP_EPT_0303_384a8ee0_Rx
        ComIPduSignalRef = BMS_StateDI6_oBMS_DIRelayState_oKAMA_FP_EPT_0303_622bb180_Rx
        ComIPduSignalRef = BMS_StateDI7_oBMS_DIRelayState_oKAMA_FP_EPT_0303_e2dba69f_Rx
        ComIPduSignalRef = BMS_StateDI8_oBMS_DIRelayState_oKAMA_FP_EPT_0303_0a4f623e_Rx
        ComIPduSignalRef = BMS_StateRelay4_oBMS_DIRelayState_oKAMA_FP_EPT_0303_78849980_Rx
        ComIPduSignalRef = BMS_StateRelay5_oBMS_DIRelayState_oKAMA_FP_EPT_0303_f8748e9f_Rx
        ComIPduSignalRef = BMS_StateRelay6_oBMS_DIRelayState_oKAMA_FP_EPT_0303_a215b1ff_Rx
        ComIPduSignalRef = BMS_StateRelay7_oBMS_DIRelayState_oKAMA_FP_EPT_0303_22e5a6e0_Rx
        ComIPduSignalRef = BMS_StateRelay8_oBMS_DIRelayState_oKAMA_FP_EPT_0303_ca716241_Rx
        ComPduIdRef = BMS_DIRelayState_oKAMA_FP_EPT_0303_081a63f8_Rx
      14 x ComSignal, all with ComTimeout=0, ComSignalAccess=ACCESS_UNCLEAR:
        BMS_ErrorLevel_oBMS_status_oKAMA_FP_EPT_0303_ecafdd61_Rx: ComBitPosition=43, ComBitSize=4, ComSignalEndianness=BIG_ENDIAN, ComSignalInitValue=0, ComSignalType=UINT8, ComHandleId=118, ComSystemTemplateSystemSignalRef=BMS_ErrorLevel
        YRS_BusOff_oYRS_7_oKAMA_FP_EPSChassis1_0303_50939f50_Rx: ComBitPosition=7, ComBitSize=1, ComSignalEndianness=LITTLE_ENDIAN, ComSignalInitValue=0, ComSignalType=BOOLEAN, ComHandleId=518, ComSystemTemplateSystemSignalRef=YRS_BusOff
        VCU_faultChrgMultPlugs_oVCU_PlugInChrgInfo1_oKAMA_FP_EPSChassis1_0303_502ef6e5_Tx: ComBitPosition=7, ComBitSize=1, ComSignalEndianness=BIG_ENDIAN, ComSignalInitValue=0, ComSignalType=BOOLEAN, ComTransferProperty=PENDING, ComHandleId=130, ComSystemTemplateSystemSignalRef=VCU_faultChrgMultPlugs
        EPS_Iq_oEPS_FEEDBACK_oKAMA_FP_EPSChassis1_0303_dbd3334a_Rx: ComBitPosition=39, ComBitSize=16, ComSignalEndianness=BIG_ENDIAN, ComSignalInitValue=10000, ComSignalType=UINT16, ComHandleId=255, ComSystemTemplateSystemSignalRef=EPS_Iq
        OBC_internalFault_oOBC_Error_STATUS_oKAMA_FP_EPT_0303_2469625b_Rx: ComBitPosition=25, ComBitSize=1, ComSignalEndianness=BIG_ENDIAN, ComSignalInitValue=0, ComSignalType=BOOLEAN, ComHandleId=473, ComSystemTemplateSystemSignalRef=OBC_internalFault
        BMS_InsulationDetectionStatus_oBMS_Insulation_oKAMA_FP_EPT_0303_583ee5db_Rx: ComBitPosition=55, ComBitSize=1, ComSignalEndianness=BIG_ENDIAN, ComSignalInitValue=0, ComSignalType=BOOLEAN, ComHandleId=130, ComSystemTemplateSystemSignalRef=BMS_InsulationDetectionStatus
        VCU_IsoMeasurementSwitch_oVCU_BMS_oKAMA_FP_EPT_0303_e68a1aea_Tx: ComBitPosition=3, ComBitSize=2, ComSignalEndianness=BIG_ENDIAN, ComSignalInitValue=0, ComSignalType=UINT8, ComTransferProperty=PENDING, ComHandleId=80, ComSystemTemplateSystemSignalRef=VCU_IsoMeasurementSwitch
        BMS_Tempoutlet_oBMS_TCU_oKAMA_FP_EPT_0303_aeb3b90a_Rx: ComBitPosition=31, ComBitSize=8, ComSignalEndianness=BIG_ENDIAN, ComSignalInitValue=255, ComSignalType=UINT8, ComHandleId=179, ComSystemTemplateSystemSignalRef=BMS_Tempoutlet
        ACC_ParkShiftReq_oADAS_ACC_oKAMA_FP_EPSChassis1_0303_b4a43305_Rx: ComBitPosition=7, ComBitSize=1, ComSignalEndianness=BIG_ENDIAN, ComSignalInitValue=0, ComSignalType=BOOLEAN, ComHandleId=7, ComSystemTemplateSystemSignalRef=ACC_ParkShiftReq
        IBS_VLCTorqueRequestValid_oIBS_VCUVLC_oKAMA_FP_EPSChassis1_0303_ed047cb9_Rx: ComBitPosition=11, ComBitSize=1, ComSignalEndianness=BIG_ENDIAN, ComSignalInitValue=0, ComSignalType=BOOLEAN, ComHandleId=337, ComSystemTemplateSystemSignalRef=IBS_VLCTorqueRequestValid
        BMS_DisplaySOC_oBMS_PackVoltage_oKAMA_FP_EPT_0303_5997374d_Rx: ComBitPosition=55, ComBitSize=16, ComSignalEndianness=BIG_ENDIAN, ComSignalInitValue=55000, ComSignalType=UINT16, ComHandleId=95, ComSystemTemplateSystemSignalRef=BMS_DisplaySOC
        IBS_TorqueIncreaseStatus_oIBS_Torque_oKAMA_FP_EPSChassis1_0303_e3a146fa_Rx: ComBitPosition=24, ComBitSize=1, ComSignalEndianness=BIG_ENDIAN, ComSignalInitValue=0, ComSignalType=BOOLEAN, ComHandleId=330, ComSystemTemplateSystemSignalRef=IBS_TorqueIncreaseStatus
        IBS_FRWheelSpeedFault_oIBS_WheelSpeed_oKAMA_FP_EPSChassis1_0303_da66a821_Rx: ComBitPosition=7, ComBitSize=1, ComSignalEndianness=BIG_ENDIAN, ComSignalInitValue=0, ComSignalType=BOOLEAN, ComHandleId=309, ComSystemTemplateSystemSignalRef=IBS_FRWheelSpeedFault
        MCU_ActualSpeedValid_oMCU_VCU_1_oKAMA_FP_EPT_0303_09eff7d8_Rx: ComBitPosition=53, ComBitSize=1, ComSignalEndianness=BIG_ENDIAN, ComSignalInitValue=0, ComSignalType=BOOLEAN, ComHandleId=344, ComSystemTemplateSystemSignalRef=MCU_ActualSpeedValid
      BMS_Temp_oKAMA_FP_EPT_0303_0559f438_Rx (ComIPdu):
        ComIPduDirection = RECEIVE
        ComIPduType = NORMAL
        ComIPduHandleId = 20
        ComIPduSignalProcessing = DEFERRED
        ComIPduCancellationSupport = false
        ComIPduGroupRef = VCU_oKAMA_FP_EPT_0303_Rx_07e8d111
        ComIPduSignalRef = BMS_AverageCellTemp_oBMS_Temp_oKAMA_FP_EPT_0303_856bba72_Rx
        ComIPduSignalRef = BMS_MaxCellTempModuleNO_oBMS_Temp_oKAMA_FP_EPT_0303_a186a73e_Rx
        ComIPduSignalRef = BMS_MaxCellTempNO_oBMS_Temp_oKAMA_FP_EPT_0303_0e589b9a_Rx
        ComIPduSignalRef = BMS_MaxCellTemp_oBMS_Temp_oKAMA_FP_EPT_0303_19e08cd0_Rx
        ComIPduSignalRef = BMS_MinCellTempModuleNO_oBMS_Temp_oKAMA_FP_EPT_0303_af722940_Rx
        ComIPduSignalRef = BMS_MinCellTempNO_oBMS_Temp_oKAMA_FP_EPT_0303_3bda8ac4_Rx
        ComIPduSignalRef = BMS_MinCellTemp_oBMS_Temp_oKAMA_FP_EPT_0303_787f543b_Rx
        ComIPduSignalRef = BMS_ThermometerProbes_oBMS_Temp_oKAMA_FP_EPT_0303_94b070d7_Rx
        ComPduIdRef = BMS_Temp_oKAMA_FP_EPT_0303_0559f438_Rx
      19 x ComSignal, all with ComTimeout=0, ComSignalAccess=ACCESS_UNCLEAR:
        Checksum_0A1_oVCU_BMS_oKAMA_FP_EPT_0303_42ed6dd7_Tx: ComBitPosition=63, ComBitSize=8, ComSignalEndianness=BIG_ENDIAN, ComSignalInitValue=0, ComSignalType=UINT8, ComTransferProperty=PENDING, ComHandleId=0, ComSystemTemplateSystemSignalRef=Checksum_0A1
        BMS_MinCellVoltageModlueNO_oBMS_CellVoltage1_oKAMA_FP_EPT_0303_39d14c38_Rx: ComBitPosition=35, ComBitSize=4, ComSignalEndianness=BIG_ENDIAN, ComSignalInitValue=0, ComSignalType=UINT8, ComHandleId=143, ComSystemTemplateSystemSignalRef=BMS_MinCellVoltageModlueNO
        MessageCounter_27A_oVCU_PwrtrainRequests_oKAMA_FP_EPSChassis1_0303_da9722ce_Tx: ComBitPosition=51, ComBitSize=4, ComSignalEndianness=BIG_ENDIAN, ComSignalInitValue=0, ComSignalType=UINT8, ComTransferProperty=PENDING, ComHandleId=14, ComSystemTemplateSystemSignalRef=MessageCounter_27A
        MCU_TempRiseCurrStr_oMCU_Temperature2_oKAMA_FP_EPT_0303_fed136d1_Rx: ComBitPosition=39, ComBitSize=8, ComSignalEndianness=BIG_ENDIAN, ComSignalInitValue=0, ComSignalType=UINT8, ComHandleId=374, ComSystemTemplateSystemSignalRef=MCU_TempRiseCurrStr
        MCU_IsCurr_oMCU_VCU_1_oKAMA_FP_EPT_0303_14da0f17_Rx: ComBitPosition=18, ComBitSize=11, ComSignalEndianness=BIG_ENDIAN, ComSignalInitValue=0, ComSignalType=UINT16, ComHandleId=364, ComSystemTemplateSystemSignalRef=MCU_IsCurr
        IBS_HHCActive_oIBS_Status2_oKAMA_FP_EPSChassis1_0303_f5cb95d5_Rx: ComBitPosition=31, ComBitSize=1, ComSignalEndianness=BIG_ENDIAN, ComSignalInitValue=0, ComSignalType=BOOLEAN, ComHandleId=313, ComSystemTemplateSystemSignalRef=IBS_HHCActive
        AEB_AWB_Level_oADAS_AEB_oKAMA_FP_EPSChassis1_0303_744820f1_Rx: ComBitPosition=28, ComBitSize=4, ComSignalEndianness=BIG_ENDIAN, ComSignalInitValue=0, ComSignalType=UINT8, ComHandleId=27, ComSystemTemplateSystemSignalRef=AEB_AWB_Level
        VCU_ActTrqValid_oVCU_MCU_7A_oKAMA_FP_EPSChassis1_0303_71c69d05_Tx: ComBitPosition=52, ComBitSize=1, ComSignalEndianness=BIG_ENDIAN, ComSignalInitValue=0, ComSignalType=BOOLEAN, ComTransferProperty=PENDING, ComHandleId=37, ComSystemTemplateSystemSignalRef=VCU_ActTrqValid
        BCM_RLHSSolarPass_oGW_BCM_oKAMA_FP_EPT_0303_ae2c6629_Rx: ComBitPosition=15, ComBitSize=8, ComSignalEndianness=BIG_ENDIAN, ComSignalInitValue=0, ComSignalType=UINT8, ComHandleId=52, ComSystemTemplateSystemSignalRef=BCM_RLHSSolarPass
        DM2_Byte3_oREPS_DM2_oKAMA_FP_EPSChassis1_0303_77a0f235_Rx: ComBitPosition=31, ComBitSize=8, ComSignalEndianness=BIG_ENDIAN, ComSignalInitValue=0, ComSignalType=UINT8, ComHandleId=237, ComSystemTemplateSystemSignalRef=DM2_Byte3
        MCU_TempCurrStr2_oMCU_Temperature2_oKAMA_FP_EPT_0303_5ec7ba52_Rx: ComBitPosition=23, ComBitSize=8, ComSignalEndianness=BIG_ENDIAN, ComSignalInitValue=255, ComSignalType=UINT8, ComHandleId=372, ComSystemTemplateSystemSignalRef=MCU_TempCurrStr2
        YRS_YawRateStatus_oYRS_1_oKAMA_FP_EPSChassis1_0303_1d2b57fe_Rx: ComBitPosition=20, ComBitSize=4, ComSignalEndianness=LITTLE_ENDIAN, ComSignalInitValue=0, ComSignalType=UINT8, ComHandleId=521, ComSystemTemplateSystemSignalRef=YRS_YawRateStatus
        TCU_HVCHState_oTCU_Status_oKAMA_FP_EPT_0303_e67d87f8_Rx: ComBitPosition=55, ComBitSize=2, ComSignalEndianness=BIG_ENDIAN, ComSignalInitValue=0, ComSignalType=UINT8, ComHandleId=502, ComSystemTemplateSystemSignalRef=TCU_HVCHState
        VCU_KL15On_oVCU_MCU01_oKAMA_FP_EPT_0303_a64e5491_Tx: ComBitPosition=8, ComBitSize=1, ComSignalEndianness=BIG_ENDIAN, ComSignalInitValue=0, ComSignalType=BOOLEAN, ComTransferProperty=PENDING, ComHandleId=81, ComSystemTemplateSystemSignalRef=VCU_KL15On
        POD_DCInletTempB_oPOD_VCU_Status_01_oKAMA_FP_EPT_0303_8acfaf27_Rx: ComBitPosition=47, ComBitSize=8, ComSignalEndianness=BIG_ENDIAN, ComSignalInitValue=255, ComSignalType=UINT8, ComHandleId=481, ComSystemTemplateSystemSignalRef=POD_DCInletTempB
        VCU_IsCurr_oVCU_MCU_7A_oKAMA_FP_EPSChassis1_0303_8e51bd32_Tx: ComBitPosition=18, ComBitSize=11, ComSignalEndianness=BIG_ENDIAN, ComSignalInitValue=0, ComSignalType=UINT16, ComTransferProperty=PENDING, ComHandleId=79, ComSystemTemplateSystemSignalRef=VCU_IsCurr
        Uds_EPT_bootResponse_Byte2_oUds_EPT_Boot_Response_oKAMA_FP_EPT_0303_812edaeb_Tx: ComBitPosition=16, ComBitSize=8, ComSignalEndianness=LITTLE_ENDIAN, ComSignalInitValue=0, ComSignalType=UINT8, ComTransferProperty=TRIGGERED_WITHOUT_REPETITION, ComHandleId=27, ComSystemTemplateSystemSignalRef=Uds_EPT_bootResponse_Byte2
        OBC_InputACCurrent_oOBC_VCU_STATUS1_oKAMA_FP_EPT_0303_afc76503_Rx: ComBitPosition=7, ComBitSize=13, ComSignalEndianness=BIG_ENDIAN, ComSignalInitValue=0, ComSignalType=UINT16, ComHandleId=453, ComSystemTemplateSystemSignalRef=OBC_InputACCurrent
        VCU_OBC_Control_of_S2_SW_oVCU_OBC_oKAMA_FP_EPT_0303_a9c3a188_Tx: ComBitPosition=7, ComBitSize=1, ComSignalEndianness=BIG_ENDIAN, ComSignalInitValue=0, ComSignalType=BOOLEAN, ComTransferProperty=PENDING, ComHandleId=95, ComSystemTemplateSystemSignalRef=VCU_OBC_Control_of_S2_SW
      BMS_TCU_oKAMA_FP_EPT_0303_50945f58_Rx (ComIPdu):
        ComIPduDirection = RECEIVE
        ComIPduType = NORMAL
        ComIPduHandleId = 19
        ComIPduSignalProcessing = DEFERRED
        ComIPduCancellationSupport = false
        ComIPduGroupRef = VCU_oKAMA_FP_EPT_0303_Rx_07e8d111
        ComIPduSignalRef = BMS_AllowCellTemperature_oBMS_TCU_oKAMA_FP_EPT_0303_a598b691_Rx
        ComIPduSignalRef = BMS_BalanceCommand_oBMS_TCU_oKAMA_FP_EPT_0303_857ed85f_Rx
        ComIPduSignalRef = BMS_CoolCommand_oBMS_TCU_oKAMA_FP_EPT_0303_c9d4657f_Rx
        ComIPduSignalRef = BMS_FlowRate_oBMS_TCU_oKAMA_FP_EPT_0303_f631a605_Rx
        ComIPduSignalRef = BMS_HeatCommand_oBMS_TCU_oKAMA_FP_EPT_0303_09b5b913_Rx
        ComIPduSignalRef = BMS_TargetBatteryMaxCellTemp_oBMS_TCU_oKAMA_FP_EPT_0303_362d8ea4_Rx
        ComIPduSignalRef = BMS_TempInlet_oBMS_TCU_oKAMA_FP_EPT_0303_07b2a4fc_Rx
        ComIPduSignalRef = BMS_Tempoutlet_oBMS_TCU_oKAMA_FP_EPT_0303_aeb3b90a_Rx
        ComIPduSignalRef = Checksum_5_oBMS_TCU_oKAMA_FP_EPT_0303_f406a118_Rx
        ComIPduSignalRef = MessageCounter_5_oBMS_TCU_oKAMA_FP_EPT_0303_c3903e71_Rx
        ComPduIdRef = BMS_TCU_oKAMA_FP_EPT_0303_50945f58_Rx
      11 x ComSignal, all with ComSignalEndianness=BIG_ENDIAN, ComTimeout=0, ComSignalAccess=ACCESS_UNCLEAR:
        DCDC_OutputSOGFault_oDCDC_VCU_02_oKAMA_FP_EPT_0303_29b74325_Rx: ComBitPosition=0, ComBitSize=1, ComSignalInitValue=0, ComSignalType=BOOLEAN, ComHandleId=217, ComSystemTemplateSystemSignalRef=DCDC_OutputSOGFault
        IBS_EPBFailureLamp_oIBS_Status2_oKAMA_FP_EPSChassis1_0303_e214c490_Rx: ComBitPosition=7, ComBitSize=2, ComSignalInitValue=0, ComSignalType=UINT8, ComHandleId=292, ComSystemTemplateSystemSignalRef=IBS_EPBFailureLamp
        IBS_RBSSTATUS_oIBS_Torque_oKAMA_FP_EPSChassis1_0303_1ebb9465_Rx: ComBitPosition=53, ComBitSize=1, ComSignalInitValue=0, ComSignalType=BOOLEAN, ComHandleId=318, ComSystemTemplateSystemSignalRef=IBS_RBSSTATUS
        OBC_PrimarySideOvertempStatus_oOBC_Error_STATUS_oKAMA_FP_EPT_0303_f04f7975_Rx: ComBitPosition=29, ComBitSize=1, ComSignalInitValue=0, ComSignalType=BOOLEAN, ComHandleId=467, ComSystemTemplateSystemSignalRef=OBC_PrimarySideOvertempStatus
        PWT_ErrorLevel_oVCU_Fault_01_oKAMA_FP_EPT_0303_1b57c33e_Tx: ComBitPosition=15, ComBitSize=4, ComSignalInitValue=0, ComSignalType=UINT8, ComTransferProperty=PENDING, ComHandleId=24, ComSystemTemplateSystemSignalRef=PWT_ErrorLevel
        BMS_StateRelay4_oBMS_DIRelayState_oKAMA_FP_EPT_0303_78849980_Rx: ComBitPosition=15, ComBitSize=2, ComSignalInitValue=0, ComSignalType=UINT8, ComHandleId=169, ComSystemTemplateSystemSignalRef=BMS_StateRelay4
        MCU_TempStatus_oMCU_Temperature2_oKAMA_FP_EPT_0303_499e911f_Rx: ComBitPosition=47, ComBitSize=2, ComSignalInitValue=0, ComSignalType=UINT8, ComHandleId=375, ComSystemTemplateSystemSignalRef=MCU_TempStatus
        MCU_VCUWorkMode_oMCU_Status_oKAMA_FP_EPT_0303_b5f7222e_Rx: ComBitPosition=59, ComBitSize=4, ComSignalInitValue=0, ComSignalType=UINT8, ComHandleId=380, ComSystemTemplateSystemSignalRef=MCU_VCUWorkMode
        VCU_MCUSurgeDamperState_oVCU_MCU01_oKAMA_FP_EPT_0303_3c180ef9_Tx: ComBitPosition=10, ComBitSize=2, ComSignalInitValue=0, ComSignalType=UINT8, ComTransferProperty=PENDING, ComHandleId=87, ComSystemTemplateSystemSignalRef=VCU_MCUSurgeDamperState
        Checksum_1A3_oADAS_APA_oKAMA_FP_EPSChassis1_0303_59ee0a93_Rx: ComBitPosition=63, ComBitSize=8, ComSignalInitValue=0, ComSignalType=UINT8, ComHandleId=185, ComSystemTemplateSystemSignalRef=Checksum_1A3
        MCU_IGBTTempRiseV_oMCU_Temperature1_oKAMA_FP_EPT_0303_3d0910be_Rx: ComBitPosition=47, ComBitSize=8, ComSignalInitValue=255, ComSignalType=UINT8, ComHandleId=359, ComSystemTemplateSystemSignalRef=MCU_IGBTTempRiseV
      ADAS_APA_oKAMA_FP_EPSChassis1_0303_63894043_Rx (ComIPdu):
        ComIPduDirection = RECEIVE
        ComIPduType = NORMAL
        ComIPduHandleId = 2
        ComIPduSignalProcessing = DEFERRED
        ComIPduCancellationSupport = false
        ComIPduGroupRef = VCU_oKAMA_FP_EPSChassis1_0303_Rx_00807295
        ComIPduSignalRef = APA_APAMode_oADAS_APA_oKAMA_FP_EPSChassis1_0303_719098d0_Rx
        ComIPduSignalRef = APA_GearShiftReq_oADAS_APA_oKAMA_FP_EPSChassis1_0303_072f4f7b_Rx
        ComIPduSignalRef = APA_SpeedLimit_oADAS_APA_oKAMA_FP_EPSChassis1_0303_cd13b2ad_Rx
        ComIPduSignalRef = APA_StopDistance_oADAS_APA_oKAMA_FP_EPSChassis1_0303_e76c8e46_Rx
        ComIPduSignalRef = Checksum_1A3_oADAS_APA_oKAMA_FP_EPSChassis1_0303_59ee0a93_Rx
        ComIPduSignalRef = MessageCounter_1A3_oADAS_APA_oKAMA_FP_EPSChassis1_0303_7450109a_Rx
        ComPduIdRef = ADAS_APA_oKAMA_FP_EPSChassis1_0303_63894043_Rx
      6 x ComSignal, all with ComSignalEndianness=BIG_ENDIAN, ComSignalInitValue=0, ComTimeout=0, ComSignalAccess=ACCESS_UNCLEAR:
        MessageCounter_5B_oIBS_Status2_oKAMA_FP_EPSChassis1_0303_6b3632e1_Rx: ComBitPosition=51, ComBitSize=4, ComSignalType=UINT8, ComHandleId=411, ComSystemTemplateSystemSignalRef=MessageCounter_5B
        IBS_VDCActive_oIBS_Status2_oKAMA_FP_EPSChassis1_0303_a0d22281_Rx: ComBitPosition=25, ComBitSize=1, ComSignalType=BOOLEAN, ComHandleId=335, ComSystemTemplateSystemSignalRef=IBS_VDCActive
        VCU_FrMotorSpd_oVCU_HMIsignals_oKAMA_FP_EPSChassis1_0303_41b87c84_Tx: ComBitPosition=31, ComBitSize=8, ComSignalType=UINT8, ComTransferProperty=PENDING, ComHandleId=66, ComSystemTemplateSystemSignalRef=VCU_FrMotorSpd
        BMS_ThermometerProbes_oBMS_Temp_oKAMA_FP_EPT_0303_94b070d7_Rx: ComBitPosition=7, ComBitSize=8, ComSignalType=UINT8, ComHandleId=181, ComSystemTemplateSystemSignalRef=BMS_ThermometerProbes
        IBS_ESCLateralAccle_oIBS1_acceleration_oKAMA_FP_EPSChassis1_0303_36c377fc_Rx: ComBitPosition=23, ComBitSize=16, ComSignalType=UINT16, ComHandleId=298, ComSystemTemplateSystemSignalRef=IBS_ESCLateralAccle
        OBC_OutputShortError_oOBC_Error_STATUS_oKAMA_FP_EPT_0303_4bf227d4_Rx: ComBitPosition=16, ComBitSize=1, ComSignalType=BOOLEAN, ComHandleId=464, ComSystemTemplateSystemSignalRef=OBC_OutputShortError
      DCDC_VCU_01_oKAMA_FP_EPT_0303_a6207f52_Rx (ComIPdu):
        ComIPduDirection = RECEIVE
        ComIPduType = NORMAL
        ComIPduHandleId = 23
        ComIPduSignalProcessing = DEFERRED
        ComIPduCancellationSupport = false
        ComIPduGroupRef = VCU_oKAMA_FP_EPT_0303_Rx_07e8d111
        ComIPduSignalRef = Checksum_375_oDCDC_VCU_01_oKAMA_FP_EPT_0303_2aaad358_Rx
        ComIPduSignalRef = DCDC_HVInputCurrent_oDCDC_VCU_01_oKAMA_FP_EPT_0303_2fb84430_Rx
        ComIPduSignalRef = DCDC_HVInputVoltage_oDCDC_VCU_01_oKAMA_FP_EPT_0303_98520e04_Rx
        ComIPduSignalRef = DCDC_LVOutputCurrent_oDCDC_VCU_01_oKAMA_FP_EPT_0303_fc484678_Rx
        ComIPduSignalRef = DCDC_LVOutputVoltage_oDCDC_VCU_01_oKAMA_FP_EPT_0303_4ba20c4c_Rx
        ComIPduSignalRef = DCDC_WorkMode_oDCDC_VCU_01_oKAMA_FP_EPT_0303_6085f628_Rx
        ComIPduSignalRef = MessageCounter_375_oDCDC_VCU_01_oKAMA_FP_EPT_0303_ef087066_Rx
        ComPduIdRef = DCDC_VCU_01_oKAMA_FP_EPT_0303_a6207f52_Rx
      16 x ComSignal, all with ComTimeout=0, ComSignalAccess=ACCESS_UNCLEAR:
        ADAS_SteeringAngleReq_oADAS_CCU1_Ctrl_oKAMA_FP_EPSChassis1_0303_843b362b_Rx: ComBitPosition=7, ComBitSize=16, ComSignalEndianness=BIG_ENDIAN, ComSignalInitValue=7380, ComSignalType=UINT16, ComHandleId=21, ComSystemTemplateSystemSignalRef=ADAS_SteeringAngleReq
        AEB_TargetDecel_ReqValue_oADAS_AEB_oKAMA_FP_EPSChassis1_0303_54ec0fd5_Rx: ComBitPosition=15, ComBitSize=16, ComSignalEndianness=BIG_ENDIAN, ComSignalInitValue=0, ComSignalType=UINT16, ComHandleId=30, ComSystemTemplateSystemSignalRef=AEB_TargetDecel_ReqValue
        IBS_ECDActive_oIBS_Status2_oKAMA_FP_EPSChassis1_0303_eaef2465_Rx: ComBitPosition=30, ComBitSize=1, ComSignalEndianness=BIG_ENDIAN, ComSignalInitValue=0, ComSignalType=BOOLEAN, ComHandleId=291, ComSystemTemplateSystemSignalRef=IBS_ECDActive
        BMS_TargetBatteryMaxCellTemp_oBMS_TCU_oKAMA_FP_EPT_0303_362d8ea4_Rx: ComBitPosition=15, ComBitSize=8, ComSignalEndianness=BIG_ENDIAN, ComSignalInitValue=255, ComSignalType=UINT8, ComHandleId=177, ComSystemTemplateSystemSignalRef=BMS_TargetBatteryMaxCellTemp
        MCU_CAN_Fault_oMCU_FailureCode_oKAMA_FP_EPT_0303_4bbac187_Rx: ComBitPosition=63, ComBitSize=8, ComSignalEndianness=BIG_ENDIAN, ComSignalInitValue=0, ComSignalType=UINT8, ComHandleId=347, ComSystemTemplateSystemSignalRef=MCU_CAN_Fault
        BMS_BatChagSum_oBMS_ChargeEnergy_oKAMA_FP_EPT_0303_c61693b2_Rx: ComBitPosition=39, ComBitSize=16, ComSignalEndianness=BIG_ENDIAN, ComSignalInitValue=0, ComSignalType=UINT16, ComHandleId=68, ComSystemTemplateSystemSignalRef=BMS_BatChagSum
        TCU_HVCHHighVoltage_oTCU_Status_oKAMA_FP_EPT_0303_7a9c07d4_Rx: ComBitPosition=15, ComBitSize=8, ComSignalEndianness=BIG_ENDIAN, ComSignalInitValue=0, ComSignalType=UINT8, ComHandleId=501, ComSystemTemplateSystemSignalRef=TCU_HVCHHighVoltage
        Uds_EPT_bootResponse_Byte5_oUds_EPT_Boot_Response_oKAMA_FP_EPT_0303_506048e3_Tx: ComBitPosition=40, ComBitSize=8, ComSignalEndianness=LITTLE_ENDIAN, ComSignalInitValue=0, ComSignalType=UINT8, ComTransferProperty=TRIGGERED_WITHOUT_REPETITION, ComHandleId=30, ComSystemTemplateSystemSignalRef=Uds_EPT_bootResponse_Byte5
        BMS_ChargeStatus_oBMS_status_oKAMA_FP_EPT_0303_65537a1e_Rx: ComBitPosition=11, ComBitSize=4, ComSignalEndianness=BIG_ENDIAN, ComSignalInitValue=0, ComSignalType=UINT8, ComHandleId=88, ComSystemTemplateSystemSignalRef=BMS_ChargeStatus
        VCU_TargetGear_oVCU_AccPedal_oKAMA_FP_EPSChassis1_0303_cceff6cd_Tx: ComBitPosition=31, ComBitSize=3, ComSignalEndianness=BIG_ENDIAN, ComSignalInitValue=0, ComSignalType=UINT8, ComTransferProperty=PENDING, ComHandleId=111, ComSystemTemplateSystemSignalRef=VCU_TargetGear
        VCU_MinTorqueLimit_oVCU_MCU02_oKAMA_FP_EPT_0303_3137fd7d_Tx: ComBitPosition=7, ComBitSize=11, ComSignalEndianness=BIG_ENDIAN, ComSignalInitValue=1023, ComSignalType=UINT16, ComTransferProperty=PENDING, ComHandleId=90, ComSystemTemplateSystemSignalRef=VCU_MinTorqueLimit
        VCU_ActualSpeed_oVCU_MCU_7A_oKAMA_FP_EPSChassis1_0303_6bd50567_Tx: ComBitPosition=39, ComBitSize=16, ComSignalEndianness=BIG_ENDIAN, ComSignalInitValue=32768, ComSignalType=UINT16, ComTransferProperty=PENDING, ComHandleId=42, ComSystemTemplateSystemSignalRef=VCU_ActualSpeed
        BMS_MinCellTempModuleNO_oBMS_Temp_oKAMA_FP_EPT_0303_af722940_Rx: ComBitPosition=47, ComBitSize=8, ComSignalEndianness=BIG_ENDIAN, ComSignalInitValue=0, ComSignalType=UINT8, ComHandleId=140, ComSystemTemplateSystemSignalRef=BMS_MinCellTempModuleNO
        ADAS_State_oADAS_CCU1_Ctrl_oKAMA_FP_EPSChassis1_0303_1cc17bb6_Rx: ComBitPosition=19, ComBitSize=1, ComSignalEndianness=BIG_ENDIAN, ComSignalInitValue=0, ComSignalType=BOOLEAN, ComHandleId=19, ComSystemTemplateSystemSignalRef=ADAS_State
        OBC_CommunFault_oOBC_Error_STATUS_oKAMA_FP_EPT_0303_533fe865_Rx: ComBitPosition=14, ComBitSize=1, ComSignalEndianness=BIG_ENDIAN, ComSignalInitValue=0, ComSignalType=BOOLEAN, ComHandleId=446, ComSystemTemplateSystemSignalRef=OBC_CommunFault
        BMS_MaxCellVoltageModuleNO_oBMS_CellVoltage1_oKAMA_FP_EPT_0303_0d97a828_Rx: ComBitPosition=39, ComBitSize=4, ComSignalEndianness=BIG_ENDIAN, ComSignalInitValue=0, ComSignalType=UINT8, ComHandleId=136, ComSystemTemplateSystemSignalRef=BMS_MaxCellVoltageModuleNO
      Uds_EPT_Boot_Request_oKAMA_FP_EPT_0303_8243a077_Rx (ComIPdu):
        ComIPduDirection = RECEIVE
        ComIPduType = NORMAL
        ComIPduHandleId = 64
        ComIPduSignalProcessing = DEFERRED
        ComIPduCancellationSupport = false
        ComIPduGroupRef = VCU_oKAMA_FP_EPT_0303_Rx_07e8d111
        ComIPduSignalRef = UDS_EPT_BootCmd1_oUds_EPT_Boot_Request_oKAMA_FP_EPT_0303_d87cfbd7_Rx
        ComIPduSignalRef = UDS_EPT_BootCmd2_oUds_EPT_Boot_Request_oKAMA_FP_EPT_0303_3b354c75_Rx
        ComIPduSignalRef = UDS_EPT_BootCmd3_oUds_EPT_Boot_Request_oKAMA_FP_EPT_0303_d322dcd4_Rx
        ComPduIdRef = Uds_EPT_Boot_Request_oKAMA_FP_EPT_0303_8243a077_Rx
      ACU_DrvSeatbeltBucklestatus_oDonorCar_ACM_Status_oKAMA_FP_EPSChassis1_0303_31dc3457_Rx (ComSignal):
        ComBitPosition = 0
        ComBitSize = 1
        ComSignalEndianness = BIG_ENDIAN
        ComSignalInitValue = 0
        ComSignalType = BOOLEAN
        ComTimeout = 0
        ComSignalAccess = ACCESS_UNCLEAR
        ComHandleId = 9
        ComSystemTemplateSystemSignalRef = ACU_DrvSeatbeltBucklestatus
      VCU_PtCrashStatus_oVCU_PwrtrainRequests_oKAMA_FP_EPSChassis1_0303_75848149_Tx (ComSignal):
        ComBitPosition = 1
        ComBitSize = 2
        ComSignalEndianness = BIG_ENDIAN
        ComSignalInitValue = 0
        ComSignalType = UINT8
        ComTimeout = 0
        ComTransferProperty = PENDING
        ComSignalAccess = ACCESS_UNCLEAR
        ComHandleId = 99
        ComSystemTemplateSystemSignalRef = VCU_PtCrashStatus
      POD_VCU_Status_02_oKAMA_FP_EPT_0303_90198af4_Rx (ComIPdu):
        ComIPduDirection = RECEIVE
        ComIPduType = NORMAL
        ComIPduHandleId = 56
        ComIPduSignalProcessing = DEFERRED
        ComIPduCancellationSupport = false
        ComIPduGroupRef = VCU_oKAMA_FP_EPT_0303_Rx_07e8d111
        ComIPduSignalRef = POD_DCNegRelayState_oPOD_VCU_Status_02_oKAMA_FP_EPT_0303_ee2b9564_Rx
        ComIPduSignalRef = POD_DCPortInletTempAValid_oPOD_VCU_Status_02_oKAMA_FP_EPT_0303_72f6dbe5_Rx
        ComIPduSignalRef = POD_DCPortInletTempBValid_oPOD_VCU_Status_02_oKAMA_FP_EPT_0303_bbc2c0e8_Rx
        ComIPduSignalRef = POD_DCPosRelayState_oPOD_VCU_Status_02_oKAMA_FP_EPT_0303_6bf0e2d8_Rx
        ComIPduSignalRef = POD_TempSensor1Fault_oPOD_VCU_Status_02_oKAMA_FP_EPT_0303_750225ed_Rx
        ComPduIdRef = POD_VCU_Status_02_oKAMA_FP_EPT_0303_90198af4_Rx
      5 x ComSignal, all with ComSignalInitValue=0, ComTimeout=0, ComSignalAccess=ACCESS_UNCLEAR:
        DM2_Byte5_oREPS_DM2_oKAMA_FP_EPSChassis1_0303_c3628cf5_Rx: ComBitPosition=47, ComBitSize=8, ComSignalEndianness=BIG_ENDIAN, ComSignalType=UINT8, ComHandleId=239, ComSystemTemplateSystemSignalRef=DM2_Byte5
        MCU_Hardware_Fault_oMCU_FailureCode_oKAMA_FP_EPT_0303_1518a0bd_Rx: ComBitPosition=39, ComBitSize=16, ComSignalEndianness=BIG_ENDIAN, ComSignalType=UINT16, ComHandleId=353, ComSystemTemplateSystemSignalRef=MCU_Hardware_Fault
        VCU_EPBAppliedReq_oVCU_AccPedal_oKAMA_FP_EPSChassis1_0303_5a51a017_Tx: ComBitPosition=28, ComBitSize=1, ComSignalEndianness=BIG_ENDIAN, ComSignalType=BOOLEAN, ComTransferProperty=PENDING, ComHandleId=61, ComSystemTemplateSystemSignalRef=VCU_EPBAppliedReq
        YRS_ZeroCalibrationResult_oYRS_7_oKAMA_FP_EPSChassis1_0303_ccc109a5_Rx: ComBitPosition=24, ComBitSize=2, ComSignalEndianness=LITTLE_ENDIAN, ComSignalType=UINT8, ComHandleId=523, ComSystemTemplateSystemSignalRef=YRS_ZeroCalibrationResult
        PEPS_PowerMode_oDonorCar_PEPS_Message_Sts_oKAMA_FP_EPSChassis1_0303_a177fbf2_Rx: ComBitPosition=4, ComBitSize=3, ComSignalEndianness=BIG_ENDIAN, ComSignalType=UINT8, ComHandleId=477, ComSystemTemplateSystemSignalRef=PEPS_PowerMode
      VCU_PwrtrainRequests_oKAMA_FP_EPSChassis1_0303_51346ff9_Tx (ComIPdu):
        ComIPduDirection = SEND
        ComIPduType = NORMAL
        ComIPduHandleId = 17
        ComIPduSignalProcessing = DEFERRED
        ComIPduCancellationSupport = false
        ComIPduGroupRef = VCU_oKAMA_FP_EPSChassis1_0303_Tx_56dad513
        ComIPduSignalRef = Checksum_27A_oVCU_PwrtrainRequests_oKAMA_FP_EPSChassis1_0303_e8e65a6e_Tx
        ComIPduSignalRef = MessageCounter_27A_oVCU_PwrtrainRequests_oKAMA_FP_EPSChassis1_0303_da9722ce_Tx
        ComIPduSignalRef = VCU_ActDriverMode_oVCU_PwrtrainRequests_oKAMA_FP_EPSChassis1_0303_f53b302a_Tx
        ComIPduSignalRef = VCU_ActiveEnergyProfile_oVCU_PwrtrainRequests_oKAMA_FP_EPSChassis1_0303_0adc2a54_Tx
        ComIPduSignalRef = VCU_ActiveRgnBrkProfile_oVCU_PwrtrainRequests_oKAMA_FP_EPSChassis1_0303_f75f5f47_Tx
        ComIPduSignalRef = VCU_CruiseControlStatus_oVCU_PwrtrainRequests_oKAMA_FP_EPSChassis1_0303_0b961c4e_Tx
        ComIPduSignalRef = VCU_DrvModSwitchWarn_oVCU_PwrtrainRequests_oKAMA_FP_EPSChassis1_0303_8683b86c_Tx
        ComIPduSignalRef = VCU_NeutralLockExitReason_oVCU_PwrtrainRequests_oKAMA_FP_EPSChassis1_0303_9d0551c7_Tx
        ComIPduSignalRef = VCU_NeutralLockStatus_oVCU_PwrtrainRequests_oKAMA_FP_EPSChassis1_0303_7d881b5a_Tx
        ComIPduSignalRef = VCU_PtCrashStatus_oVCU_PwrtrainRequests_oKAMA_FP_EPSChassis1_0303_75848149_Tx
        ComIPduSignalRef = VCU_RegenBrakeLightRequest_oVCU_PwrtrainRequests_oKAMA_FP_EPSChassis1_0303_3d171558_Tx
        ComIPduSignalRef = VCU_cruiseControlSetUnit_oVCU_PwrtrainRequests_oKAMA_FP_EPSChassis1_0303_660a3a8a_Tx
        ComIPduSignalRef = VCU_regenBrakeLightReqVld_oVCU_PwrtrainRequests_oKAMA_FP_EPSChassis1_0303_16471c1d_Tx
        ComPduIdRef = VCU_PwrtrainRequests_oKAMA_FP_EPSChassis1_0303_51346ff9_Tx
        ComTxIPdu: ComMinimumDelayTime=0, ComTxIPduUnusedAreasDefault=0
          ComTxModeTrue
            ComTxMode: ComTxModeMode=PERIODIC, ComTxModeTimeOffset=0, ComTxModeTimePeriod=0.1
          ComTxModeFalse
            ComTxMode: ComTxModeMode=PERIODIC, ComTxModeTimeOffset=0, ComTxModeTimePeriod=0.1
      DonorCar_MMI_AC_Command_oKAMA_FP_EPT_0303_2af1d020_Rx (ComIPdu):
        ComIPduDirection = RECEIVE
        ComIPduType = NORMAL
        ComIPduHandleId = 28
        ComIPduSignalProcessing = DEFERRED
        ComIPduCancellationSupport = false
        ComIPduGroupRef = VCU_oKAMA_FP_EPT_0303_Rx_07e8d111
        ComIPduSignalRef = MMI_AC_OnKey_oDonorCar_MMI_AC_Command_oKAMA_FP_EPT_0303_08ae30b7_Rx
        ComIPduSignalRef = MMI_AcKey_oDonorCar_MMI_AC_Command_oKAMA_FP_EPT_0303_1ee47db8_Rx
        ComIPduSignalRef = MMI_AirConditionerPowerKey_oDonorCar_MMI_AC_Command_oKAMA_FP_EPT_0303_e5830600_Rx
        ComIPduSignalRef = MMI_AirDistributionModeReq_oDonorCar_MMI_AC_Command_oKAMA_FP_EPT_0303_85b76135_Rx
        ComIPduSignalRef = MMI_BlowerFanLevel_oDonorCar_MMI_AC_Command_oKAMA_FP_EPT_0303_c2d9f8f9_Rx
        ComIPduSignalRef = MMI_FreshReciKey_oDonorCar_MMI_AC_Command_oKAMA_FP_EPT_0303_151b1ef4_Rx
        ComIPduSignalRef = MMI_FrontDefrostKey_oDonorCar_MMI_AC_Command_oKAMA_FP_EPT_0303_2415312c_Rx
        ComIPduSignalRef = MMI_LeftSetTemp_oDonorCar_MMI_AC_Command_oKAMA_FP_EPT_0303_0867569c_Rx
        ComIPduSignalRef = MMI_MaxAcKey_oDonorCar_MMI_AC_Command_oKAMA_FP_EPT_0303_5f47228e_Rx
        ComPduIdRef = DonorCar_MMI_AC_Command_oKAMA_FP_EPT_0303_2af1d020_Rx
      6 x ComSignal, all with ComSignalInitValue=0, ComTimeout=0, ComSignalAccess=ACCESS_UNCLEAR:
        MessageCounter_7A_oVCU_MCU_7A_oKAMA_FP_EPSChassis1_0303_03dd8fd5_Tx: ComBitPosition=51, ComBitSize=4, ComSignalEndianness=BIG_ENDIAN, ComSignalType=UINT8, ComTransferProperty=PENDING, ComHandleId=13, ComSystemTemplateSystemSignalRef=MessageCounter_7A
        VCU_AVHActivereq_oVCU_AccPedal_oKAMA_FP_EPSChassis1_0303_743caa0d_Tx: ComBitPosition=47, ComBitSize=1, ComSignalEndianness=BIG_ENDIAN, ComSignalType=BOOLEAN, ComTransferProperty=PENDING, ComHandleId=33, ComSystemTemplateSystemSignalRef=VCU_AVHActivereq
        YRS_AyRateFailure_oYRS_7_oKAMA_FP_EPSChassis1_0303_c027752f_Rx: ComBitPosition=9, ComBitSize=1, ComSignalEndianness=LITTLE_ENDIAN, ComSignalType=BOOLEAN, ComHandleId=515, ComSystemTemplateSystemSignalRef=YRS_AyRateFailure
        BMS_StateDI5_oBMS_DIRelayState_oKAMA_FP_EPT_0303_384a8ee0_Rx: ComBitPosition=31, ComBitSize=2, ComSignalEndianness=BIG_ENDIAN, ComSignalType=UINT8, ComHandleId=165, ComSystemTemplateSystemSignalRef=BMS_StateDI5
        BMS_ErrorBattOverVolt_oBMS_ErrorInfo1_oKAMA_FP_EPT_0303_ce66d81a_Rx: ComBitPosition=15, ComBitSize=2, ComSignalEndianness=BIG_ENDIAN, ComSignalType=UINT8, ComHandleId=99, ComSystemTemplateSystemSignalRef=BMS_ErrorBattOverVolt
        BMS_ErrorCellUnderVolt_oBMS_ErrorInfo1_oKAMA_FP_EPT_0303_c8f85a95_Rx: ComBitPosition=5, ComBitSize=2, ComSignalEndianness=BIG_ENDIAN, ComSignalType=UINT8, ComHandleId=106, ComSystemTemplateSystemSignalRef=BMS_ErrorCellUnderVolt
      MCU_Status_oKAMA_FP_EPT_0303_f59e16e7_Rx (ComIPdu):
        ComIPduDirection = RECEIVE
        ComIPduType = NORMAL
        ComIPduHandleId = 47
        ComIPduSignalProcessing = DEFERRED
        ComIPduCancellationSupport = false
        ComIPduGroupRef = VCU_oKAMA_FP_EPT_0303_Rx_07e8d111
        ComIPduSignalRef = MCU_DmpCTrqCurr_oMCU_Status_oKAMA_FP_EPT_0303_5055b05e_Rx
        ComIPduSignalRef = MCU_Isd_oMCU_Status_oKAMA_FP_EPT_0303_30343673_Rx
        ComIPduSignalRef = MCU_Isq_oMCU_Status_oKAMA_FP_EPT_0303_eb32f0f6_Rx
        ComIPduSignalRef = MCU_OfsAl_oMCU_Status_oKAMA_FP_EPT_0303_bb17883f_Rx
        ComIPduSignalRef = MCU_VCUWorkMode_oMCU_Status_oKAMA_FP_EPT_0303_b5f7222e_Rx
        ComIPduSignalRef = MCU_bDmpCActv_oMCU_Status_oKAMA_FP_EPT_0303_fc5ef79c_Rx
        ComIPduSignalRef = MCU_stGateDrv_oMCU_Status_oKAMA_FP_EPT_0303_99eef85c_Rx
        ComPduIdRef = MCU_Status_oKAMA_FP_EPT_0303_f59e16e7_Rx
      4 x ComSignal, all with ComSignalEndianness=BIG_ENDIAN, ComSignalInitValue=0, ComTimeout=0, ComSignalAccess=ACCESS_UNCLEAR:
        BMS_ComVersion_oBMS_VersionInfor_oKAMA_FP_EPT_0303_63e41227_Rx: ComBitPosition=39, ComBitSize=16, ComSignalType=UINT16, ComHandleId=90, ComSystemTemplateSystemSignalRef=BMS_ComVersion
        EVCOM_StandByOverVolError_oEVCOM_State_oKAMA_FP_EPT_0303_a407716c_Rx: ComBitPosition=4, ComBitSize=1, ComSignalType=BOOLEAN, ComHandleId=274, ComSystemTemplateSystemSignalRef=EVCOM_StandByOverVolError
        MMI_FrontDefrostKey_oDonorCar_MMI_AC_Command_oKAMA_FP_EPT_0303_2415312c_Rx: ComBitPosition=3, ComBitSize=1, ComSignalType=BOOLEAN, ComHandleId=402, ComSystemTemplateSystemSignalRef=MMI_FrontDefrostKey
        BMS_DTC_oBMS_ErrorInfo1_oKAMA_FP_EPT_0303_3e05902d_Rx: ComBitPosition=55, ComBitSize=8, ComSignalType=UINT8, ComHandleId=93, ComSystemTemplateSystemSignalRef=BMS_DTC
      OBC_Error_STATUS_oKAMA_FP_EPT_0303_fe50628e_Rx (ComIPdu):
        ComIPduDirection = RECEIVE
        ComIPduType = NORMAL
        ComIPduHandleId = 51
        ComIPduSignalProcessing = DEFERRED
        ComIPduCancellationSupport = false
        ComIPduGroupRef = VCU_oKAMA_FP_EPT_0303_Rx_07e8d111
        ComIPduSignalRef = OBC_ACPortTempASensValid_oOBC_Error_STATUS_oKAMA_FP_EPT_0303_c1c6e070_Rx
        ComIPduSignalRef = OBC_ACPortTempAerror_oOBC_Error_STATUS_oKAMA_FP_EPT_0303_abb9c641_Rx
        ComIPduSignalRef = OBC_ACPortTempBSensValid_oOBC_Error_STATUS_oKAMA_FP_EPT_0303_419c4cc5_Rx
        ComIPduSignalRef = OBC_ACPortTempBerror_oOBC_Error_STATUS_oKAMA_FP_EPT_0303_93824d32_Rx
        ComIPduSignalRef = OBC_ACVoltHighFault_oOBC_Error_STATUS_oKAMA_FP_EPT_0303_b3ecad4f_Rx
        ComIPduSignalRef = OBC_ACVoltLowFault_oOBC_Error_STATUS_oKAMA_FP_EPT_0303_6eb87a6f_Rx
        ComIPduSignalRef = OBC_ComFault1_oOBC_Error_STATUS_oKAMA_FP_EPT_0303_4657bd7f_Rx
        ComIPduSignalRef = OBC_ComFault2_oOBC_Error_STATUS_oKAMA_FP_EPT_0303_1c36821f_Rx
        ComIPduSignalRef = OBC_CommunFault_oOBC_Error_STATUS_oKAMA_FP_EPT_0303_533fe865_Rx
        ComIPduSignalRef = OBC_DCCurHighFault_oOBC_Error_STATUS_oKAMA_FP_EPT_0303_d1d1fc26_Rx
        ComIPduSignalRef = OBC_DCVoltHighFault_oOBC_Error_STATUS_oKAMA_FP_EPT_0303_e7cb9c12_Rx
        ComIPduSignalRef = OBC_DCVoltLowFault_oOBC_Error_STATUS_oKAMA_FP_EPT_0303_97de0e99_Rx
        ComIPduSignalRef = OBC_FaultLevel_oOBC_Error_STATUS_oKAMA_FP_EPT_0303_bdd2e9f5_Rx
        ComIPduSignalRef = OBC_InputFrequencyStatus_oOBC_Error_STATUS_oKAMA_FP_EPT_0303_668c46af_Rx
        ComIPduSignalRef = OBC_InputOverCurrentstatus_R_oOBC_Error_STATUS_oKAMA_FP_EPT_0303_4580bb0c_Rx
        ComIPduSignalRef = OBC_InputOverCurrentstatus_S_oOBC_Error_STATUS_oKAMA_FP_EPT_0303_c570ac13_Rx
        ComIPduSignalRef = OBC_InputOverCurrentstatus_T_oOBC_Error_STATUS_oKAMA_FP_EPT_0303_f142c5cc_Rx
        ComIPduSignalRef = OBC_InputPhaseStatus_oOBC_Error_STATUS_oKAMA_FP_EPT_0303_76c7d8d9_Rx
        ComIPduSignalRef = OBC_NlineStatus_oOBC_Error_STATUS_oKAMA_FP_EPT_0303_6b29417d_Rx
        ComIPduSignalRef = OBC_OutputShortError_oOBC_Error_STATUS_oKAMA_FP_EPT_0303_4bf227d4_Rx
        ComIPduSignalRef = OBC_PFCOverVoltageError_oOBC_Error_STATUS_oKAMA_FP_EPT_0303_67189211_Rx
        ComIPduSignalRef = OBC_PFCUnderVoltageError_oOBC_Error_STATUS_oKAMA_FP_EPT_0303_7a662b4c_Rx
        ComIPduSignalRef = OBC_PrimarySideOvertempStatus_oOBC_Error_STATUS_oKAMA_FP_EPT_0303_f04f7975_Rx
        ComIPduSignalRef = OBC_PrimarySideTemp_oOBC_Error_STATUS_oKAMA_FP_EPT_0303_677cf47a_Rx
        ComIPduSignalRef = OBC_SecondarySideTemp_oOBC_Error_STATUS_oKAMA_FP_EPT_0303_53ea5021_Rx
        ComIPduSignalRef = OBC_SecordarySideOvertempStatus_oOBC_Error_STATUS_oKAMA_FP_EPT_0303_1d8699c7_Rx
        ComIPduSignalRef = OBC_StartUpAllowed_oOBC_Error_STATUS_oKAMA_FP_EPT_0303_5f4a22be_Rx
        ComIPduSignalRef = OBC_internalFault_oOBC_Error_STATUS_oKAMA_FP_EPT_0303_2469625b_Rx
        ComIPduSignalRef = POD_faultTemp_oOBC_Error_STATUS_oKAMA_FP_EPT_0303_63cfc5a1_Rx
        ComPduIdRef = OBC_Error_STATUS_oKAMA_FP_EPT_0303_fe50628e_Rx
      25 x ComSignal, all with ComTimeout=0, ComSignalAccess=ACCESS_UNCLEAR:
        VCU_OdometerInfo_VCU_oVCU_OdometerInfo_oKAMA_FP_EPSChassis1_0303_83395826_Tx: ComBitPosition=7, ComBitSize=20, ComSignalEndianness=BIG_ENDIAN, ComSignalInitValue=0, ComSignalType=UINT32, ComTransferProperty=PENDING, ComHandleId=98, ComSystemTemplateSystemSignalRef=VCU_OdometerInfo_VCU
        BMS_BatType_oBMS_BatInfor2_oKAMA_FP_EPT_0303_2061b264_Rx: ComBitPosition=7, ComBitSize=4, ComSignalEndianness=BIG_ENDIAN, ComSignalInitValue=0, ComSignalType=UINT8, ComHandleId=83, ComSystemTemplateSystemSignalRef=BMS_BatType
        OBC_DCDC_KL30Error_oDCDC_VCU_02_oKAMA_FP_EPT_0303_2196d055_Rx: ComBitPosition=22, ComBitSize=1, ComSignalEndianness=BIG_ENDIAN, ComSignalInitValue=0, ComSignalType=BOOLEAN, ComHandleId=448, ComSystemTemplateSystemSignalRef=OBC_DCDC_KL30Error
        OBC_SecondarySideTemp_oOBC_Error_STATUS_oKAMA_FP_EPT_0303_53ea5021_Rx: ComBitPosition=47, ComBitSize=8, ComSignalEndianness=BIG_ENDIAN, ComSignalInitValue=40, ComSignalType=UINT8, ComHandleId=470, ComSystemTemplateSystemSignalRef=OBC_SecondarySideTemp
        BMS_BattCurr_oBMS_BatInfor1_oKAMA_FP_EPT_0303_9e118383_Rx: ComBitPosition=23, ComBitSize=15, ComSignalEndianness=BIG_ENDIAN, ComSignalInitValue=10240, ComSignalType=UINT16, ComHandleId=84, ComSystemTemplateSystemSignalRef=BMS_BattCurr
        DM1_Byte1_oREPS_DM1_oKAMA_FP_EPSChassis1_0303_d791ec84_Rx: ComBitPosition=15, ComBitSize=8, ComSignalEndianness=BIG_ENDIAN, ComSignalInitValue=0, ComSignalType=UINT8, ComHandleId=227, ComSystemTemplateSystemSignalRef=DM1_Byte1
        BCM_RLHSTempDewPoint_oGW_BCM_oKAMA_FP_EPT_0303_b820e988_Rx: ComBitPosition=39, ComBitSize=11, ComSignalEndianness=BIG_ENDIAN, ComSignalInitValue=400, ComSignalType=UINT16, ComHandleId=53, ComSystemTemplateSystemSignalRef=BCM_RLHSTempDewPoint
        BMS_SOC_oBMS_PackVoltage_oKAMA_FP_EPT_0303_15423f2a_Rx: ComBitPosition=39, ComBitSize=16, ComSignalEndianness=BIG_ENDIAN, ComSignalInitValue=55000, ComSignalType=UINT16, ComHandleId=158, ComSystemTemplateSystemSignalRef=BMS_SOC
        EVCOM_StandByUnderVolError_oEVCOM_State_oKAMA_FP_EPT_0303_7587ae67_Rx: ComBitPosition=3, ComBitSize=1, ComSignalEndianness=BIG_ENDIAN, ComSignalInitValue=0, ComSignalType=BOOLEAN, ComHandleId=275, ComSystemTemplateSystemSignalRef=EVCOM_StandByUnderVolError
        OBC_CPDuty_oOBC_VCU_CHRGSTATION_ST_oKAMA_FP_EPT_0303_d5be8004_Rx: ComBitPosition=47, ComBitSize=8, ComSignalEndianness=BIG_ENDIAN, ComSignalInitValue=0, ComSignalType=UINT8, ComHandleId=438, ComSystemTemplateSystemSignalRef=OBC_CPDuty
        IBS_RLWheelSpeed_Fault_oIBS_WheelSpeed_oKAMA_FP_EPSChassis1_0303_09838b74_Rx: ComBitPosition=55, ComBitSize=1, ComSignalEndianness=BIG_ENDIAN, ComSignalInitValue=0, ComSignalType=BOOLEAN, ComHandleId=321, ComSystemTemplateSystemSignalRef=IBS_RLWheelSpeed_Fault
        VCU_HVBatCoolOvrTemp_oVCU_HMIsignals_oKAMA_FP_EPSChassis1_0303_ba1ee51c_Tx: ComBitPosition=12, ComBitSize=1, ComSignalEndianness=BIG_ENDIAN, ComSignalInitValue=0, ComSignalType=BOOLEAN, ComTransferProperty=PENDING, ComHandleId=67, ComSystemTemplateSystemSignalRef=VCU_HVBatCoolOvrTemp
        MCU_HvMcuVer_oMCU_SoftwareNumber_oKAMA_FP_EPT_0303_43ec3028_Rx: ComBitPosition=55, ComBitSize=16, ComSignalEndianness=BIG_ENDIAN, ComSignalInitValue=0, ComSignalType=UINT16, ComHandleId=354, ComSystemTemplateSystemSignalRef=MCU_HvMcuVer
        BCM_RLHSTempSensorValue_oGW_BCM_oKAMA_FP_EPT_0303_fecee294_Rx: ComBitPosition=31, ComBitSize=8, ComSignalEndianness=BIG_ENDIAN, ComSignalInitValue=80, ComSignalType=UINT8, ComHandleId=54, ComSystemTemplateSystemSignalRef=BCM_RLHSTempSensorValue
        MCU_stDischg_oMCU_DeratingStatus_oKAMA_FP_EPT_0303_34fcacdf_Rx: ComBitPosition=55, ComBitSize=2, ComSignalEndianness=BIG_ENDIAN, ComSignalInitValue=0, ComSignalType=UINT8, ComHandleId=393, ComSystemTemplateSystemSignalRef=MCU_stDischg
        IBS_TorqueReductionRequest_oIBS_Torque_oKAMA_FP_EPSChassis1_0303_9e6a500f_Rx: ComBitPosition=7, ComBitSize=15, ComSignalEndianness=BIG_ENDIAN, ComSignalInitValue=5400, ComSignalType=UINT16, ComHandleId=334, ComSystemTemplateSystemSignalRef=IBS_TorqueReductionRequest
        MessageCounter_130_oYRS_1_oKAMA_FP_EPSChassis1_0303_8f6318c7_Rx: ComBitPosition=48, ComBitSize=4, ComSignalEndianness=LITTLE_ENDIAN, ComSignalInitValue=0, ComSignalType=UINT8, ComHandleId=421, ComSystemTemplateSystemSignalRef=MessageCounter_130
        BMS_AbortAchivesetValue_oBMS_ChargeStop_oKAMA_FP_EPT_0303_8cb1da4e_Rx: ComBitPosition=17, ComBitSize=2, ComSignalEndianness=BIG_ENDIAN, ComSignalInitValue=0, ComSignalType=UINT8, ComHandleId=57, ComSystemTemplateSystemSignalRef=BMS_AbortAchivesetValue
        MMI_DriverModeReq_oDonorCar_MMI_Status_Infor_oKAMA_FP_EPSChassis1_0303_f5c259b4_Rx: ComBitPosition=42, ComBitSize=3, ComSignalEndianness=BIG_ENDIAN, ComSignalInitValue=0, ComSignalType=UINT8, ComHandleId=400, ComSystemTemplateSystemSignalRef=MMI_DriverModeReq
        VCU_HVStatus_oVCU_BMS_oKAMA_FP_EPT_0303_820e6a90_Tx: ComBitPosition=15, ComBitSize=4, ComSignalEndianness=BIG_ENDIAN, ComSignalInitValue=0, ComSignalType=UINT8, ComTransferProperty=PENDING, ComHandleId=77, ComSystemTemplateSystemSignalRef=VCU_HVStatus
        BMS_BRMVersions_oBMS_VersionInfor_oKAMA_FP_EPT_0303_374dfe3b_Rx: ComBitPosition=23, ComBitSize=16, ComSignalEndianness=BIG_ENDIAN, ComSignalInitValue=0, ComSignalType=UINT16, ComHandleId=65, ComSystemTemplateSystemSignalRef=BMS_BRMVersions
        POD_DCPortInletTempBValid_oPOD_VCU_Status_02_oKAMA_FP_EPT_0303_bbc2c0e8_Rx: ComBitPosition=3, ComBitSize=2, ComSignalEndianness=BIG_ENDIAN, ComSignalInitValue=0, ComSignalType=UINT8, ComHandleId=484, ComSystemTemplateSystemSignalRef=POD_DCPortInletTempBValid
        IBS_HHCAvailable_oIBS_Status2_oKAMA_FP_EPSChassis1_0303_0b9f88d4_Rx: ComBitPosition=32, ComBitSize=1, ComSignalEndianness=BIG_ENDIAN, ComSignalInitValue=0, ComSignalType=BOOLEAN, ComHandleId=314, ComSystemTemplateSystemSignalRef=IBS_HHCAvailable
        APTC_Core1TempSensorFaltStatus_oAPTC_TCU_oKAMA_FP_EPT_0303_0ff89cce_Rx: ComBitPosition=41, ComBitSize=2, ComSignalEndianness=BIG_ENDIAN, ComSignalInitValue=0, ComSignalType=UINT8, ComHandleId=37, ComSystemTemplateSystemSignalRef=APTC_Core1TempSensorFaltStatus
        MCU_bDernUndrUdc_oMCU_DeratingStatus_oKAMA_FP_EPT_0303_c0f06e7e_Rx: ComBitPosition=0, ComBitSize=1, ComSignalEndianness=BIG_ENDIAN, ComSignalInitValue=0, ComSignalType=BOOLEAN, ComHandleId=390, ComSystemTemplateSystemSignalRef=MCU_bDernUndrUdc
      VCU_TCU_oKAMA_FP_EPT_0303_7cc42e59_Tx (ComIPdu):
        ComIPduDirection = SEND
        ComIPduType = NORMAL
        ComIPduHandleId = 18
        ComIPduSignalProcessing = DEFERRED
        ComIPduCancellationSupport = false
        ComIPduGroupRef = VCU_oKAMA_FP_EPT_0303_Tx_51b27697
        ComIPduSignalRef = VCU_RequestedModeTCU_oVCU_TCU_oKAMA_FP_EPT_0303_b90f5020_Tx
        ComIPduSignalRef = VCU_TCUPowerAllowed_oVCU_TCU_oKAMA_FP_EPT_0303_c9668d8d_Tx
        ComPduIdRef = VCU_TCU_oKAMA_FP_EPT_0303_7cc42e59_Tx
        ComTxIPdu: ComMinimumDelayTime=0, ComTxIPduUnusedAreasDefault=0
          ComTxModeTrue
            ComTxMode: ComTxModeMode=PERIODIC, ComTxModeTimeOffset=0, ComTxModeTimePeriod=0.1
          ComTxModeFalse
            ComTxMode: ComTxModeMode=PERIODIC, ComTxModeTimeOffset=0, ComTxModeTimePeriod=0.1
      13 x ComSignal, all with ComSignalEndianness=BIG_ENDIAN, ComTimeout=0, ComSignalAccess=ACCESS_UNCLEAR:
        APTC_HVBusVoltage_oAPTC_TCU_oKAMA_FP_EPT_0303_e132457a_Rx: ComBitPosition=39, ComBitSize=11, ComSignalInitValue=0, ComSignalType=UINT16, ComHandleId=40, ComSystemTemplateSystemSignalRef=APTC_HVBusVoltage
        BMS_AllowCellTemperature_oBMS_TCU_oKAMA_FP_EPT_0303_a598b691_Rx: ComBitPosition=7, ComBitSize=8, ComSignalInitValue=255, ComSignalType=UINT8, ComHandleId=62, ComSystemTemplateSystemSignalRef=BMS_AllowCellTemperature
        IBS_EPBSwitchPosition_oIBS_Status2_oKAMA_FP_EPSChassis1_0303_053602ab_Rx: ComBitPosition=39, ComBitSize=2, ComSignalInitValue=0, ComSignalType=UINT8, ComHandleId=295, ComSystemTemplateSystemSignalRef=IBS_EPBSwitchPosition
        IBS_RRWheelSpeed_oIBS_WheelSpeed_oKAMA_FP_EPSChassis1_0303_32d4c92a_Rx: ComBitPosition=36, ComBitSize=13, ComSignalInitValue=0, ComSignalType=UINT16, ComHandleId=326, ComSystemTemplateSystemSignalRef=IBS_RRWheelSpeed
        BMS_RatBatVoltage_oBMS_BatInfor2_oKAMA_FP_EPT_0303_58df94cd_Rx: ComBitPosition=39, ComBitSize=16, ComSignalInitValue=0, ComSignalType=UINT16, ComHandleId=152, ComSystemTemplateSystemSignalRef=BMS_RatBatVoltage
        BMS_BatCode3_oBMS_Batcode_oKAMA_FP_EPT_0303_c4d5592b_Rx: ComBitPosition=39, ComBitSize=8, ComSignalInitValue=0, ComSignalType=UINT8, ComHandleId=71, ComSystemTemplateSystemSignalRef=BMS_BatCode3
        BMS_ErrorLeakDet_oBMS_ErrorInfo1_oKAMA_FP_EPT_0303_d14e6399_Rx: ComBitPosition=45, ComBitSize=1, ComSignalInitValue=0, ComSignalType=BOOLEAN, ComHandleId=117, ComSystemTemplateSystemSignalRef=BMS_ErrorLeakDet
        VCU_WheelTrqACT_oVCU_chassis_oKAMA_FP_EPSChassis1_0303_a917e36b_Tx: ComBitPosition=39, ComBitSize=16, ComSignalInitValue=20000, ComSignalType=UINT16, ComTransferProperty=PENDING, ComHandleId=124, ComSystemTemplateSystemSignalRef=VCU_WheelTrqACT
        BMS_ErrorSystemsMatch_oBMS_ErrorInfo1_oKAMA_FP_EPT_0303_f955b6a9_Rx: ComBitPosition=47, ComBitSize=1, ComSignalInitValue=0, ComSignalType=BOOLEAN, ComHandleId=124, ComSystemTemplateSystemSignalRef=BMS_ErrorSystemsMatch
        OBC_PrimarySideTemp_oOBC_Error_STATUS_oKAMA_FP_EPT_0303_677cf47a_Rx: ComBitPosition=39, ComBitSize=8, ComSignalInitValue=40, ComSignalType=UINT8, ComHandleId=468, ComSystemTemplateSystemSignalRef=OBC_PrimarySideTemp
        Checksum_2C0_oTCU_Status_oKAMA_FP_EPT_0303_9b85e24f_Rx: ComBitPosition=63, ComBitSize=8, ComSignalInitValue=0, ComSignalType=UINT8, ComHandleId=186, ComSystemTemplateSystemSignalRef=Checksum_2C0
        VCU_currentFromExtChargerAc_oVCU_PlugInChrgInfo2_oKAMA_FP_EPSChassis1_0303_52c379dd_Tx: ComBitPosition=7, ComBitSize=12, ComSignalInitValue=0, ComSignalType=UINT16, ComTransferProperty=PENDING, ComHandleId=127, ComSystemTemplateSystemSignalRef=VCU_currentFromExtChargerAc
        EVCOM_FailStatus_oEVCOM_State_oKAMA_FP_EPT_0303_7d468baf_Rx: ComBitPosition=54, ComBitSize=1, ComSignalInitValue=0, ComSignalType=BOOLEAN, ComHandleId=269, ComSystemTemplateSystemSignalRef=EVCOM_FailStatus
      VCU_oKAMA_FP_EPT_0303_Rx_07e8d111 (ComIPduGroup): ComIPduGroupHandleId=2
      5 x ComSignal, all with ComSignalEndianness=BIG_ENDIAN, ComTimeout=0, ComSignalAccess=ACCESS_UNCLEAR:
        OBC_ComFault2_oOBC_Error_STATUS_oKAMA_FP_EPT_0303_1c36821f_Rx: ComBitPosition=26, ComBitSize=1, ComSignalInitValue=0, ComSignalType=BOOLEAN, ComHandleId=445, ComSystemTemplateSystemSignalRef=OBC_ComFault2
        PEPS_Message_Sts_AliveCounter_oDonorCar_PEPS_Message_Sts_oKAMA_FP_EPSChassis1_0303_8f8646c9_Rx: ComBitPosition=51, ComBitSize=4, ComSignalInitValue=0, ComSignalType=UINT8, ComHandleId=474, ComSystemTemplateSystemSignalRef=PEPS_Message_Sts_AliveCounter
        OBC_CPStatus_oOBC_VCU_CHRGSTATION_ST_oKAMA_FP_EPT_0303_04a122e7_Rx: ComBitPosition=11, ComBitSize=3, ComSignalInitValue=0, ComSignalType=UINT8, ComHandleId=440, ComSystemTemplateSystemSignalRef=OBC_CPStatus
        ACC_MinJerkA_oADAS_ACC_oKAMA_FP_EPSChassis1_0303_1349898e_Rx: ComBitPosition=39, ComBitSize=7, ComSignalInitValue=127, ComSignalType=UINT8, ComHandleId=5, ComSystemTemplateSystemSignalRef=ACC_MinJerkA
        BMS_AbortAchiveTotalVolt_oBMS_ChargeStop_oKAMA_FP_EPT_0303_0c83125c_Rx: ComBitPosition=7, ComBitSize=2, ComSignalInitValue=0, ComSignalType=UINT8, ComHandleId=56, ComSystemTemplateSystemSignalRef=BMS_AbortAchiveTotalVolt
      VCU_BMS_oKAMA_FP_EPT_0303_45397907_Tx (ComIPdu):
        ComIPduDirection = SEND
        ComIPduType = NORMAL
        ComIPduHandleId = 2
        ComIPduSignalProcessing = DEFERRED
        ComIPduCancellationSupport = false
        ComIPduGroupRef = VCU_oKAMA_FP_EPT_0303_Tx_51b27697
        ComIPduSignalRef = Checksum_0A1_oVCU_BMS_oKAMA_FP_EPT_0303_42ed6dd7_Tx
        ComIPduSignalRef = MessageCounter_0A1_oVCU_BMS_oKAMA_FP_EPT_0303_9662047a_Tx
        ComIPduSignalRef = VCU_BMS_Control_of_NegRelay_oVCU_BMS_oKAMA_FP_EPT_0303_daf51a5c_Tx
        ComIPduSignalRef = VCU_Chargestatus_oVCU_BMS_oKAMA_FP_EPT_0303_0d5594fe_Tx
        ComIPduSignalRef = VCU_HVStatus_oVCU_BMS_oKAMA_FP_EPT_0303_820e6a90_Tx
        ComIPduSignalRef = VCU_IsoMeasurementSwitch_oVCU_BMS_oKAMA_FP_EPT_0303_e68a1aea_Tx
        ComIPduSignalRef = VCU_RequestedModeBMS_oVCU_BMS_oKAMA_FP_EPT_0303_435d6a39_Tx
        ComPduIdRef = VCU_BMS_oKAMA_FP_EPT_0303_45397907_Tx
        ComTxIPdu: ComMinimumDelayTime=0, ComTxIPduUnusedAreasDefault=0
          ComTxModeTrue
            ComTxMode: ComTxModeMode=PERIODIC, ComTxModeTimeOffset=0, ComTxModeTimePeriod=0.02
          ComTxModeFalse
            ComTxMode: ComTxModeMode=PERIODIC, ComTxModeTimeOffset=0, ComTxModeTimePeriod=0.02
      4 x ComSignal, all with ComSignalEndianness=BIG_ENDIAN, ComTimeout=0, ComSignalAccess=ACCESS_UNCLEAR:
        IBS_VehicleStandstill_Valid_oIBS_VCUVLC_oKAMA_FP_EPSChassis1_0303_03b42b1b_Rx: ComBitPosition=31, ComBitSize=1, ComSignalInitValue=0, ComSignalType=BOOLEAN, ComHandleId=340, ComSystemTemplateSystemSignalRef=IBS_VehicleStandstill_Valid
        MCU_TrqAbsMax_oMCU_DeratingStatus_oKAMA_FP_EPT_0303_c307bb83_Rx: ComBitPosition=11, ComBitSize=11, ComSignalInitValue=1024, ComSignalType=UINT16, ComHandleId=376, ComSystemTemplateSystemSignalRef=MCU_TrqAbsMax
        OBC_ChrgOutpPwrAvl_oOBC_VCU_STATUS2_oKAMA_FP_EPT_0303_c4d5bbdb_Rx: ComBitPosition=7, ComBitSize=8, ComSignalInitValue=0, ComSignalType=UINT8, ComHandleId=443, ComSystemTemplateSystemSignalRef=OBC_ChrgOutpPwrAvl
        VCU_HVBatUndTemp_oVCU_HMIsignals_oKAMA_FP_EPSChassis1_0303_a4c8b79a_Tx: ComBitPosition=2, ComBitSize=1, ComSignalInitValue=0, ComSignalType=BOOLEAN, ComTransferProperty=PENDING, ComHandleId=73, ComSystemTemplateSystemSignalRef=VCU_HVBatUndTemp
      MCU_HardwareNumber_oKAMA_FP_EPT_0303_379b1fee_Rx (ComIPdu):
        ComIPduDirection = RECEIVE
        ComIPduType = NORMAL
        ComIPduHandleId = 45
        ComIPduSignalProcessing = DEFERRED
        ComIPduCancellationSupport = false
        ComIPduGroupRef = VCU_oKAMA_FP_EPT_0303_Rx_07e8d111
        ComIPduSignalRef = MCU_HwVer_oMCU_HardwareNumber_oKAMA_FP_EPT_0303_c0b0dce1_Rx
        ComPduIdRef = MCU_HardwareNumber_oKAMA_FP_EPT_0303_379b1fee_Rx
      YRS_1_oKAMA_FP_EPSChassis1_0303_6b7756ae_Rx (ComIPdu):
        ComIPduDirection = RECEIVE
        ComIPduType = NORMAL
        ComIPduHandleId = 65
        ComIPduSignalProcessing = DEFERRED
        ComIPduCancellationSupport = false
        ComIPduGroupRef = VCU_oKAMA_FP_EPSChassis1_0303_Rx_00807295
        ComIPduSignalRef = Checksum_130_oYRS_1_oKAMA_FP_EPSChassis1_0303_8179344a_Rx
        ComIPduSignalRef = MessageCounter_130_oYRS_1_oKAMA_FP_EPSChassis1_0303_8f6318c7_Rx
        ComIPduSignalRef = YRS_AyStatus_oYRS_1_oKAMA_FP_EPSChassis1_0303_ae11a279_Rx
        ComIPduSignalRef = YRS_Ay_oYRS_1_oKAMA_FP_EPSChassis1_0303_b3ce63e2_Rx
        ComIPduSignalRef = YRS_YawRateStatus_oYRS_1_oKAMA_FP_EPSChassis1_0303_1d2b57fe_Rx
        ComIPduSignalRef = YRS_YawRate_oYRS_1_oKAMA_FP_EPSChassis1_0303_203c933c_Rx
        ComPduIdRef = YRS_1_oKAMA_FP_EPSChassis1_0303_6b7756ae_Rx
      4 x ComSignal, all with ComTimeout=0, ComSignalAccess=ACCESS_UNCLEAR:
        MMI_BlowerFanLevel_oDonorCar_MMI_AC_Command_oKAMA_FP_EPT_0303_c2d9f8f9_Rx: ComBitPosition=11, ComBitSize=4, ComSignalEndianness=BIG_ENDIAN, ComSignalInitValue=15, ComSignalType=UINT8, ComHandleId=399, ComSystemTemplateSystemSignalRef=MMI_BlowerFanLevel
        VCU_RequestedModeTCU_oVCU_TCU_oKAMA_FP_EPT_0303_b90f5020_Tx: ComBitPosition=15, ComBitSize=2, ComSignalEndianness=BIG_ENDIAN, ComSignalInitValue=0, ComSignalType=UINT8, ComTransferProperty=PENDING, ComHandleId=105, ComSystemTemplateSystemSignalRef=VCU_RequestedModeTCU
        YRS_Ax_oYRS_2_oKAMA_FP_EPSChassis1_0303_24d81f17_Rx: ComBitPosition=32, ComBitSize=16, ComSignalEndianness=LITTLE_ENDIAN, ComSignalType=UINT16, ComSignalInitValue=0, ComHandleId=514, ComSystemTemplateSystemSignalRef=YRS_Ax
        BCM_RLHSSolarDrvr_oGW_BCM_oKAMA_FP_EPT_0303_656d224a_Rx: ComBitPosition=7, ComBitSize=8, ComSignalEndianness=BIG_ENDIAN, ComSignalInitValue=0, ComSignalType=UINT8, ComHandleId=51, ComSystemTemplateSystemSignalRef=BCM_RLHSSolarDrvr
      REPS_DM2_oKAMA_FP_EPSChassis1_0303_2799a187_Rx (ComIPdu):
        ComIPduDirection = RECEIVE
        ComIPduType = NORMAL
        ComIPduHandleId = 58
        ComIPduSignalProcessing = DEFERRED
        ComIPduCancellationSupport = false
        ComIPduGroupRef = VCU_oKAMA_FP_EPSChassis1_0303_Rx_00807295
        ComIPduSignalRef = DM2_Byte0_oREPS_DM2_oKAMA_FP_EPSChassis1_0303_2dc1cd55_Rx
        ComIPduSignalRef = DM2_Byte1_oREPS_DM2_oKAMA_FP_EPSChassis1_0303_ad31da4a_Rx
        ComIPduSignalRef = DM2_Byte2_oREPS_DM2_oKAMA_FP_EPSChassis1_0303_f750e52a_Rx
        ComIPduSignalRef = DM2_Byte3_oREPS_DM2_oKAMA_FP_EPSChassis1_0303_77a0f235_Rx
        ComIPduSignalRef = DM2_Byte4_oREPS_DM2_oKAMA_FP_EPSChassis1_0303_43929bea_Rx
        ComIPduSignalRef = DM2_Byte5_oREPS_DM2_oKAMA_FP_EPSChassis1_0303_c3628cf5_Rx
        ComIPduSignalRef = DM2_Byte6_oREPS_DM2_oKAMA_FP_EPSChassis1_0303_9903b395_Rx
        ComIPduSignalRef = DM2_Byte7_oREPS_DM2_oKAMA_FP_EPSChassis1_0303_19f3a48a_Rx
        ComPduIdRef = REPS_DM2_oKAMA_FP_EPSChassis1_0303_2799a187_Rx
      12 x ComSignal, all with ComSignalEndianness=BIG_ENDIAN, ComSignalInitValue=0, ComTimeout=0, ComSignalAccess=ACCESS_UNCLEAR:
        BMS_ErrorCellLowTemp_oBMS_ErrorInfo1_oKAMA_FP_EPT_0303_c372ba9c_Rx: ComBitPosition=1, ComBitSize=2, ComSignalType=UINT8, ComHandleId=102, ComSystemTemplateSystemSignalRef=BMS_ErrorCellLowTemp
        MessageCounter_5A_oIBS_Status1_oKAMA_FP_EPSChassis1_0303_f21eafaa_Rx: ComBitPosition=51, ComBitSize=4, ComSignalType=UINT8, ComHandleId=410, ComSystemTemplateSystemSignalRef=MessageCounter_5A
        OBC_ChargCapacibility_oOBC_VCU_CHRGSTATION_ST_oKAMA_FP_EPT_0303_a5f9f869_Rx: ComBitPosition=35, ComBitSize=2, ComSignalType=UINT8, ComHandleId=441, ComSystemTemplateSystemSignalRef=OBC_ChargCapacibility
        AC_BlowerLevel_oTCU_ACStatusInfo_oKAMA_FP_EPT_0303_fb35f94a_Rx: ComBitPosition=11, ComBitSize=4, ComSignalType=UINT8, ComHandleId=12, ComSystemTemplateSystemSignalRef=AC_BlowerLevel
        Checksum_1A2_oADAS_AEB_oKAMA_FP_EPSChassis1_0303_76b7e8f6_Rx: ComBitPosition=63, ComBitSize=8, ComSignalType=UINT8, ComHandleId=184, ComSystemTemplateSystemSignalRef=Checksum_1A2
        APA_StopDistance_oADAS_APA_oKAMA_FP_EPSChassis1_0303_e76c8e46_Rx: ComBitPosition=7, ComBitSize=12, ComSignalType=UINT16, ComHandleId=36, ComSystemTemplateSystemSignalRef=APA_StopDistance
        Checksum_AF_oBMS_BatInfor1_oKAMA_FP_EPT_0303_e074c4ab_Rx: ComBitPosition=63, ComBitSize=8, ComSignalType=UINT8, ComHandleId=203, ComSystemTemplateSystemSignalRef=Checksum_AF
        MessageCounter_6A_oEPS_FEEDBACK_oKAMA_FP_EPSChassis1_0303_d323a2d0_Rx: ComBitPosition=51, ComBitSize=4, ComSignalType=UINT8, ComHandleId=417, ComSystemTemplateSystemSignalRef=MessageCounter_6A
        BMS_StateRelay5_oBMS_DIRelayState_oKAMA_FP_EPT_0303_f8748e9f_Rx: ComBitPosition=13, ComBitSize=2, ComSignalType=UINT8, ComHandleId=170, ComSystemTemplateSystemSignalRef=BMS_StateRelay5
        DM3_Byte0_oREPS_DM3_oKAMA_FP_EPSChassis1_0303_045e20ef_Rx: ComBitPosition=7, ComBitSize=8, ComSignalType=UINT8, ComHandleId=242, ComSystemTemplateSystemSignalRef=DM3_Byte0
        VCU_Enable_DC_Relay_oVCU_POD_oKAMA_FP_EPT_0303_59814884_Tx: ComBitPosition=21, ComBitSize=1, ComSignalType=BOOLEAN, ComTransferProperty=PENDING, ComHandleId=63, ComSystemTemplateSystemSignalRef=VCU_Enable_DC_Relay
        MCU_Softwae_FaultBit_oMCU_FailureCode_oKAMA_FP_EPT_0303_68be5667_Rx: ComBitPosition=15, ComBitSize=19, ComSignalType=UINT32, ComHandleId=369, ComSystemTemplateSystemSignalRef=MCU_Softwae_FaultBit
      BMS_Charge1_oKAMA_FP_EPT_0303_0f6fc3b3_Rx (ComIPdu):
        ComIPduDirection = RECEIVE
        ComIPduType = NORMAL
        ComIPduHandleId = 9
        ComIPduSignalProcessing = DEFERRED
        ComIPduCancellationSupport = false
        ComIPduGroupRef = VCU_oKAMA_FP_EPT_0303_Rx_07e8d111
        ComIPduSignalRef = BMS_AllowChagCurrent_oBMS_Charge1_oKAMA_FP_EPT_0303_2005bfb9_Rx
        ComIPduSignalRef = BMS_MaxChagVoltage_oBMS_Charge1_oKAMA_FP_EPT_0303_245ba8e6_Rx
        ComIPduSignalRef = BMS_RemChagTime_oBMS_Charge1_oKAMA_FP_EPT_0303_1cc78fa1_Rx
        ComPduIdRef = BMS_Charge1_oKAMA_FP_EPT_0303_0f6fc3b3_Rx
      11 x ComSignal, all with ComTimeout=0, ComSignalAccess=ACCESS_UNCLEAR:
        BMS_ErrorBatVolt_oBMS_ErrorInfo1_oKAMA_FP_EPT_0303_6eaffe03_Rx: ComBitPosition=31, ComBitSize=2, ComSignalEndianness=BIG_ENDIAN, ComSignalInitValue=0, ComSignalType=UINT8, ComHandleId=98, ComSystemTemplateSystemSignalRef=BMS_ErrorBatVolt
        BMS_SOH_oBMS_status_oKAMA_FP_EPT_0303_3df0ba2b_Rx: ComBitPosition=39, ComBitSize=8, ComSignalEndianness=BIG_ENDIAN, ComSignalInitValue=0, ComSignalType=UINT8, ComHandleId=159, ComSystemTemplateSystemSignalRef=BMS_SOH
        IBS_TorqueRBSReq_oIBS_Torque_oKAMA_FP_EPSChassis1_0303_a4d38ebf_Rx: ComBitPosition=39, ComBitSize=16, ComSignalEndianness=BIG_ENDIAN, ComSignalInitValue=32768, ComSignalType=UINT16, ComHandleId=332, ComSystemTemplateSystemSignalRef=IBS_TorqueRBSReq
        OBC_InputOverCurrentstatus_T_oOBC_Error_STATUS_oKAMA_FP_EPT_0303_f142c5cc_Rx: ComBitPosition=19, ComBitSize=1, ComSignalEndianness=BIG_ENDIAN, ComSignalInitValue=0, ComSignalType=BOOLEAN, ComHandleId=458, ComSystemTemplateSystemSignalRef=OBC_InputOverCurrentstatus_T
        TCU_APTC1Enable_oTCU_Cmd_oKAMA_FP_EPT_0303_5a9ca1b3_Rx: ComBitPosition=16, ComBitSize=1, ComSignalEndianness=BIG_ENDIAN, ComSignalInitValue=0, ComSignalType=BOOLEAN, ComHandleId=489, ComSystemTemplateSystemSignalRef=TCU_APTC1Enable
        DM2_Byte7_oREPS_DM2_oKAMA_FP_EPSChassis1_0303_19f3a48a_Rx: ComBitPosition=63, ComBitSize=8, ComSignalEndianness=BIG_ENDIAN, ComSignalInitValue=0, ComSignalType=UINT8, ComHandleId=241, ComSystemTemplateSystemSignalRef=DM2_Byte7
        VCU_DCDCFail_oVCU_HMIsignals_oKAMA_FP_EPSChassis1_0303_fe869881_Tx: ComBitPosition=3, ComBitSize=1, ComSignalEndianness=BIG_ENDIAN, ComSignalInitValue=0, ComSignalType=BOOLEAN, ComTransferProperty=PENDING, ComHandleId=52, ComSystemTemplateSystemSignalRef=VCU_DCDCFail
        AC_FrontDefrostState_oTCU_ACStatusInfo_oKAMA_FP_EPT_0303_1b119bb6_Rx: ComBitPosition=3, ComBitSize=1, ComSignalEndianness=BIG_ENDIAN, ComSignalInitValue=0, ComSignalType=BOOLEAN, ComHandleId=13, ComSystemTemplateSystemSignalRef=AC_FrontDefrostState
        AC_IntakeAirState_oTCU_ACStatusInfo_oKAMA_FP_EPT_0303_9da5f179_Rx: ComBitPosition=5, ComBitSize=2, ComSignalEndianness=BIG_ENDIAN, ComSignalInitValue=0, ComSignalType=UINT8, ComHandleId=14, ComSystemTemplateSystemSignalRef=AC_IntakeAirState
        YRS_Ay_oYRS_1_oKAMA_FP_EPSChassis1_0303_b3ce63e2_Rx: ComBitPosition=32, ComBitSize=16, ComSignalEndianness=LITTLE_ENDIAN, ComSignalType=UINT16, ComSignalInitValue=0, ComHandleId=517, ComSystemTemplateSystemSignalRef=YRS_Ay
        MMI_MaxAcKey_oDonorCar_MMI_AC_Command_oKAMA_FP_EPT_0303_5f47228e_Rx: ComBitPosition=2, ComBitSize=1, ComSignalEndianness=BIG_ENDIAN, ComSignalInitValue=0, ComSignalType=BOOLEAN, ComHandleId=404, ComSystemTemplateSystemSignalRef=MMI_MaxAcKey
      TCU_Status_oKAMA_FP_EPT_0303_e2dbd2c2_Rx (ComIPdu):
        ComIPduDirection = RECEIVE
        ComIPduType = NORMAL
        ComIPduHandleId = 63
        ComIPduSignalProcessing = DEFERRED
        ComIPduCancellationSupport = false
        ComIPduGroupRef = VCU_oKAMA_FP_EPT_0303_Rx_07e8d111
        ComIPduSignalRef = Checksum_2C0_oTCU_Status_oKAMA_FP_EPT_0303_9b85e24f_Rx
        ComIPduSignalRef = MessageCounter_2C0_oTCU_Status_oKAMA_FP_EPT_0303_831d62f7_Rx
        ComIPduSignalRef = TCU_APTCState_oTCU_Status_oKAMA_FP_EPT_0303_68b124a6_Rx
        ComIPduSignalRef = TCU_BattTMState_oTCU_Status_oKAMA_FP_EPT_0303_97de8d60_Rx
        ComIPduSignalRef = TCU_EVCompState_oTCU_Status_oKAMA_FP_EPT_0303_a8408b47_Rx
        ComIPduSignalRef = TCU_HVACACState_oTCU_Status_oKAMA_FP_EPT_0303_509ba018_Rx
        ComIPduSignalRef = TCU_HVCHHVDCCurrent_oTCU_Status_oKAMA_FP_EPT_0303_95f720fc_Rx
        ComIPduSignalRef = TCU_HVCHHighVoltage_oTCU_Status_oKAMA_FP_EPT_0303_7a9c07d4_Rx
        ComIPduSignalRef = TCU_HVCHState_oTCU_Status_oKAMA_FP_EPT_0303_e67d87f8_Rx
        ComIPduSignalRef = TCU_HVPwrState_oTCU_Status_oKAMA_FP_EPT_0303_14f21212_Rx
        ComIPduSignalRef = TCU_HvOnReq_oTCU_Status_oKAMA_FP_EPT_0303_c5e07206_Rx
        ComIPduSignalRef = TCU_TMSFaultLevel_oTCU_Status_oKAMA_FP_EPT_0303_1848d01e_Rx
        ComIPduSignalRef = TCU_TMSState_oTCU_Status_oKAMA_FP_EPT_0303_e5c86ed2_Rx
        ComIPduSignalRef = TCU_TMSTotoalPwrReq_oTCU_Status_oKAMA_FP_EPT_0303_ea3f14b8_Rx
        ComPduIdRef = TCU_Status_oKAMA_FP_EPT_0303_e2dbd2c2_Rx
      3 x ComSignal, all with ComSignalEndianness=BIG_ENDIAN, ComSignalInitValue=0, ComTimeout=0, ComSignalAccess=ACCESS_UNCLEAR:
        BMS_MinCellTempNO_oBMS_Temp_oKAMA_FP_EPT_0303_3bda8ac4_Rx: ComBitPosition=63, ComBitSize=8, ComSignalType=UINT8, ComHandleId=141, ComSystemTemplateSystemSignalRef=BMS_MinCellTempNO
        IBS_BrakepedalStatus_oIBS_Status1_oKAMA_FP_EPSChassis1_0303_926e2309_Rx: ComBitPosition=7, ComBitSize=1, ComSignalType=BOOLEAN, ComHandleId=286, ComSystemTemplateSystemSignalRef=IBS_BrakepedalStatus
        VCU_DriveMotOvrTemp_oVCU_HMIsignals_oKAMA_FP_EPSChassis1_0303_c9c648c4_Tx: ComBitPosition=5, ComBitSize=1, ComSignalType=BOOLEAN, ComTransferProperty=PENDING, ComHandleId=57, ComSystemTemplateSystemSignalRef=VCU_DriveMotOvrTemp
      OBC_VCU_STATUS2_oKAMA_FP_EPT_0303_36a159a3_Rx (ComIPdu):
        ComIPduDirection = RECEIVE
        ComIPduType = NORMAL
        ComIPduHandleId = 54
        ComIPduSignalProcessing = DEFERRED
        ComIPduCancellationSupport = false
        ComIPduGroupRef = VCU_oKAMA_FP_EPT_0303_Rx_07e8d111
        ComIPduSignalRef = OBC_ACPortTempA_oOBC_VCU_STATUS2_oKAMA_FP_EPT_0303_fb0087e5_Rx
        ComIPduSignalRef = OBC_ACPortTempB_oOBC_VCU_STATUS2_oKAMA_FP_EPT_0303_9fe0fc1b_Rx
        ComIPduSignalRef = OBC_ChrgOutpPwrAvl_oOBC_VCU_STATUS2_oKAMA_FP_EPT_0303_c4d5bbdb_Rx
        ComIPduSignalRef = OBC_OutputDCChargeCurrent_oOBC_VCU_STATUS2_oKAMA_FP_EPT_0303_ea500141_Rx
        ComPduIdRef = OBC_VCU_STATUS2_oKAMA_FP_EPT_0303_36a159a3_Rx
      3 x ComSignal, all with ComSignalEndianness=BIG_ENDIAN, ComSignalInitValue=0, ComTimeout=0, ComSignalAccess=ACCESS_UNCLEAR:
        BMS_BatCodeFrameNO_oBMS_Batcode_oKAMA_FP_EPT_0303_778b8df2_Rx: ComBitPosition=7, ComBitSize=8, ComSignalType=UINT8, ComHandleId=76, ComSystemTemplateSystemSignalRef=BMS_BatCodeFrameNO
        DM3_Byte6_oREPS_DM3_oKAMA_FP_EPSChassis1_0303_b09c5e2f_Rx: ComBitPosition=55, ComBitSize=8, ComSignalType=UINT8, ComHandleId=248, ComSystemTemplateSystemSignalRef=DM3_Byte6
        MCU_bDernOvrUdc_oMCU_DeratingStatus_oKAMA_FP_EPT_0303_8504b895_Rx: ComBitPosition=5, ComBitSize=1, ComSignalType=BOOLEAN, ComHandleId=383, ComSystemTemplateSystemSignalRef=MCU_bDernOvrUdc
      DonorCar_MMI_Status_Infor_oKAMA_FP_EPSChassis1_0303_cfdfa99c_Rx (ComIPdu):
        ComIPduDirection = RECEIVE
        ComIPduType = NORMAL
        ComIPduHandleId = 29
        ComIPduSignalProcessing = DEFERRED
        ComIPduCancellationSupport = false
        ComIPduGroupRef = VCU_oKAMA_FP_EPSChassis1_0303_Rx_00807295
        ComIPduSignalRef = MMI_DriverModeReq_oDonorCar_MMI_Status_Infor_oKAMA_FP_EPSChassis1_0303_f5c259b4_Rx
        ComPduIdRef = DonorCar_MMI_Status_Infor_oKAMA_FP_EPSChassis1_0303_cfdfa99c_Rx
      VCU_RequestedModeBMS_oVCU_BMS_oKAMA_FP_EPT_0303_435d6a39_Tx (ComSignal):
        ComBitPosition = 7
        ComBitSize = 3
        ComSignalEndianness = BIG_ENDIAN
        ComSignalInitValue = 0
        ComSignalType = UINT8
        ComTimeout = 0
        ComTransferProperty = PENDING
        ComSignalAccess = ACCESS_UNCLEAR
        ComHandleId = 104
        ComSystemTemplateSystemSignalRef = VCU_RequestedModeBMS
      VCU_PwrtrainHVbattStatus2_oKAMA_FP_EPSChassis1_0303_3c31462e_Tx (ComIPdu):
        ComIPduDirection = SEND
        ComIPduType = NORMAL
        ComIPduHandleId = 16
        ComIPduSignalProcessing = DEFERRED
        ComIPduCancellationSupport = false
        ComIPduGroupRef = VCU_oKAMA_FP_EPSChassis1_0303_Tx_56dad513
        ComIPduSignalRef = Checksum_27F_oVCU_PwrtrainHVbattStatus2_oKAMA_FP_EPSChassis1_0303_27901d10_Tx
        ComIPduSignalRef = MessageCounter_27F_oVCU_PwrtrainHVbattStatus2_oKAMA_FP_EPSChassis1_0303_417f5ce3_Tx
        ComIPduSignalRef = VCU_HVBatCurrent_VCU_oVCU_PwrtrainHVbattStatus2_oKAMA_FP_EPSChassis1_0303_b43a3dd3_Tx
        ComIPduSignalRef = VCU_HVBatVolt_VCU_oVCU_PwrtrainHVbattStatus2_oKAMA_FP_EPSChassis1_0303_46d7dc97_Tx
        ComPduIdRef = VCU_PwrtrainHVbattStatus2_oKAMA_FP_EPSChassis1_0303_3c31462e_Tx
        ComTxIPdu: ComMinimumDelayTime=0, ComTxIPduUnusedAreasDefault=0
          ComTxModeTrue
            ComTxMode: ComTxModeMode=PERIODIC, ComTxModeTimeOffset=0, ComTxModeTimePeriod=0.2
          ComTxModeFalse
            ComTxMode: ComTxModeMode=PERIODIC, ComTxModeTimeOffset=0, ComTxModeTimePeriod=0.2
      DM2_Byte6_oREPS_DM2_oKAMA_FP_EPSChassis1_0303_9903b395_Rx (ComSignal):
        ComBitPosition = 55
        ComBitSize = 8
        ComSignalEndianness = BIG_ENDIAN
        ComSignalInitValue = 0
        ComSignalType = UINT8
        ComTimeout = 0
        ComSignalAccess = ACCESS_UNCLEAR
        ComHandleId = 240
        ComSystemTemplateSystemSignalRef = DM2_Byte6
      DCDC_VCU_02_oKAMA_FP_EPT_0303_0576f9fb_Rx (ComIPdu):
        ComIPduDirection = RECEIVE
        ComIPduType = NORMAL
        ComIPduHandleId = 24
        ComIPduSignalProcessing = DEFERRED
        ComIPduCancellationSupport = false
        ComIPduGroupRef = VCU_oKAMA_FP_EPT_0303_Rx_07e8d111
        ComIPduSignalRef = DCDC_ComFault_oDCDC_VCU_02_oKAMA_FP_EPT_0303_9177342e_Rx
        ComIPduSignalRef = DCDC_FaultStatus_oDCDC_VCU_02_oKAMA_FP_EPT_0303_c1f47714_Rx
        ComIPduSignalRef = DCDC_InputVoltHighFault_oDCDC_VCU_02_oKAMA_FP_EPT_0303_7d394ef3_Rx
        ComIPduSignalRef = DCDC_InputVoltLowFault_oDCDC_VCU_02_oKAMA_FP_EPT_0303_9ef01f25_Rx
        ComIPduSignalRef = DCDC_InternalFault_oDCDC_VCU_02_oKAMA_FP_EPT_0303_9be61bd9_Rx
        ComIPduSignalRef = DCDC_OBCTempHighFault_oDCDC_VCU_02_oKAMA_FP_EPT_0303_b05c1fae_Rx
        ComIPduSignalRef = DCDC_OBC_CANBusoff_oDCDC_VCU_02_oKAMA_FP_EPT_0303_efbba3f7_Rx
        ComIPduSignalRef = DCDC_OutputCurrentHighFault_oDCDC_VCU_02_oKAMA_FP_EPT_0303_efaac618_Rx
        ComIPduSignalRef = DCDC_OutputCurrentSensorFault_oDCDC_VCU_02_oKAMA_FP_EPT_0303_a94a7b3c_Rx
        ComIPduSignalRef = DCDC_OutputSOGFault_oDCDC_VCU_02_oKAMA_FP_EPT_0303_29b74325_Rx
        ComIPduSignalRef = DCDC_OutputTempSensorFault_oDCDC_VCU_02_oKAMA_FP_EPT_0303_dfa8507a_Rx
        ComIPduSignalRef = DCDC_OutputVoltHighFault_oDCDC_VCU_02_oKAMA_FP_EPT_0303_d3f5b73e_Rx
        ComIPduSignalRef = DCDC_OutputVoltLowFault_oDCDC_VCU_02_oKAMA_FP_EPT_0303_836398cd_Rx
        ComIPduSignalRef = DCDC_PrimarySideOvertempStatus_oDCDC_VCU_02_oKAMA_FP_EPT_0303_71e13547_Rx
        ComIPduSignalRef = DCDC_SecondarySideTemp_oDCDC_VCU_02_oKAMA_FP_EPT_0303_cf856b2c_Rx
        ComIPduSignalRef = DCDC_SecordarySideOvertempStatus_oDCDC_VCU_02_oKAMA_FP_EPT_0303_c4a03957_Rx
        ComIPduSignalRef = DCDC_StopFault_oDCDC_VCU_02_oKAMA_FP_EPT_0303_807b748b_Rx
        ComIPduSignalRef = OBC_DCDC_KL30Error_oDCDC_VCU_02_oKAMA_FP_EPT_0303_2196d055_Rx
        ComPduIdRef = DCDC_VCU_02_oKAMA_FP_EPT_0303_0576f9fb_Rx
      BMS_Batcode_oKAMA_FP_EPT_0303_2af9015e_Rx (ComIPdu):
        ComIPduDirection = RECEIVE
        ComIPduType = NORMAL
        ComIPduHandleId = 7
        ComIPduSignalProcessing = DEFERRED
        ComIPduCancellationSupport = false
        ComIPduGroupRef = VCU_oKAMA_FP_EPT_0303_Rx_07e8d111
        ComIPduSignalRef = BMS_BatCode1_oBMS_Batcode_oKAMA_FP_EPT_0303_fc10543e_Rx
        ComIPduSignalRef = BMS_BatCode2_oBMS_Batcode_oKAMA_FP_EPT_0303_350f5c81_Rx
        ComIPduSignalRef = BMS_BatCode3_oBMS_Batcode_oKAMA_FP_EPT_0303_c4d5592b_Rx
        ComIPduSignalRef = BMS_BatCode4_oBMS_Batcode_oKAMA_FP_EPT_0303_7c404bbe_Rx
        ComIPduSignalRef = BMS_BatCode5_oBMS_Batcode_oKAMA_FP_EPT_0303_8d9a4e14_Rx
        ComIPduSignalRef = BMS_BatCode6_oBMS_Batcode_oKAMA_FP_EPT_0303_448546ab_Rx
        ComIPduSignalRef = BMS_BatCodeFrameLength_oBMS_Batcode_oKAMA_FP_EPT_0303_18e1f1a2_Rx
        ComIPduSignalRef = BMS_BatCodeFrameNO_oBMS_Batcode_oKAMA_FP_EPT_0303_778b8df2_Rx
        ComPduIdRef = BMS_Batcode_oKAMA_FP_EPT_0303_2af9015e_Rx
      BMS_PreCharge_oBMS_status_oKAMA_FP_EPT_0303_314f9283_Rx (ComSignal):
        ComBitPosition = 15
        ComBitSize = 4
        ComSignalEndianness = BIG_ENDIAN
        ComSignalInitValue = 0
        ComSignalType = UINT8
        ComTimeout = 0
        ComSignalAccess = ACCESS_UNCLEAR
        ComHandleId = 150
        ComSystemTemplateSystemSignalRef = BMS_PreCharge
      MessageCounter_7A_oMCU_VCU_1_oKAMA_FP_EPT_0303_d9a8a6b6_Rx (ComSignal):
        ComBitPosition = 51
        ComBitSize = 4
        ComSignalEndianness = BIG_ENDIAN
        ComSignalInitValue = 0
        ComSignalType = UINT8
        ComTimeout = 0
        ComSignalAccess = ACCESS_UNCLEAR
        ComHandleId = 418
        ComSystemTemplateSystemSignalRef = MessageCounter_7A
