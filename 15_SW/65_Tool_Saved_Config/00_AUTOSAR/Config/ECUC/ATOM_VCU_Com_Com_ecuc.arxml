[part 2 of 2: package /ActiveEcuC]
AUTOSAR XML (schema 00048)
package /ActiveEcuC  (continued)
  module config Com: implementation-config-variant=VARIANT-PRE-COMPILE, module-description=Com_Impl  (continued)
    ComConfig: ComConfigurationId=0, ComRxDeferredNotificationCacheSize=0, ComRxImmediateNotificationCacheSize=0  (continued)
      VCU_PlugInChrgInfo1_oKAMA_FP_EPSChassis1_0303_f0a9ba25_Tx (ComIPdu):
        ComIPduDirection = SEND
        ComIPduType = NORMAL
        ComIPduHandleId = 14
        ComIPduSignalProcessing = DEFERRED
        ComIPduCancellationSupport = false
        ComIPduGroupRef = VCU_oKAMA_FP_EPSChassis1_0303_Tx_56dad513
        ComIPduSignalRef = Checksum_27E_oVCU_PlugInChrgInfo1_oKAMA_FP_EPSChassis1_0303_b28f9723_Tx
        ComIPduSignalRef = MessageCounter_27E_oVCU_PlugInChrgInfo1_oKAMA_FP_EPSChassis1_0303_1b9bd40f_Tx
        ComIPduSignalRef = VCU_DegradedHVCharging_oVCU_PlugInChrgInfo1_oKAMA_FP_EPSChassis1_0303_56c601cc_Tx
        ComIPduSignalRef = VCU_EnergyChargeSession_oVCU_PlugInChrgInfo1_oKAMA_FP_EPSChassis1_0303_b775b774_Tx
        ComIPduSignalRef = VCU_HVBatTargetSoC_oVCU_PlugInChrgInfo1_oKAMA_FP_EPSChassis1_0303_8fff7a08_Tx
        ComIPduSignalRef = VCU_UnavailHVCharging_oVCU_PlugInChrgInfo1_oKAMA_FP_EPSChassis1_0303_7c7a1d0b_Tx
        ComIPduSignalRef = VCU_UnavailHVChgReason_oVCU_PlugInChrgInfo1_oKAMA_FP_EPSChassis1_0303_200fdde8_Tx
        ComIPduSignalRef = VCU_chrgSystemStatus_oVCU_PlugInChrgInfo1_oKAMA_FP_EPSChassis1_0303_b8a9874c_Tx
        ComIPduSignalRef = VCU_faultChrgMultPlugs_oVCU_PlugInChrgInfo1_oKAMA_FP_EPSChassis1_0303_502ef6e5_Tx
        ComIPduSignalRef = remainChrgTime_oVCU_PlugInChrgInfo1_oKAMA_FP_EPSChassis1_0303_c7376de6_Tx
        ComPduIdRef = VCU_PlugInChrgInfo1_oKAMA_FP_EPSChassis1_0303_f0a9ba25_Tx
        ComTxIPdu: ComMinimumDelayTime=0, ComTxIPduUnusedAreasDefault=0
          ComTxModeTrue
            ComTxMode: ComTxModeMode=PERIODIC, ComTxModeTimeOffset=0, ComTxModeTimePeriod=0.5
          ComTxModeFalse
            ComTxMode: ComTxModeMode=PERIODIC, ComTxModeTimeOffset=0, ComTxModeTimePeriod=0.5
      11 x ComSignal, all with ComSignalEndianness=BIG_ENDIAN, ComTimeout=0, ComSignalAccess=ACCESS_UNCLEAR:
        MCU_DmpCTrqCurr_oMCU_Status_oKAMA_FP_EPT_0303_5055b05e_Rx: ComBitPosition=55, ComBitSize=8, ComSignalInitValue=0, ComSignalType=UINT8, ComHandleId=351, ComSystemTemplateSystemSignalRef=MCU_DmpCTrqCurr
        BMS_status_oBMS_status_oKAMA_FP_EPT_0303_249dab61_Rx: ComBitPosition=7, ComBitSize=4, ComSignalInitValue=0, ComSignalType=UINT8, ComHandleId=182, ComSystemTemplateSystemSignalRef=BMS_status
        MessageCounter_5D_oIBS_Status3_oKAMA_FP_EPSChassis1_0303_50c348b0_Rx: ComBitPosition=51, ComBitSize=4, ComSignalInitValue=0, ComSignalType=UINT8, ComHandleId=413, ComSystemTemplateSystemSignalRef=MessageCounter_5D
        MCU_UdcCurr_oMCU_VCU_1_oKAMA_FP_EPT_0303_ad4a2a55_Rx: ComBitPosition=12, ComBitSize=10, ComSignalInitValue=0, ComSignalType=UINT16, ComHandleId=379, ComSystemTemplateSystemSignalRef=MCU_UdcCurr
        MMI_AirDistributionModeReq_oDonorCar_MMI_AC_Command_oKAMA_FP_EPT_0303_85b76135_Rx: ComBitPosition=18, ComBitSize=3, ComSignalInitValue=7, ComSignalType=UINT8, ComHandleId=398, ComSystemTemplateSystemSignalRef=MMI_AirDistributionModeReq
        OBC_S2State_oOBC_VCU_CHRGSTATION_ST_oKAMA_FP_EPT_0303_ae3ab9ae_Rx: ComBitPosition=33, ComBitSize=2, ComSignalInitValue=0, ComSignalType=UINT8, ComHandleId=469, ComSystemTemplateSystemSignalRef=OBC_S2State
        DCDC_FaultStatus_oDCDC_VCU_02_oKAMA_FP_EPT_0303_c1f47714_Rx: ComBitPosition=7, ComBitSize=2, ComSignalInitValue=0, ComSignalType=UINT8, ComHandleId=205, ComSystemTemplateSystemSignalRef=DCDC_FaultStatus
        BMS_ErrorCellTempDiff_oBMS_ErrorInfo1_oKAMA_FP_EPT_0303_df89aaaf_Rx: ComBitPosition=17, ComBitSize=2, ComSignalInitValue=0, ComSignalType=UINT8, ComHandleId=104, ComSystemTemplateSystemSignalRef=BMS_ErrorCellTempDiff
        BMS_MaxCellTemp_oBMS_Temp_oKAMA_FP_EPT_0303_19e08cd0_Rx: ComBitPosition=23, ComBitSize=8, ComSignalInitValue=255, ComSignalType=UINT8, ComHandleId=135, ComSystemTemplateSystemSignalRef=BMS_MaxCellTemp
        Checksum_5B_oIBS_Status2_oKAMA_FP_EPSChassis1_0303_47965d6c_Rx: ComBitPosition=63, ComBitSize=8, ComSignalInitValue=0, ComSignalType=UINT8, ComHandleId=189, ComSystemTemplateSystemSignalRef=Checksum_5B
        Checksum_27A_oVCU_PwrtrainRequests_oKAMA_FP_EPSChassis1_0303_e8e65a6e_Tx: ComBitPosition=63, ComBitSize=8, ComSignalInitValue=0, ComSignalType=UINT8, ComTransferProperty=PENDING, ComHandleId=2, ComSystemTemplateSystemSignalRef=Checksum_27A
      3 x ComIPdu, all with ComIPduType=NORMAL, ComIPduSignalProcessing=DEFERRED, ComIPduCancellationSupport=false:
        IBS_Status1_oKAMA_FP_EPSChassis1_0303_bbfa0311_Rx: ComIPduDirection=RECEIVE, ComIPduHandleId=36, ComIPduGroupRef=VCU_oKAMA_FP_EPSChassis1_0303_Rx_00807295, ComIPduSignalRef=Checksum_5A_oIBS_Status1_oKAMA_FP_EPSChassis1_0303_debec027_Rx, ComIPduSignalRef=IBS_BrakePushrodStroke_oIBS_Status1_oKAMA_FP_EPSChassis1_0303_6f81e2a3_Rx, ComIPduSignalRef=IBS_BrakepedalStatus_oIBS_Status1_oKAMA_FP_EPSChassis1_0303_926e2309_Rx, ComIPduSignalRef=IBS_MasterCylinderPressure_oIBS_Status1_oKAMA_FP_EPSChassis1_0303_f5093d5f_Rx, ComIPduSignalRef=IBS_PlungerPressure_oIBS_Status1_oKAMA_FP_EPSChassis1_0303_f8ba5043_Rx, ComIPduSignalRef=MessageCounter_5A_oIBS_Status1_oKAMA_FP_EPSChassis1_0303_f21eafaa_Rx, ComPduIdRef=IBS_Status1_oKAMA_FP_EPSChassis1_0303_bbfa0311_Rx
        REPS_DM1_oKAMA_FP_EPSChassis1_0303_940d8c44_Rx: ComIPduDirection=RECEIVE, ComIPduHandleId=57, ComIPduGroupRef=VCU_oKAMA_FP_EPSChassis1_0303_Rx_00807295, ComIPduSignalRef=DM1_Byte0_oREPS_DM1_oKAMA_FP_EPSChassis1_0303_5761fb9b_Rx, ComIPduSignalRef=DM1_Byte1_oREPS_DM1_oKAMA_FP_EPSChassis1_0303_d791ec84_Rx, ComIPduSignalRef=DM1_Byte2_oREPS_DM1_oKAMA_FP_EPSChassis1_0303_8df0d3e4_Rx, ComIPduSignalRef=DM1_Byte3_oREPS_DM1_oKAMA_FP_EPSChassis1_0303_0d00c4fb_Rx, ComIPduSignalRef=DM1_Byte4_oREPS_DM1_oKAMA_FP_EPSChassis1_0303_3932ad24_Rx, ComIPduSignalRef=DM1_Byte5_oREPS_DM1_oKAMA_FP_EPSChassis1_0303_b9c2ba3b_Rx, ComIPduSignalRef=DM1_Byte6_oREPS_DM1_oKAMA_FP_EPSChassis1_0303_e3a3855b_Rx, ComIPduSignalRef=DM1_Byte7_oREPS_DM1_oKAMA_FP_EPSChassis1_0303_63539244_Rx, ComPduIdRef=REPS_DM1_oKAMA_FP_EPSChassis1_0303_940d8c44_Rx
        VCU_MCU02_oKAMA_FP_EPT_0303_e5ff9a82_Tx: ComIPduDirection=SEND, ComIPduHandleId=8, ComIPduGroupRef=VCU_oKAMA_FP_EPT_0303_Tx_51b27697, ComIPduSignalRef=Checksum_047_oVCU_MCU02_oKAMA_FP_EPT_0303_24cd2422_Tx, ComIPduSignalRef=MessageCounter_047_oVCU_MCU02_oKAMA_FP_EPT_0303_0b0aebf5_Tx, ComIPduSignalRef=VCU_MaxTorqueGradient_oVCU_MCU02_oKAMA_FP_EPT_0303_429d7ce1_Tx, ComIPduSignalRef=VCU_MaxTorqueLimit_oVCU_MCU02_oKAMA_FP_EPT_0303_7fbf98d7_Tx, ComIPduSignalRef=VCU_MinTorqueLimit_oVCU_MCU02_oKAMA_FP_EPT_0303_3137fd7d_Tx, ComIPduSignalRef=VCU_TrqThresholdDampgCtl_oVCU_MCU02_oKAMA_FP_EPT_0303_3cbe5fa0_Tx, ComPduIdRef=VCU_MCU02_oKAMA_FP_EPT_0303_e5ff9a82_Tx
          ComTxIPdu: ComMinimumDelayTime=0, ComTxIPduUnusedAreasDefault=0
            ComTxModeTrue
              ComTxMode: ComTxModeMode=PERIODIC, ComTxModeTimeOffset=0, ComTxModeTimePeriod=0.02
            ComTxModeFalse
              ComTxMode: ComTxModeMode=PERIODIC, ComTxModeTimeOffset=0, ComTxModeTimePeriod=0.02
      44 x ComSignal, all with ComTimeout=0, ComSignalAccess=ACCESS_UNCLEAR:
        BMS_CoolCommand_oBMS_TCU_oKAMA_FP_EPT_0303_c9d4657f_Rx: ComBitPosition=43, ComBitSize=3, ComSignalEndianness=BIG_ENDIAN, ComSignalInitValue=0, ComSignalType=UINT8, ComHandleId=91, ComSystemTemplateSystemSignalRef=BMS_CoolCommand
        BMS_ErrorBSUBalance_oBMS_ErrorInfo1_oKAMA_FP_EPT_0303_b679af66_Rx: ComBitPosition=24, ComBitSize=1, ComSignalEndianness=BIG_ENDIAN, ComSignalInitValue=0, ComSignalType=BOOLEAN, ComHandleId=96, ComSystemTemplateSystemSignalRef=BMS_ErrorBSUBalance
        MCU_ActualSpeed_oMCU_VCU_1_oKAMA_FP_EPT_0303_0995a35d_Rx: ComBitPosition=39, ComBitSize=16, ComSignalEndianness=BIG_ENDIAN, ComSignalInitValue=32768, ComSignalType=UINT16, ComHandleId=345, ComSystemTemplateSystemSignalRef=MCU_ActualSpeed
        IBS_AVHActive_oIBS_Status2_oKAMA_FP_EPSChassis1_0303_4618a6a7_Rx: ComBitPosition=34, ComBitSize=1, ComSignalEndianness=BIG_ENDIAN, ComSignalInitValue=0, ComSignalType=BOOLEAN, ComHandleId=281, ComSystemTemplateSystemSignalRef=IBS_AVHActive
        BMS_DisChgCurr_oBMS_CurrentLimit_oKAMA_FP_EPT_0303_85919879_Rx: ComBitPosition=39, ComBitSize=16, ComSignalEndianness=BIG_ENDIAN, ComSignalInitValue=10000, ComSignalType=UINT16, ComHandleId=94, ComSystemTemplateSystemSignalRef=BMS_DisChgCurr
        EBA_TargetDecelReq_oADAS_AEB_oKAMA_FP_EPSChassis1_0303_e76d1804_Rx: ComBitPosition=3, ComBitSize=1, ComSignalEndianness=BIG_ENDIAN, ComSignalInitValue=0, ComSignalType=BOOLEAN, ComHandleId=250, ComSystemTemplateSystemSignalRef=EBA_TargetDecelReq
        VCU_DegradedPerformance_oVCU_HMIsignals_oKAMA_FP_EPSChassis1_0303_e756a720_Tx: ComBitPosition=9, ComBitSize=1, ComSignalEndianness=BIG_ENDIAN, ComSignalInitValue=0, ComSignalType=BOOLEAN, ComTransferProperty=PENDING, ComHandleId=54, ComSystemTemplateSystemSignalRef=VCU_DegradedPerformance
        BMS_StateRelay8_oBMS_DIRelayState_oKAMA_FP_EPT_0303_ca716241_Rx: ComBitPosition=23, ComBitSize=2, ComSignalEndianness=BIG_ENDIAN, ComSignalInitValue=0, ComSignalType=UINT8, ComHandleId=173, ComSystemTemplateSystemSignalRef=BMS_StateRelay8
        EVCOM_OverCurDropFreqError_oEVCOM_State_oKAMA_FP_EPT_0303_a0df61a8_Rx: ComBitPosition=1, ComBitSize=1, ComSignalEndianness=BIG_ENDIAN, ComSignalInitValue=0, ComSignalType=BOOLEAN, ComHandleId=270, ComSystemTemplateSystemSignalRef=EVCOM_OverCurDropFreqError
        IBS_HDCAvailable_oIBS_Status2_oKAMA_FP_EPSChassis1_0303_8c663fdd_Rx: ComBitPosition=28, ComBitSize=1, ComSignalEndianness=BIG_ENDIAN, ComSignalInitValue=0, ComSignalType=BOOLEAN, ComHandleId=312, ComSystemTemplateSystemSignalRef=IBS_HDCAvailable
        OBC_ACVoltHighFault_oOBC_Error_STATUS_oKAMA_FP_EPT_0303_b3ecad4f_Rx: ComBitPosition=11, ComBitSize=1, ComSignalEndianness=BIG_ENDIAN, ComSignalInitValue=0, ComSignalType=BOOLEAN, ComHandleId=433, ComSystemTemplateSystemSignalRef=OBC_ACVoltHighFault
        MCU_DataVer_oMCU_SoftwareNumber_oKAMA_FP_EPT_0303_066f41da_Rx: ComBitPosition=23, ComBitSize=16, ComSignalEndianness=BIG_ENDIAN, ComSignalInitValue=0, ComSignalType=UINT16, ComHandleId=350, ComSystemTemplateSystemSignalRef=MCU_DataVer
        OBC_ComFault1_oOBC_Error_STATUS_oKAMA_FP_EPT_0303_4657bd7f_Rx: ComBitPosition=27, ComBitSize=1, ComSignalEndianness=BIG_ENDIAN, ComSignalInitValue=0, ComSignalType=BOOLEAN, ComHandleId=444, ComSystemTemplateSystemSignalRef=OBC_ComFault1
        APTC_HVPowerUpReq_oAPTC_TCU_oKAMA_FP_EPT_0303_36343390_Rx: ComBitPosition=0, ComBitSize=1, ComSignalEndianness=BIG_ENDIAN, ComSignalInitValue=0, ComSignalType=BOOLEAN, ComHandleId=41, ComSystemTemplateSystemSignalRef=APTC_HVPowerUpReq
        IBS_EPBTxtdisplay_oIBS_Status2_oKAMA_FP_EPSChassis1_0303_a23c4ae6_Rx: ComBitPosition=3, ComBitSize=4, ComSignalEndianness=BIG_ENDIAN, ComSignalInitValue=0, ComSignalType=UINT8, ComHandleId=296, ComSystemTemplateSystemSignalRef=IBS_EPBTxtdisplay
        BMS_BatProDatDay_oBMS_PRO_oKAMA_FP_EPT_0303_7f734584_Rx: ComBitPosition=23, ComBitSize=8, ComSignalEndianness=BIG_ENDIAN, ComSignalInitValue=0, ComSignalType=UINT8, ComHandleId=77, ComSystemTemplateSystemSignalRef=BMS_BatProDatDay
        BMS_ErrorChaCurrentOver_oBMS_ErrorInfo1_oKAMA_FP_EPT_0303_fb588ab7_Rx: ComBitPosition=11, ComBitSize=2, ComSignalEndianness=BIG_ENDIAN, ComSignalInitValue=0, ComSignalType=UINT8, ComHandleId=109, ComSystemTemplateSystemSignalRef=BMS_ErrorChaCurrentOver
        BMS_SumDisChgkwh_oBMS_DisChargeEnergy_oKAMA_FP_EPT_0303_999808cc_Rx: ComBitPosition=7, ComBitSize=24, ComSignalEndianness=BIG_ENDIAN, ComSignalInitValue=0, ComSignalType=UINT32, ComHandleId=175, ComSystemTemplateSystemSignalRef=BMS_SumDisChgkwh
        AEB_BrakeReqFunction_oADAS_AEB_oKAMA_FP_EPSChassis1_0303_6fc40070_Rx: ComBitPosition=31, ComBitSize=3, ComSignalEndianness=BIG_ENDIAN, ComSignalInitValue=0, ComSignalType=UINT8, ComHandleId=29, ComSystemTemplateSystemSignalRef=AEB_BrakeReqFunction
        MessageCounter_273_oVCU_DCDC_oKAMA_FP_EPT_0303_3bb045a1_Tx: ComBitPosition=51, ComBitSize=4, ComSignalEndianness=BIG_ENDIAN, ComSignalInitValue=0, ComSignalType=UINT8, ComTransferProperty=PENDING, ComHandleId=22, ComSystemTemplateSystemSignalRef=MessageCounter_273
        VCU_NeutralLockStatus_oVCU_PwrtrainRequests_oKAMA_FP_EPSChassis1_0303_7d881b5a_Tx: ComBitPosition=3, ComBitSize=2, ComSignalEndianness=BIG_ENDIAN, ComSignalInitValue=0, ComSignalType=UINT8, ComTransferProperty=PENDING, ComHandleId=93, ComSystemTemplateSystemSignalRef=VCU_NeutralLockStatus
        AC_OnState_oTCU_ACStatusInfo_oKAMA_FP_EPT_0303_e706dad0_Rx: ComBitPosition=20, ComBitSize=1, ComSignalEndianness=BIG_ENDIAN, ComSignalInitValue=0, ComSignalType=BOOLEAN, ComHandleId=17, ComSystemTemplateSystemSignalRef=AC_OnState
        AEB_ABAReq_oADAS_AEB_oKAMA_FP_EPSChassis1_0303_614aadae_Rx: ComBitPosition=2, ComBitSize=1, ComSignalEndianness=BIG_ENDIAN, ComSignalInitValue=0, ComSignalType=BOOLEAN, ComHandleId=25, ComSystemTemplateSystemSignalRef=AEB_ABAReq
        UDS_EPT_BootCmd1_oUds_EPT_Boot_Request_oKAMA_FP_EPT_0303_d87cfbd7_Rx: ComBitPosition=0, ComBitSize=8, ComSignalEndianness=LITTLE_ENDIAN, ComSignalInitValue=0, ComSignalType=UINT8, ComHandleId=509, ComSystemTemplateSystemSignalRef=UDS_EPT_BootCmd1
        BMS_MaxCellVoltage_oBMS_CellVoltage1_oKAMA_FP_EPT_0303_0e72448e_Rx: ComBitPosition=7, ComBitSize=16, ComSignalEndianness=BIG_ENDIAN, ComSignalInitValue=0, ComSignalType=UINT16, ComHandleId=138, ComSystemTemplateSystemSignalRef=BMS_MaxCellVoltage
        IBS_AEBActive_oIBS_Status2_oKAMA_FP_EPSChassis1_0303_6b8bf521_Rx: ComBitPosition=29, ComBitSize=1, ComSignalEndianness=BIG_ENDIAN, ComSignalInitValue=0, ComSignalType=BOOLEAN, ComHandleId=280, ComSystemTemplateSystemSignalRef=IBS_AEBActive
        IBS_ESCYawRate_oIBS1_acceleration_oKAMA_FP_EPSChassis1_0303_77ab426f_Rx: ComBitPosition=7, ComBitSize=16, ComSignalEndianness=BIG_ENDIAN, ComSignalInitValue=32768, ComSignalType=UINT16, ComHandleId=300, ComSystemTemplateSystemSignalRef=IBS_ESCYawRate
        IBS_RLMovingDirection_oIBS_WheelSpeed_oKAMA_FP_EPSChassis1_0303_4b4447ef_Rx: ComBitPosition=54, ComBitSize=2, ComSignalEndianness=BIG_ENDIAN, ComSignalInitValue=0, ComSignalType=UINT8, ComHandleId=319, ComSystemTemplateSystemSignalRef=IBS_RLMovingDirection
        MCU_bReadyHv_oMCU_DeratingStatus_oKAMA_FP_EPT_0303_1d3c6b43_Rx: ComBitPosition=15, ComBitSize=1, ComSignalEndianness=BIG_ENDIAN, ComSignalInitValue=0, ComSignalType=BOOLEAN, ComHandleId=392, ComSystemTemplateSystemSignalRef=MCU_bReadyHv
        TCU_HVPwrState_oTCU_Status_oKAMA_FP_EPT_0303_14f21212_Rx: ComBitPosition=36, ComBitSize=2, ComSignalEndianness=BIG_ENDIAN, ComSignalInitValue=0, ComSignalType=UINT8, ComHandleId=503, ComSystemTemplateSystemSignalRef=TCU_HVPwrState
        VCU_TorqueRequestAvailable_oVCU_chassis_oKAMA_FP_EPSChassis1_0303_cd911a5c_Tx: ComBitPosition=10, ComBitSize=1, ComSignalEndianness=BIG_ENDIAN, ComSignalInitValue=0, ComSignalType=BOOLEAN, ComTransferProperty=PENDING, ComHandleId=113, ComSystemTemplateSystemSignalRef=VCU_TorqueRequestAvailable
        MMI_LeftSetTemp_oDonorCar_MMI_AC_Command_oKAMA_FP_EPT_0303_0867569c_Rx: ComBitPosition=28, ComBitSize=5, ComSignalEndianness=BIG_ENDIAN, ComSignalInitValue=0, ComSignalType=UINT8, ComHandleId=403, ComSystemTemplateSystemSignalRef=MMI_LeftSetTemp
        BMS_AbortErrorVoltage_oBMS_ChargeStop_oKAMA_FP_EPT_0303_6dcfc714_Rx: ComBitPosition=9, ComBitSize=2, ComSignalEndianness=BIG_ENDIAN, ComSignalInitValue=0, ComSignalType=UINT8, ComHandleId=59, ComSystemTemplateSystemSignalRef=BMS_AbortErrorVoltage
        YRS_AxStatus_oYRS_2_oKAMA_FP_EPSChassis1_0303_b2c11dfd_Rx: ComBitPosition=52, ComBitSize=4, ComSignalEndianness=LITTLE_ENDIAN, ComSignalInitValue=0, ComSignalType=UINT8, ComHandleId=513, ComSystemTemplateSystemSignalRef=YRS_AxStatus
        Checksum_375_oDCDC_VCU_01_oKAMA_FP_EPT_0303_2aaad358_Rx: ComBitPosition=63, ComBitSize=8, ComSignalEndianness=BIG_ENDIAN, ComSignalInitValue=0, ComSignalType=UINT8, ComHandleId=201, ComSystemTemplateSystemSignalRef=Checksum_375
        IBS_BrakePushrodStroke_oIBS_Status1_oKAMA_FP_EPSChassis1_0303_6f81e2a3_Rx: ComBitPosition=39, ComBitSize=12, ComSignalEndianness=BIG_ENDIAN, ComSignalInitValue=320, ComSignalType=UINT16, ComHandleId=285, ComSystemTemplateSystemSignalRef=IBS_BrakePushrodStroke
        BMS_ErrorPreChaFailed_oBMS_ErrorInfo1_oKAMA_FP_EPT_0303_9c1be185_Rx: ComBitPosition=26, ComBitSize=1, ComSignalEndianness=BIG_ENDIAN, ComSignalInitValue=0, ComSignalType=BOOLEAN, ComHandleId=120, ComSystemTemplateSystemSignalRef=BMS_ErrorPreChaFailed
        DCDC_HVInputCurrent_oDCDC_VCU_01_oKAMA_FP_EPT_0303_2fb84430_Rx: ComBitPosition=39, ComBitSize=8, ComSignalEndianness=BIG_ENDIAN, ComSignalInitValue=0, ComSignalType=UINT8, ComHandleId=206, ComSystemTemplateSystemSignalRef=DCDC_HVInputCurrent
        Checksum_151_oVCU_AccPedal_oKAMA_FP_EPSChassis1_0303_f8a47a0f_Tx: ComBitPosition=63, ComBitSize=8, ComSignalEndianness=BIG_ENDIAN, ComSignalInitValue=0, ComSignalType=UINT8, ComTransferProperty=PENDING, ComHandleId=8, ComSystemTemplateSystemSignalRef=Checksum_151
        BMS_RunHeatStatus_oBMS_status_oKAMA_FP_EPT_0303_03521515_Rx: ComBitPosition=23, ComBitSize=4, ComSignalEndianness=BIG_ENDIAN, ComSignalInitValue=0, ComSignalType=UINT8, ComHandleId=157, ComSystemTemplateSystemSignalRef=BMS_RunHeatStatus
        MCU_ActTrqValid_oMCU_VCU_1_oKAMA_FP_EPT_0303_0ddbe723_Rx: ComBitPosition=52, ComBitSize=1, ComSignalEndianness=BIG_ENDIAN, ComSignalInitValue=0, ComSignalType=BOOLEAN, ComHandleId=343, ComSystemTemplateSystemSignalRef=MCU_ActTrqValid
        DM1_Byte0_oREPS_DM1_oKAMA_FP_EPSChassis1_0303_5761fb9b_Rx: ComBitPosition=7, ComBitSize=8, ComSignalEndianness=BIG_ENDIAN, ComSignalInitValue=0, ComSignalType=UINT8, ComHandleId=226, ComSystemTemplateSystemSignalRef=DM1_Byte0
        BMS_StateDI6_oBMS_DIRelayState_oKAMA_FP_EPT_0303_622bb180_Rx: ComBitPosition=29, ComBitSize=2, ComSignalEndianness=BIG_ENDIAN, ComSignalInitValue=0, ComSignalType=UINT8, ComHandleId=166, ComSystemTemplateSystemSignalRef=BMS_StateDI6
        IBS_EPBSwitchPositionValid_oIBS_Status2_oKAMA_FP_EPSChassis1_0303_fb017e88_Rx: ComBitPosition=37, ComBitSize=1, ComSignalEndianness=BIG_ENDIAN, ComSignalInitValue=0, ComSignalType=BOOLEAN, ComHandleId=294, ComSystemTemplateSystemSignalRef=IBS_EPBSwitchPositionValid
      IBS1_acceleration_oKAMA_FP_EPSChassis1_0303_92cce59a_Rx (ComIPdu):
        ComIPduDirection = RECEIVE
        ComIPduType = NORMAL
        ComIPduHandleId = 35
        ComIPduSignalProcessing = DEFERRED
        ComIPduCancellationSupport = false
        ComIPduGroupRef = VCU_oKAMA_FP_EPSChassis1_0303_Rx_00807295
        ComIPduSignalRef = Checksum_5C_oIBS1_acceleration_oKAMA_FP_EPSChassis1_0303_4ba362a6_Rx
        ComIPduSignalRef = IBS_ESCLateralAccle_oIBS1_acceleration_oKAMA_FP_EPSChassis1_0303_36c377fc_Rx
        ComIPduSignalRef = IBS_ESCLongitudinalAccle_oIBS1_acceleration_oKAMA_FP_EPSChassis1_0303_fc10a9c9_Rx
        ComIPduSignalRef = IBS_ESCYawRate_oIBS1_acceleration_oKAMA_FP_EPSChassis1_0303_77ab426f_Rx
        ComIPduSignalRef = MessageCounter_5C_oIBS1_acceleration_oKAMA_FP_EPSChassis1_0303_8ed323bd_Rx
        ComPduIdRef = IBS1_acceleration_oKAMA_FP_EPSChassis1_0303_92cce59a_Rx
      14 x ComSignal, all with ComTimeout=0, ComSignalAccess=ACCESS_UNCLEAR:
        MCU_Isd_oMCU_Status_oKAMA_FP_EPT_0303_30343673_Rx: ComBitPosition=11, ComBitSize=12, ComSignalEndianness=BIG_ENDIAN, ComSignalInitValue=2047, ComSignalType=UINT16, ComHandleId=365, ComSystemTemplateSystemSignalRef=MCU_Isd
        VCU_HVBatCriFail_oVCU_HMIsignals_oKAMA_FP_EPSChassis1_0303_f3c8276f_Tx: ComBitPosition=4, ComBitSize=1, ComSignalEndianness=BIG_ENDIAN, ComSignalInitValue=0, ComSignalType=BOOLEAN, ComTransferProperty=PENDING, ComHandleId=68, ComSystemTemplateSystemSignalRef=VCU_HVBatCriFail
        remainChrgTime_oVCU_PlugInChrgInfo1_oKAMA_FP_EPSChassis1_0303_c7376de6_Tx: ComBitPosition=15, ComBitSize=10, ComSignalEndianness=BIG_ENDIAN, ComSignalInitValue=0, ComSignalType=UINT16, ComTransferProperty=PENDING, ComHandleId=135, ComSystemTemplateSystemSignalRef=remainChrgTime
        Checksum_130_oYRS_1_oKAMA_FP_EPSChassis1_0303_8179344a_Rx: ComBitPosition=56, ComBitSize=8, ComSignalEndianness=LITTLE_ENDIAN, ComSignalInitValue=0, ComSignalType=UINT8, ComHandleId=198, ComSystemTemplateSystemSignalRef=Checksum_130
        EVCOM_CompDeviceInternTempError_oEVCOM_State_oKAMA_FP_EPT_0303_c90eb0b4_Rx: ComBitPosition=15, ComBitSize=8, ComSignalEndianness=BIG_ENDIAN, ComSignalInitValue=40, ComSignalType=UINT8, ComHandleId=268, ComSystemTemplateSystemSignalRef=EVCOM_CompDeviceInternTempError
        MCU_TempCurrStr_oMCU_Temperature2_oKAMA_FP_EPT_0303_3aaa0a70_Rx: ComBitPosition=31, ComBitSize=8, ComSignalEndianness=BIG_ENDIAN, ComSignalInitValue=255, ComSignalType=UINT8, ComHandleId=373, ComSystemTemplateSystemSignalRef=MCU_TempCurrStr
        MessageCounter_59_oIBS_WheelPulse_oKAMA_FP_EPSChassis1_0303_abb8d569_Rx: ComBitPosition=51, ComBitSize=4, ComSignalEndianness=BIG_ENDIAN, ComSignalInitValue=0, ComSignalType=UINT8, ComHandleId=419, ComSystemTemplateSystemSignalRef=MessageCounter_59
        MCU_bDernUndrIdc_oMCU_DeratingStatus_oKAMA_FP_EPT_0303_a1c5846c_Rx: ComBitPosition=1, ComBitSize=1, ComSignalEndianness=BIG_ENDIAN, ComSignalInitValue=0, ComSignalType=BOOLEAN, ComHandleId=389, ComSystemTemplateSystemSignalRef=MCU_bDernUndrIdc
        VCU_DrvDirCtrlFlt_oVCU_HMIsignals_oKAMA_FP_EPSChassis1_0303_e23b1903_Tx: ComBitPosition=10, ComBitSize=1, ComSignalEndianness=BIG_ENDIAN, ComSignalInitValue=0, ComSignalType=BOOLEAN, ComTransferProperty=PENDING, ComHandleId=58, ComSystemTemplateSystemSignalRef=VCU_DrvDirCtrlFlt
        BMS_NegRelayStatus_oBMS_DIRelayState_oKAMA_FP_EPT_0303_942155bb_Rx: ComBitPosition=3, ComBitSize=2, ComSignalEndianness=BIG_ENDIAN, ComSignalInitValue=0, ComSignalType=UINT8, ComHandleId=146, ComSystemTemplateSystemSignalRef=BMS_NegRelayStatus
        DM3_Byte5_oREPS_DM3_oKAMA_FP_EPSChassis1_0303_eafd614f_Rx: ComBitPosition=47, ComBitSize=8, ComSignalEndianness=BIG_ENDIAN, ComSignalInitValue=0, ComSignalType=UINT8, ComHandleId=247, ComSystemTemplateSystemSignalRef=DM3_Byte5
        OBC_SecordarySideOvertempStatus_oOBC_Error_STATUS_oKAMA_FP_EPT_0303_1d8699c7_Rx: ComBitPosition=28, ComBitSize=1, ComSignalEndianness=BIG_ENDIAN, ComSignalInitValue=0, ComSignalType=BOOLEAN, ComHandleId=471, ComSystemTemplateSystemSignalRef=OBC_SecordarySideOvertempStatus
        Uds_EPT_bootResponse_Byte7_oUds_EPT_Boot_Response_oKAMA_FP_EPT_0303_c962477e_Tx: ComBitPosition=56, ComBitSize=8, ComSignalEndianness=LITTLE_ENDIAN, ComSignalInitValue=0, ComSignalType=UINT8, ComTransferProperty=TRIGGERED_WITHOUT_REPETITION, ComHandleId=32, ComSystemTemplateSystemSignalRef=Uds_EPT_bootResponse_Byte7
        VCU_CriSysFailure_oVCU_HMIsignals_oKAMA_FP_EPSChassis1_0303_2d6a9a80_Tx: ComBitPosition=7, ComBitSize=1, ComSignalEndianness=BIG_ENDIAN, ComSignalInitValue=0, ComSignalType=BOOLEAN, ComTransferProperty=PENDING, ComHandleId=50, ComSystemTemplateSystemSignalRef=VCU_CriSysFailure
      VCU_POD_oKAMA_FP_EPT_0303_79abac5b_Tx (ComIPdu):
        ComIPduDirection = SEND
        ComIPduType = NORMAL
        ComIPduHandleId = 13
        ComIPduSignalProcessing = DEFERRED
        ComIPduCancellationSupport = false
        ComIPduGroupRef = VCU_oKAMA_FP_EPT_0303_Tx_51b27697
        ComIPduSignalRef = VCU_Enable_DC_Relay_oVCU_POD_oKAMA_FP_EPT_0303_59814884_Tx
        ComPduIdRef = VCU_POD_oKAMA_FP_EPT_0303_79abac5b_Tx
        ComTxIPdu: ComMinimumDelayTime=0, ComTxIPduUnusedAreasDefault=0
          ComTxModeTrue
            ComTxMode: ComTxModeMode=PERIODIC, ComTxModeTimeOffset=0, ComTxModeTimePeriod=0.05
          ComTxModeFalse
            ComTxMode: ComTxModeMode=PERIODIC, ComTxModeTimeOffset=0, ComTxModeTimePeriod=0.05
      17 x ComSignal, all with ComSignalInitValue=0, ComTimeout=0, ComSignalAccess=ACCESS_UNCLEAR:
        VCU_LimpHome_oVCU_HMIsignals_oKAMA_FP_EPSChassis1_0303_c8f6a8f0_Tx: ComBitPosition=13, ComBitSize=1, ComSignalEndianness=BIG_ENDIAN, ComSignalType=BOOLEAN, ComTransferProperty=PENDING, ComHandleId=83, ComSystemTemplateSystemSignalRef=VCU_LimpHome
        DM3_Byte3_oREPS_DM3_oKAMA_FP_EPSChassis1_0303_5e3f1f8f_Rx: ComBitPosition=31, ComBitSize=8, ComSignalEndianness=BIG_ENDIAN, ComSignalType=UINT8, ComHandleId=245, ComSystemTemplateSystemSignalRef=DM3_Byte3
        OBC_InputOverCurrentstatus_S_oOBC_Error_STATUS_oKAMA_FP_EPT_0303_c570ac13_Rx: ComBitPosition=20, ComBitSize=1, ComSignalEndianness=BIG_ENDIAN, ComSignalType=BOOLEAN, ComHandleId=457, ComSystemTemplateSystemSignalRef=OBC_InputOverCurrentstatus_S
        VCU_regenBrakeLightReqVld_oVCU_PwrtrainRequests_oKAMA_FP_EPSChassis1_0303_16471c1d_Tx: ComBitPosition=7, ComBitSize=1, ComSignalEndianness=BIG_ENDIAN, ComSignalType=BOOLEAN, ComTransferProperty=PENDING, ComHandleId=132, ComSystemTemplateSystemSignalRef=VCU_regenBrakeLightReqVld
        BMS_HardVsesion_oBMS_VersionInfor_oKAMA_FP_EPT_0303_0425e35d_Rx: ComBitPosition=15, ComBitSize=8, ComSignalEndianness=BIG_ENDIAN, ComSignalType=UINT8, ComHandleId=128, ComSystemTemplateSystemSignalRef=BMS_HardVsesion
        MMI_AirConditionerPowerKey_oDonorCar_MMI_AC_Command_oKAMA_FP_EPT_0303_e5830600_Rx: ComBitPosition=20, ComBitSize=1, ComSignalEndianness=BIG_ENDIAN, ComSignalType=BOOLEAN, ComHandleId=397, ComSystemTemplateSystemSignalRef=MMI_AirConditionerPowerKey
        BMS_ErrorCellVoltOffline_oBMS_ErrorInfo1_oKAMA_FP_EPT_0303_7ab346be_Rx: ComBitPosition=28, ComBitSize=1, ComSignalEndianness=BIG_ENDIAN, ComSignalType=BOOLEAN, ComHandleId=108, ComSystemTemplateSystemSignalRef=BMS_ErrorCellVoltOffline
        Checksum_5E_oIBS_Torque_oKAMA_FP_EPSChassis1_0303_8de37c45_Rx: ComBitPosition=63, ComBitSize=8, ComSignalEndianness=BIG_ENDIAN, ComSignalType=UINT8, ComHandleId=192, ComSystemTemplateSystemSignalRef=Checksum_5E
        IBS_PlungerPressure_oIBS_Status1_oKAMA_FP_EPSChassis1_0303_f8ba5043_Rx: ComBitPosition=23, ComBitSize=12, ComSignalEndianness=BIG_ENDIAN, ComSignalType=UINT16, ComHandleId=317, ComSystemTemplateSystemSignalRef=IBS_PlungerPressure
        VCU_VLCTorqueRequestActive_oVCU_AccPedal_oKAMA_FP_EPSChassis1_0303_fb9779de_Tx: ComBitPosition=38, ComBitSize=1, ComSignalEndianness=BIG_ENDIAN, ComSignalType=BOOLEAN, ComTransferProperty=PENDING, ComHandleId=119, ComSystemTemplateSystemSignalRef=VCU_VLCTorqueRequestActive
        VCU_VLCTorqueRequestAvailable_oVCU_AccPedal_oKAMA_FP_EPSChassis1_0303_caeb332d_Tx: ComBitPosition=39, ComBitSize=1, ComSignalEndianness=BIG_ENDIAN, ComSignalType=BOOLEAN, ComTransferProperty=PENDING, ComHandleId=120, ComSystemTemplateSystemSignalRef=VCU_VLCTorqueRequestAvailable
        DCDC_OBCTempHighFault_oDCDC_VCU_02_oKAMA_FP_EPT_0303_b05c1fae_Rx: ComBitPosition=16, ComBitSize=1, ComSignalEndianness=BIG_ENDIAN, ComSignalType=BOOLEAN, ComHandleId=213, ComSystemTemplateSystemSignalRef=DCDC_OBCTempHighFault
        DCDC_OutputCurrentHighFault_oDCDC_VCU_02_oKAMA_FP_EPT_0303_efaac618_Rx: ComBitPosition=5, ComBitSize=1, ComSignalEndianness=BIG_ENDIAN, ComSignalType=BOOLEAN, ComHandleId=215, ComSystemTemplateSystemSignalRef=DCDC_OutputCurrentHighFault
        BMS_SysRegInsulationValue_oBMS_Insulation_oKAMA_FP_EPT_0303_00598d60_Rx: ComBitPosition=39, ComBitSize=16, ComSignalEndianness=BIG_ENDIAN, ComSignalType=UINT16, ComHandleId=176, ComSystemTemplateSystemSignalRef=BMS_SysRegInsulationValue
        PEPS_Message_Sts_Checksum_oDonorCar_PEPS_Message_Sts_oKAMA_FP_EPSChassis1_0303_29404510_Rx: ComBitPosition=63, ComBitSize=8, ComSignalEndianness=BIG_ENDIAN, ComSignalType=UINT8, ComHandleId=475, ComSystemTemplateSystemSignalRef=PEPS_Message_Sts_Checksum
        OBC_ACVoltLowFault_oOBC_Error_STATUS_oKAMA_FP_EPT_0303_6eb87a6f_Rx: ComBitPosition=10, ComBitSize=1, ComSignalEndianness=BIG_ENDIAN, ComSignalType=BOOLEAN, ComHandleId=434, ComSystemTemplateSystemSignalRef=OBC_ACVoltLowFault
        YRS_DirectionCalibrationResult_oYRS_7_oKAMA_FP_EPSChassis1_0303_60b7a114_Rx: ComBitPosition=26, ComBitSize=3, ComSignalEndianness=LITTLE_ENDIAN, ComSignalType=UINT8, ComHandleId=519, ComSystemTemplateSystemSignalRef=YRS_DirectionCalibrationResult
      VCU_OdometerInfo_oKAMA_FP_EPSChassis1_0303_60fc5853_Tx (ComIPdu):
        ComIPduDirection = SEND
        ComIPduType = NORMAL
        ComIPduHandleId = 12
        ComIPduSignalProcessing = DEFERRED
        ComIPduCancellationSupport = false
        ComIPduGroupRef = VCU_oKAMA_FP_EPSChassis1_0303_Tx_56dad513
        ComIPduSignalRef = VCU_OdometerInfo_VCU_oVCU_OdometerInfo_oKAMA_FP_EPSChassis1_0303_83395826_Tx
        ComPduIdRef = VCU_OdometerInfo_oKAMA_FP_EPSChassis1_0303_60fc5853_Tx
        ComTxIPdu: ComMinimumDelayTime=0, ComTxIPduUnusedAreasDefault=0
          ComTxModeTrue
            ComTxMode: ComTxModeMode=PERIODIC, ComTxModeTimeOffset=0, ComTxModeTimePeriod=2
          ComTxModeFalse
            ComTxMode: ComTxModeMode=PERIODIC, ComTxModeTimeOffset=0, ComTxModeTimePeriod=2
      APTC_RightCoreTemp_oAPTC_TCU_oKAMA_FP_EPT_0303_a6faa87a_Rx (ComSignal):
        ComBitPosition = 23
        ComBitSize = 8
        ComSignalEndianness = BIG_ENDIAN
        ComSignalInitValue = 40
        ComSignalType = UINT8
        ComTimeout = 0
        ComSignalAccess = ACCESS_UNCLEAR
        ComHandleId = 47
        ComSystemTemplateSystemSignalRef = APTC_RightCoreTemp
      VCU_ActualTorque_oVCU_MCU_7A_oKAMA_FP_EPSChassis1_0303_7bc04833_Tx (ComSignal):
        ComBitPosition = 7
        ComBitSize = 11
        ComSignalEndianness = BIG_ENDIAN
        ComSignalInitValue = 1024
        ComSignalType = UINT16
        ComTimeout = 0
        ComTransferProperty = PENDING
        ComSignalAccess = ACCESS_UNCLEAR
        ComHandleId = 43
        ComSystemTemplateSystemSignalRef = VCU_ActualTorque
      DonorCar_PEPS_Message_Sts_oKAMA_FP_EPSChassis1_0303_1785e56a_Rx (ComIPdu):
        ComIPduDirection = RECEIVE
        ComIPduType = NORMAL
        ComIPduHandleId = 30
        ComIPduSignalProcessing = DEFERRED
        ComIPduCancellationSupport = false
        ComIPduGroupRef = VCU_oKAMA_FP_EPSChassis1_0303_Rx_00807295
        ComIPduSignalRef = PEPS_Message_Sts_AliveCounter_oDonorCar_PEPS_Message_Sts_oKAMA_FP_EPSChassis1_0303_8f8646c9_Rx
        ComIPduSignalRef = PEPS_Message_Sts_Checksum_oDonorCar_PEPS_Message_Sts_oKAMA_FP_EPSChassis1_0303_29404510_Rx
        ComIPduSignalRef = PEPS_PowerModeValidity_oDonorCar_PEPS_Message_Sts_oKAMA_FP_EPSChassis1_0303_896cd32f_Rx
        ComIPduSignalRef = PEPS_PowerMode_oDonorCar_PEPS_Message_Sts_oKAMA_FP_EPSChassis1_0303_a177fbf2_Rx
        ComPduIdRef = DonorCar_PEPS_Message_Sts_oKAMA_FP_EPSChassis1_0303_1785e56a_Rx
      BMS_MaxCellTempModuleNO_oBMS_Temp_oKAMA_FP_EPT_0303_a186a73e_Rx (ComSignal):
        ComBitPosition = 39
        ComBitSize = 8
        ComSignalEndianness = BIG_ENDIAN
        ComSignalInitValue = 0
        ComSignalType = UINT8
        ComTimeout = 0
        ComSignalAccess = ACCESS_UNCLEAR
        ComHandleId = 133
        ComSystemTemplateSystemSignalRef = BMS_MaxCellTempModuleNO
      BMS_PRO_oKAMA_FP_EPT_0303_a99bebfe_Rx (ComIPdu):
        ComIPduDirection = RECEIVE
        ComIPduType = NORMAL
        ComIPduHandleId = 17
        ComIPduSignalProcessing = DEFERRED
        ComIPduCancellationSupport = false
        ComIPduGroupRef = VCU_oKAMA_FP_EPT_0303_Rx_07e8d111
        ComIPduSignalRef = BMS_BatProDatDay_oBMS_PRO_oKAMA_FP_EPT_0303_7f734584_Rx
        ComIPduSignalRef = BMS_BatProDatMonth_oBMS_PRO_oKAMA_FP_EPT_0303_b57a5485_Rx
        ComIPduSignalRef = BMS_BatProDatYear_oBMS_PRO_oKAMA_FP_EPT_0303_d7462553_Rx
        ComPduIdRef = BMS_PRO_oKAMA_FP_EPT_0303_a99bebfe_Rx
      14 x ComSignal, all with ComTimeout=0, ComSignalAccess=ACCESS_UNCLEAR:
        BMS_ErrorLeakCurrent_oBMS_ErrorInfo1_oKAMA_FP_EPT_0303_bc78143b_Rx: ComBitPosition=21, ComBitSize=2, ComSignalEndianness=BIG_ENDIAN, ComSignalInitValue=0, ComSignalType=UINT8, ComHandleId=116, ComSystemTemplateSystemSignalRef=BMS_ErrorLeakCurrent
        Checksum_5C_oIBS1_acceleration_oKAMA_FP_EPSChassis1_0303_4ba362a6_Rx: ComBitPosition=63, ComBitSize=8, ComSignalEndianness=BIG_ENDIAN, ComSignalInitValue=0, ComSignalType=UINT8, ComHandleId=190, ComSystemTemplateSystemSignalRef=Checksum_5C
        DM1_Byte3_oREPS_DM1_oKAMA_FP_EPSChassis1_0303_0d00c4fb_Rx: ComBitPosition=31, ComBitSize=8, ComSignalEndianness=BIG_ENDIAN, ComSignalInitValue=0, ComSignalType=UINT8, ComHandleId=229, ComSystemTemplateSystemSignalRef=DM1_Byte3
        MessageCounter_AE_oBMS_status_oKAMA_FP_EPT_0303_23fec4ce_Rx: ComBitPosition=51, ComBitSize=4, ComSignalEndianness=BIG_ENDIAN, ComSignalInitValue=0, ComSignalType=UINT8, ComHandleId=425, ComSystemTemplateSystemSignalRef=MessageCounter_AE
        MCU_bDernStrTemp_oMCU_DeratingStatus_oKAMA_FP_EPT_0303_c104cc08_Rx: ComBitPosition=4, ComBitSize=1, ComSignalEndianness=BIG_ENDIAN, ComSignalInitValue=0, ComSignalType=BOOLEAN, ComHandleId=384, ComSystemTemplateSystemSignalRef=MCU_bDernStrTemp
        Uds_EPT_bootResponse_Byte4_oUds_EPT_Boot_Response_oKAMA_FP_EPT_0303_f159cc0d_Tx: ComBitPosition=32, ComBitSize=8, ComSignalEndianness=LITTLE_ENDIAN, ComSignalInitValue=0, ComSignalType=UINT8, ComTransferProperty=TRIGGERED_WITHOUT_REPETITION, ComHandleId=29, ComSystemTemplateSystemSignalRef=Uds_EPT_bootResponse_Byte4
        VCU_TrqThresholdDampgCtl_oVCU_MCU02_oKAMA_FP_EPT_0303_3cbe5fa0_Tx: ComBitPosition=35, ComBitSize=8, ComSignalEndianness=BIG_ENDIAN, ComSignalInitValue=0, ComSignalType=UINT8, ComTransferProperty=PENDING, ComHandleId=114, ComSystemTemplateSystemSignalRef=VCU_TrqThresholdDampgCtl
        IBS_VehicleStandstill_oIBS_VCUVLC_oKAMA_FP_EPSChassis1_0303_a4c07af4_Rx: ComBitPosition=23, ComBitSize=1, ComSignalEndianness=BIG_ENDIAN, ComSignalInitValue=0, ComSignalType=BOOLEAN, ComHandleId=341, ComSystemTemplateSystemSignalRef=IBS_VehicleStandstill
        Checksum_2C1_oTCU_Cmd_oKAMA_FP_EPT_0303_969b2a12_Rx: ComBitPosition=63, ComBitSize=8, ComSignalEndianness=BIG_ENDIAN, ComSignalInitValue=0, ComSignalType=SINT8, ComHandleId=187, ComSystemTemplateSystemSignalRef=Checksum_2C1
        IBS_AVHStandbySts_oIBS_Status2_oKAMA_FP_EPSChassis1_0303_60b379df_Rx: ComBitPosition=36, ComBitSize=1, ComSignalEndianness=BIG_ENDIAN, ComSignalInitValue=0, ComSignalType=BOOLEAN, ComHandleId=283, ComSystemTemplateSystemSignalRef=IBS_AVHStandbySts
        IBS_FLWheelPulseCounter_oIBS_WheelPulse_oKAMA_FP_EPSChassis1_0303_3418d77c_Rx: ComBitPosition=7, ComBitSize=8, ComSignalEndianness=BIG_ENDIAN, ComSignalInitValue=0, ComSignalType=UINT8, ComHandleId=304, ComSystemTemplateSystemSignalRef=IBS_FLWheelPulseCounter
        BMS_BatCode4_oBMS_Batcode_oKAMA_FP_EPT_0303_7c404bbe_Rx: ComBitPosition=47, ComBitSize=8, ComSignalEndianness=BIG_ENDIAN, ComSignalInitValue=0, ComSignalType=UINT8, ComHandleId=72, ComSystemTemplateSystemSignalRef=BMS_BatCode4
        DCDC_PrimarySideOvertempStatus_oDCDC_VCU_02_oKAMA_FP_EPT_0303_71e13547_Rx: ComBitPosition=9, ComBitSize=1, ComSignalEndianness=BIG_ENDIAN, ComSignalInitValue=0, ComSignalType=BOOLEAN, ComHandleId=221, ComSystemTemplateSystemSignalRef=DCDC_PrimarySideOvertempStatus
        MCU_TrqAbsMin_oMCU_DeratingStatus_oKAMA_FP_EPT_0303_f685aadd_Rx: ComBitPosition=16, ComBitSize=11, ComSignalEndianness=BIG_ENDIAN, ComSignalInitValue=1024, ComSignalType=UINT16, ComHandleId=377, ComSystemTemplateSystemSignalRef=MCU_TrqAbsMin
      BMS_DisChargeEnergy_oKAMA_FP_EPT_0303_715042cb_Rx (ComIPdu):
        ComIPduDirection = RECEIVE
        ComIPduType = NORMAL
        ComIPduHandleId = 14
        ComIPduSignalProcessing = DEFERRED
        ComIPduCancellationSupport = false
        ComIPduGroupRef = VCU_oKAMA_FP_EPT_0303_Rx_07e8d111
        ComIPduSignalRef = BMS_RemainCapacity_oBMS_DisChargeEnergy_oKAMA_FP_EPT_0303_5f548087_Rx
        ComIPduSignalRef = BMS_SumDisChgkwh_oBMS_DisChargeEnergy_oKAMA_FP_EPT_0303_999808cc_Rx
        ComPduIdRef = BMS_DisChargeEnergy_oKAMA_FP_EPT_0303_715042cb_Rx
      MMI_AcKey_oDonorCar_MMI_AC_Command_oKAMA_FP_EPT_0303_1ee47db8_Rx (ComSignal):
        ComBitPosition = 7
        ComBitSize = 1
        ComSignalEndianness = BIG_ENDIAN
        ComSignalInitValue = 0
        ComSignalType = BOOLEAN
        ComTimeout = 0
        ComSignalAccess = ACCESS_UNCLEAR
        ComHandleId = 396
        ComSystemTemplateSystemSignalRef = MMI_AcKey
      BMS_BatInfor2_oKAMA_FP_EPT_0303_e514bb91_Rx (ComIPdu):
        ComIPduDirection = RECEIVE
        ComIPduType = NORMAL
        ComIPduHandleId = 6
        ComIPduSignalProcessing = DEFERRED
        ComIPduCancellationSupport = false
        ComIPduGroupRef = VCU_oKAMA_FP_EPT_0303_Rx_07e8d111
        ComIPduSignalRef = BMS_BatSupName_oBMS_BatInfor2_oKAMA_FP_EPT_0303_db5464c5_Rx
        ComIPduSignalRef = BMS_BatType_oBMS_BatInfor2_oKAMA_FP_EPT_0303_2061b264_Rx
        ComIPduSignalRef = BMS_CellNumbers_oBMS_BatInfor2_oKAMA_FP_EPT_0303_2bfb15b7_Rx
        ComIPduSignalRef = BMS_RatBatVoltage_oBMS_BatInfor2_oKAMA_FP_EPT_0303_58df94cd_Rx
        ComIPduSignalRef = BMS_RatCapacity_oBMS_BatInfor2_oKAMA_FP_EPT_0303_3d73ca16_Rx
        ComIPduSignalRef = BMS_RatEnergy_oBMS_BatInfor2_oKAMA_FP_EPT_0303_7dc4c3cb_Rx
        ComPduIdRef = BMS_BatInfor2_oKAMA_FP_EPT_0303_e514bb91_Rx
      9 x ComSignal, all with ComSignalEndianness=BIG_ENDIAN, ComTimeout=0, ComSignalAccess=ACCESS_UNCLEAR:
        BMS_Life_oBMS_VersionInfor_oKAMA_FP_EPT_0303_c03d820e_Rx: ComBitPosition=63, ComBitSize=8, ComSignalInitValue=0, ComSignalType=UINT8, ComHandleId=131, ComSystemTemplateSystemSignalRef=BMS_Life
        BMS_ErrorBSUOffline_oBMS_ErrorInfo1_oKAMA_FP_EPT_0303_93b5f08f_Rx: ComBitPosition=23, ComBitSize=1, ComSignalInitValue=0, ComSignalType=BOOLEAN, ComHandleId=97, ComSystemTemplateSystemSignalRef=BMS_ErrorBSUOffline
        MessageCounter_27E_oVCU_PlugInChrgInfo1_oKAMA_FP_EPSChassis1_0303_1b9bd40f_Tx: ComBitPosition=51, ComBitSize=4, ComSignalInitValue=0, ComSignalType=UINT8, ComTransferProperty=PENDING, ComHandleId=16, ComSystemTemplateSystemSignalRef=MessageCounter_27E
        ACC_ComfortUpBand_oADAS_ACC_oKAMA_FP_EPSChassis1_0303_aaa37ee6_Rx: ComBitPosition=15, ComBitSize=8, ComSignalInitValue=140, ComSignalType=UINT8, ComHandleId=1, ComSystemTemplateSystemSignalRef=ACC_ComfortUpBand
        BMS_LinkVoltage_oBMS_PackVoltage_oKAMA_FP_EPT_0303_1fe6e15f_Rx: ComBitPosition=23, ComBitSize=16, ComSignalInitValue=0, ComSignalType=UINT16, ComHandleId=132, ComSystemTemplateSystemSignalRef=BMS_LinkVoltage
        Checksum_047_oVCU_MCU02_oKAMA_FP_EPT_0303_24cd2422_Tx: ComBitPosition=63, ComBitSize=8, ComSignalInitValue=0, ComSignalType=UINT8, ComTransferProperty=PENDING, ComHandleId=7, ComSystemTemplateSystemSignalRef=Checksum_047
        AEB_VehHldReq_oADAS_AEB_oKAMA_FP_EPSChassis1_0303_1523c802_Rx: ComBitPosition=4, ComBitSize=1, ComSignalInitValue=0, ComSignalType=BOOLEAN, ComHandleId=32, ComSystemTemplateSystemSignalRef=AEB_VehHldReq
        VCU_HVBatTargetSoC_oVCU_PlugInChrgInfo1_oKAMA_FP_EPSChassis1_0303_8fff7a08_Tx: ComBitPosition=31, ComBitSize=8, ComSignalInitValue=0, ComSignalType=UINT8, ComTransferProperty=PENDING, ComHandleId=72, ComSystemTemplateSystemSignalRef=VCU_HVBatTargetSoC
        EVCOM_CompActlSpd_oEVCOM_State_oKAMA_FP_EPT_0303_255dac2c_Rx: ComBitPosition=31, ComBitSize=13, ComSignalInitValue=0, ComSignalType=UINT16, ComHandleId=266, ComSystemTemplateSystemSignalRef=EVCOM_CompActlSpd
      POD_VCU_Status_01_oKAMA_FP_EPT_0303_334f0c5d_Rx (ComIPdu):
        ComIPduDirection = RECEIVE
        ComIPduType = NORMAL
        ComIPduHandleId = 55
        ComIPduSignalProcessing = DEFERRED
        ComIPduCancellationSupport = false
        ComIPduGroupRef = VCU_oKAMA_FP_EPT_0303_Rx_07e8d111
        ComIPduSignalRef = POD_DCFCCurrent_oPOD_VCU_Status_01_oKAMA_FP_EPT_0303_9507f5ee_Rx
        ComIPduSignalRef = POD_DCFCVoltage_oPOD_VCU_Status_01_oKAMA_FP_EPT_0303_617cb974_Rx
        ComIPduSignalRef = POD_DCInletTempA_oPOD_VCU_Status_01_oKAMA_FP_EPT_0303_c727af40_Rx
        ComIPduSignalRef = POD_DCInletTempB_oPOD_VCU_Status_01_oKAMA_FP_EPT_0303_8acfaf27_Rx
        ComIPduSignalRef = POD_Temperature_oPOD_VCU_Status_01_oKAMA_FP_EPT_0303_d4d7e422_Rx
        ComPduIdRef = POD_VCU_Status_01_oKAMA_FP_EPT_0303_334f0c5d_Rx
      4 x ComSignal, all with ComSignalEndianness=BIG_ENDIAN, ComSignalInitValue=0, ComTimeout=0, ComSignalAccess=ACCESS_UNCLEAR:
        OBC_NlineStatus_oOBC_Error_STATUS_oKAMA_FP_EPT_0303_6b29417d_Rx: ComBitPosition=8, ComBitSize=1, ComSignalType=BOOLEAN, ComHandleId=460, ComSystemTemplateSystemSignalRef=OBC_NlineStatus
        VCU_currentFromExtChargerDc_oVCU_PlugInChrgInfo2_oKAMA_FP_EPSChassis1_0303_8d68e041_Tx: ComBitPosition=31, ComBitSize=12, ComSignalType=UINT16, ComTransferProperty=PENDING, ComHandleId=128, ComSystemTemplateSystemSignalRef=VCU_currentFromExtChargerDc
        Checksum_7A_oVCU_MCU_7A_oKAMA_FP_EPSChassis1_0303_7a2c896b_Tx: ComBitPosition=63, ComBitSize=8, ComSignalType=UINT8, ComTransferProperty=PENDING, ComHandleId=1, ComSystemTemplateSystemSignalRef=Checksum_7A
        IBS_FLMovingDirection_oIBS_WheelSpeed_oKAMA_FP_EPSChassis1_0303_1770163f_Rx: ComBitPosition=22, ComBitSize=2, ComSignalType=UINT8, ComHandleId=303, ComSystemTemplateSystemSignalRef=IBS_FLMovingDirection
      OBC_VCU_STATUS1_oKAMA_FP_EPT_0303_95f7df0a_Rx (ComIPdu):
        ComIPduDirection = RECEIVE
        ComIPduType = NORMAL
        ComIPduHandleId = 53
        ComIPduSignalProcessing = DEFERRED
        ComIPduCancellationSupport = false
        ComIPduGroupRef = VCU_oKAMA_FP_EPT_0303_Rx_07e8d111
        ComIPduSignalRef = OBC_ChargeStatus_oOBC_VCU_STATUS1_oKAMA_FP_EPT_0303_04c7e1f4_Rx
        ComIPduSignalRef = OBC_InputACCurrent_oOBC_VCU_STATUS1_oKAMA_FP_EPT_0303_afc76503_Rx
        ComIPduSignalRef = OBC_InputACVoltage_oOBC_VCU_STATUS1_oKAMA_FP_EPT_0303_5c173faa_Rx
        ComIPduSignalRef = OBC_OBCMaxPermOutpCrrt_oOBC_VCU_STATUS1_oKAMA_FP_EPT_0303_2b78d0ea_Rx
        ComIPduSignalRef = OBC_OutputDCChargeVoltage_oOBC_VCU_STATUS1_oKAMA_FP_EPT_0303_bad6dd41_Rx
        ComPduIdRef = OBC_VCU_STATUS1_oKAMA_FP_EPT_0303_95f7df0a_Rx
      4 x ComSignal, all with ComSignalEndianness=BIG_ENDIAN, ComSignalInitValue=0, ComTimeout=0, ComSignalAccess=ACCESS_UNCLEAR:
        DM1_Byte7_oREPS_DM1_oKAMA_FP_EPSChassis1_0303_63539244_Rx: ComBitPosition=63, ComBitSize=8, ComSignalType=UINT8, ComHandleId=233, ComSystemTemplateSystemSignalRef=DM1_Byte7
        IBS_CDPAvailable_oIBS_Status2_oKAMA_FP_EPSChassis1_0303_3c3005fd_Rx: ComBitPosition=27, ComBitSize=1, ComSignalType=BOOLEAN, ComHandleId=288, ComSystemTemplateSystemSignalRef=IBS_CDPAvailable
        IBS_TorqueRBSReqValid_oIBS_Torque_oKAMA_FP_EPSChassis1_0303_6c3cd008_Rx: ComBitPosition=55, ComBitSize=2, ComSignalType=UINT8, ComHandleId=331, ComSystemTemplateSystemSignalRef=IBS_TorqueRBSReqValid
        VCU_chrgSystemStatus_oVCU_PlugInChrgInfo1_oKAMA_FP_EPSChassis1_0303_b8a9874c_Tx: ComBitPosition=6, ComBitSize=3, ComSignalType=UINT8, ComTransferProperty=PENDING, ComHandleId=125, ComSystemTemplateSystemSignalRef=VCU_chrgSystemStatus
      ADAS_AEB_oKAMA_FP_EPSChassis1_0303_cc20b539_Rx (ComIPdu):
        ComIPduDirection = RECEIVE
        ComIPduType = NORMAL
        ComIPduHandleId = 1
        ComIPduSignalProcessing = DEFERRED
        ComIPduCancellationSupport = false
        ComIPduGroupRef = VCU_oKAMA_FP_EPSChassis1_0303_Rx_00807295
        ComIPduSignalRef = AEB_ABALevel_oADAS_AEB_oKAMA_FP_EPSChassis1_0303_42fed090_Rx
        ComIPduSignalRef = AEB_ABAReq_oADAS_AEB_oKAMA_FP_EPSChassis1_0303_614aadae_Rx
        ComIPduSignalRef = AEB_ABPReq_oADAS_AEB_oKAMA_FP_EPSChassis1_0303_3ae93c17_Rx
        ComIPduSignalRef = AEB_AWB_Level_oADAS_AEB_oKAMA_FP_EPSChassis1_0303_744820f1_Rx
        ComIPduSignalRef = AEB_AWB_eq_oADAS_AEB_oKAMA_FP_EPSChassis1_0303_59ab8f5e_Rx
        ComIPduSignalRef = AEB_BrakeReqFunction_oADAS_AEB_oKAMA_FP_EPSChassis1_0303_6fc40070_Rx
        ComIPduSignalRef = AEB_TargetDecel_ReqValue_oADAS_AEB_oKAMA_FP_EPSChassis1_0303_54ec0fd5_Rx
        ComIPduSignalRef = AEB_TargetDecel_eq_oADAS_AEB_oKAMA_FP_EPSChassis1_0303_4ed3d98a_Rx
        ComIPduSignalRef = AEB_VehHldReq_oADAS_AEB_oKAMA_FP_EPSChassis1_0303_1523c802_Rx
        ComIPduSignalRef = Checksum_1A2_oADAS_AEB_oKAMA_FP_EPSChassis1_0303_76b7e8f6_Rx
        ComIPduSignalRef = EBA_TargetDecelReq_oADAS_AEB_oKAMA_FP_EPSChassis1_0303_e76d1804_Rx
        ComIPduSignalRef = MessageCounter_1A2_oADAS_AEB_oKAMA_FP_EPSChassis1_0303_5b09f2ff_Rx
        ComPduIdRef = ADAS_AEB_oKAMA_FP_EPSChassis1_0303_cc20b539_Rx
      5 x ComSignal, all with ComSignalEndianness=BIG_ENDIAN, ComTimeout=0, ComSignalAccess=ACCESS_UNCLEAR:
        VCU_Chargestatus_oVCU_BMS_oKAMA_FP_EPT_0303_0d5594fe_Tx: ComBitPosition=11, ComBitSize=4, ComSignalInitValue=0, ComSignalType=UINT8, ComTransferProperty=PENDING, ComHandleId=48, ComSystemTemplateSystemSignalRef=VCU_Chargestatus
        BMS_AverageCellTemp_oBMS_Temp_oKAMA_FP_EPT_0303_856bba72_Rx: ComBitPosition=15, ComBitSize=8, ComSignalInitValue=255, ComSignalType=UINT8, ComHandleId=64, ComSystemTemplateSystemSignalRef=BMS_AverageCellTemp
        BMS_ErrorSoCJump_RM_oBMS_ErrorInfo1_oKAMA_FP_EPT_0303_e602fab2_Rx: ComBitPosition=34, ComBitSize=1, ComSignalInitValue=0, ComSignalType=BOOLEAN, ComHandleId=123, ComSystemTemplateSystemSignalRef=BMS_ErrorSoCJump_RM
        DM1_Byte2_oREPS_DM1_oKAMA_FP_EPSChassis1_0303_8df0d3e4_Rx: ComBitPosition=23, ComBitSize=8, ComSignalInitValue=0, ComSignalType=UINT8, ComHandleId=228, ComSystemTemplateSystemSignalRef=DM1_Byte2
        VCU_OPStandstillReq_oVCU_AccPedal_oKAMA_FP_EPSChassis1_0303_502620b6_Tx: ComBitPosition=44, ComBitSize=1, ComSignalInitValue=0, ComSignalType=BOOLEAN, ComTransferProperty=PENDING, ComHandleId=97, ComSystemTemplateSystemSignalRef=VCU_OPStandstillReq
      BMS_PackVoltage_oKAMA_FP_EPT_0303_dde3d337_Rx (ComIPdu):
        ComIPduDirection = RECEIVE
        ComIPduType = NORMAL
        ComIPduHandleId = 18
        ComIPduSignalProcessing = DEFERRED
        ComIPduCancellationSupport = false
        ComIPduGroupRef = VCU_oKAMA_FP_EPT_0303_Rx_07e8d111
        ComIPduSignalRef = BMS_DisplaySOC_oBMS_PackVoltage_oKAMA_FP_EPT_0303_5997374d_Rx
        ComIPduSignalRef = BMS_LinkVoltage_oBMS_PackVoltage_oKAMA_FP_EPT_0303_1fe6e15f_Rx
        ComIPduSignalRef = BMS_PackVoltage_oBMS_PackVoltage_oKAMA_FP_EPT_0303_f61cb460_Rx
        ComIPduSignalRef = BMS_SOC_oBMS_PackVoltage_oKAMA_FP_EPT_0303_15423f2a_Rx
        ComPduIdRef = BMS_PackVoltage_oKAMA_FP_EPT_0303_dde3d337_Rx
      TCU_ambientTemperature_oGW_TCU_AmbientTemp_oKAMA_FP_EPSChassis1_0303_7c3de23e_Rx (ComSignal):
        ComBitPosition = 7
        ComBitSize = 8
        ComSignalEndianness = BIG_ENDIAN
        ComSignalInitValue = 50
        ComSignalType = UINT8
        ComTimeout = 0
        ComSignalAccess = ACCESS_UNCLEAR
        ComHandleId = 508
        ComSystemTemplateSystemSignalRef = TCU_ambientTemperature
      VCU_AccPedal_oKAMA_FP_EPSChassis1_0303_d4e5cf20_Tx (ComIPdu):
        ComIPduDirection = SEND
        ComIPduType = NORMAL
        ComIPduHandleId = 1
        ComIPduSignalProcessing = DEFERRED
        ComIPduCancellationSupport = false
        ComIPduGroupRef = VCU_oKAMA_FP_EPSChassis1_0303_Tx_56dad513
        ComIPduSignalRef = Checksum_151_oVCU_AccPedal_oKAMA_FP_EPSChassis1_0303_f8a47a0f_Tx
        ComIPduSignalRef = MessageCounter_151_oVCU_AccPedal_oKAMA_FP_EPSChassis1_0303_ab84cc60_Tx
        ComIPduSignalRef = VCU_AVHActivereq_oVCU_AccPedal_oKAMA_FP_EPSChassis1_0303_743caa0d_Tx
        ComIPduSignalRef = VCU_AccelerationPedalValid_oVCU_AccPedal_oKAMA_FP_EPSChassis1_0303_a0ecbfb8_Tx
        ComIPduSignalRef = VCU_AccelerationPedal_oVCU_AccPedal_oKAMA_FP_EPSChassis1_0303_2c6793be_Tx
        ComIPduSignalRef = VCU_ActualGear_oVCU_AccPedal_oKAMA_FP_EPSChassis1_0303_a16a27f2_Tx
        ComIPduSignalRef = VCU_EPBAppliedReq_oVCU_AccPedal_oKAMA_FP_EPSChassis1_0303_5a51a017_Tx
        ComIPduSignalRef = VCU_OPStandstillReq_oVCU_AccPedal_oKAMA_FP_EPSChassis1_0303_502620b6_Tx
        ComIPduSignalRef = VCU_SystemReady_oVCU_AccPedal_oKAMA_FP_EPSChassis1_0303_b046fea1_Tx
        ComIPduSignalRef = VCU_TargetDeceleration_oVCU_AccPedal_oKAMA_FP_EPSChassis1_0303_a959a382_Tx
        ComIPduSignalRef = VCU_TargetGear_oVCU_AccPedal_oKAMA_FP_EPSChassis1_0303_cceff6cd_Tx
        ComIPduSignalRef = VCU_VLCTorqueRequestActive_oVCU_AccPedal_oKAMA_FP_EPSChassis1_0303_fb9779de_Tx
        ComIPduSignalRef = VCU_VLCTorqueRequestAvailable_oVCU_AccPedal_oKAMA_FP_EPSChassis1_0303_caeb332d_Tx
        ComIPduSignalRef = VCU_VirtualPedalValid_oVCU_AccPedal_oKAMA_FP_EPSChassis1_0303_6044ac51_Tx
        ComIPduSignalRef = VCU_VirtualPedal_oVCU_AccPedal_oKAMA_FP_EPSChassis1_0303_aea157a2_Tx
        ComIPduSignalRef = VCU_onepedalstatusActive_oVCU_AccPedal_oKAMA_FP_EPSChassis1_0303_5ec19509_Tx
        ComPduIdRef = VCU_AccPedal_oKAMA_FP_EPSChassis1_0303_d4e5cf20_Tx
        ComTxIPdu: ComMinimumDelayTime=0, ComTxIPduUnusedAreasDefault=0
          ComTxModeTrue
            ComTxMode: ComTxModeMode=PERIODIC, ComTxModeTimeOffset=0, ComTxModeTimePeriod=0.02
          ComTxModeFalse
            ComTxMode: ComTxModeMode=PERIODIC, ComTxModeTimeOffset=0, ComTxModeTimePeriod=0.02
      VCU_RegenBrakeLightRequest_oVCU_PwrtrainRequests_oKAMA_FP_EPSChassis1_0303_3d171558_Tx (ComSignal):
        ComBitPosition = 5
        ComBitSize = 1
        ComSignalEndianness = BIG_ENDIAN
        ComSignalInitValue = 0
        ComSignalType = BOOLEAN
        ComTimeout = 0
        ComTransferProperty = PENDING
        ComSignalAccess = ACCESS_UNCLEAR
        ComHandleId = 100
        ComSystemTemplateSystemSignalRef = VCU_RegenBrakeLightRequest
      MCU_Temperature1_oKAMA_FP_EPT_0303_a297e928_Rx (ComIPdu):
        ComIPduDirection = RECEIVE
        ComIPduType = NORMAL
        ComIPduHandleId = 48
        ComIPduSignalProcessing = DEFERRED
        ComIPduCancellationSupport = false
        ComIPduGroupRef = VCU_oKAMA_FP_EPT_0303_Rx_07e8d111
        ComIPduSignalRef = MCU_IGBTTempMax_oMCU_Temperature1_oKAMA_FP_EPT_0303_89ff04e3_Rx
        ComIPduSignalRef = MCU_IGBTTempRiseMax_oMCU_Temperature1_oKAMA_FP_EPT_0303_14d3b7fa_Rx
        ComIPduSignalRef = MCU_IGBTTempRiseU_oMCU_Temperature1_oKAMA_FP_EPT_0303_67682fde_Rx
        ComIPduSignalRef = MCU_IGBTTempRiseV_oMCU_Temperature1_oKAMA_FP_EPT_0303_3d0910be_Rx
        ComIPduSignalRef = MCU_IGBTTempRiseW_oMCU_Temperature1_oKAMA_FP_EPT_0303_bdf907a1_Rx
        ComIPduSignalRef = MCU_IGBTTempU_oMCU_Temperature1_oKAMA_FP_EPT_0303_77c5dc46_Rx
        ComIPduSignalRef = MCU_IGBTTempV_oMCU_Temperature1_oKAMA_FP_EPT_0303_2da4e326_Rx
        ComIPduSignalRef = MCU_IGBTTempW_oMCU_Temperature1_oKAMA_FP_EPT_0303_ad54f439_Rx
        ComPduIdRef = MCU_Temperature1_oKAMA_FP_EPT_0303_a297e928_Rx
      3 x ComSignal, all with ComSignalEndianness=BIG_ENDIAN, ComSignalInitValue=0, ComTimeout=0, ComSignalAccess=ACCESS_UNCLEAR:
        IBS_FLWheelSpeed_Fault_oIBS_WheelSpeed_oKAMA_FP_EPSChassis1_0303_8f0c6df1_Rx: ComBitPosition=23, ComBitSize=1, ComSignalType=BOOLEAN, ComHandleId=305, ComSystemTemplateSystemSignalRef=IBS_FLWheelSpeed_Fault
        VCU_voltageFromExtChargerAc_oVCU_PlugInChrgInfo2_oKAMA_FP_EPSChassis1_0303_a64b20b7_Tx: ComBitPosition=10, ComBitSize=11, ComSignalType=UINT16, ComTransferProperty=PENDING, ComHandleId=133, ComSystemTemplateSystemSignalRef=VCU_voltageFromExtChargerAc
        VCU_MCURequestedState_oVCU_MCU01_oKAMA_FP_EPT_0303_c2608659_Tx: ComBitPosition=47, ComBitSize=4, ComSignalType=UINT8, ComTransferProperty=PENDING, ComHandleId=86, ComSystemTemplateSystemSignalRef=VCU_MCURequestedState
      EPS_FEEDBACK_oKAMA_FP_EPSChassis1_0303_b7e2a70b_Rx (ComIPdu):
        ComIPduDirection = RECEIVE
        ComIPduType = NORMAL
        ComIPduHandleId = 31
        ComIPduSignalProcessing = DEFERRED
        ComIPduCancellationSupport = false
        ComIPduGroupRef = VCU_oKAMA_FP_EPSChassis1_0303_Rx_00807295
        ComIPduSignalRef = Checksum_6A_oEPS_FEEDBACK_oKAMA_FP_EPSChassis1_0303_4006fd22_Rx
        ComIPduSignalRef = EPS_Iq_oEPS_FEEDBACK_oKAMA_FP_EPSChassis1_0303_dbd3334a_Rx
        ComIPduSignalRef = EPS_SteeringwheelAngleSpeed_oEPS_FEEDBACK_oKAMA_FP_EPSChassis1_0303_f5101952_Rx
        ComIPduSignalRef = EPS_SteeringwheelAngle_oEPS_FEEDBACK_oKAMA_FP_EPSChassis1_0303_9bb7fd08_Rx
        ComIPduSignalRef = EPS_WorkMode_oEPS_FEEDBACK_oKAMA_FP_EPSChassis1_0303_571be72d_Rx
        ComIPduSignalRef = MessageCounter_6A_oEPS_FEEDBACK_oKAMA_FP_EPSChassis1_0303_d323a2d0_Rx
        ComPduIdRef = EPS_FEEDBACK_oKAMA_FP_EPSChassis1_0303_b7e2a70b_Rx
      MessageCounter_2C0_oTCU_Status_oKAMA_FP_EPT_0303_831d62f7_Rx (ComSignal):
        ComBitPosition = 51
        ComBitSize = 4
        ComSignalEndianness = BIG_ENDIAN
        ComSignalInitValue = 0
        ComSignalType = UINT8
        ComTimeout = 0
        ComSignalAccess = ACCESS_UNCLEAR
        ComHandleId = 408
        ComSystemTemplateSystemSignalRef = MessageCounter_2C0
      OBC_InputFrequencyStatus_oOBC_Error_STATUS_oKAMA_FP_EPT_0303_668c46af_Rx (ComSignal):
        ComBitPosition = 23
        ComBitSize = 1
        ComSignalEndianness = BIG_ENDIAN
        ComSignalInitValue = 0
        ComSignalType = BOOLEAN
        ComTimeout = 0
        ComSignalAccess = ACCESS_UNCLEAR
        ComHandleId = 455
        ComSystemTemplateSystemSignalRef = OBC_InputFrequencyStatus
      VCU_oKAMA_FP_EPSChassis1_0303_Tx_56dad513 (ComIPduGroup): ComIPduGroupHandleId=1
      Uds_EPT_Boot_Response_oKAMA_FP_EPT_0303_52f0f748_Tx (ComIPdu):
        ComIPduDirection = SEND
        ComIPduType = NORMAL
        ComIPduHandleId = 0
        ComIPduSignalProcessing = DEFERRED
        ComIPduCancellationSupport = false
        ComIPduGroupRef = VCU_oKAMA_FP_EPT_0303_Tx_51b27697
        ComIPduSignalRef = Uds_EPT_bootResponse_Byte0_oUds_EPT_Boot_Response_oKAMA_FP_EPT_0303_182cd576_Tx
        ComIPduSignalRef = Uds_EPT_bootResponse_Byte1_oUds_EPT_Boot_Response_oKAMA_FP_EPT_0303_b9155198_Tx
        ComIPduSignalRef = Uds_EPT_bootResponse_Byte2_oUds_EPT_Boot_Response_oKAMA_FP_EPT_0303_812edaeb_Tx
        ComIPduSignalRef = Uds_EPT_bootResponse_Byte3_oUds_EPT_Boot_Response_oKAMA_FP_EPT_0303_20175e05_Tx
        ComIPduSignalRef = Uds_EPT_bootResponse_Byte4_oUds_EPT_Boot_Response_oKAMA_FP_EPT_0303_f159cc0d_Tx
        ComIPduSignalRef = Uds_EPT_bootResponse_Byte5_oUds_EPT_Boot_Response_oKAMA_FP_EPT_0303_506048e3_Tx
        ComIPduSignalRef = Uds_EPT_bootResponse_Byte6_oUds_EPT_Boot_Response_oKAMA_FP_EPT_0303_685bc390_Tx
        ComIPduSignalRef = Uds_EPT_bootResponse_Byte7_oUds_EPT_Boot_Response_oKAMA_FP_EPT_0303_c962477e_Tx
        ComPduIdRef = Uds_EPT_Boot_Response_oKAMA_FP_EPT_0303_52f0f748_Tx
        ComTxIPdu: ComMinimumDelayTime=0, ComTxIPduUnusedAreasDefault=0
          ComTxModeTrue
            ComTxMode: ComTxModeMode=DIRECT, ComTxModeNumberOfRepetitions=0, ComTxModeRepetitionPeriod=0
          ComTxModeFalse
            ComTxMode: ComTxModeMode=DIRECT, ComTxModeNumberOfRepetitions=0, ComTxModeRepetitionPeriod=0
      22 x ComSignal, all with ComTimeout=0, ComSignalAccess=ACCESS_UNCLEAR:
        APTC_DriveFaltStatus_oAPTC_TCU_oKAMA_FP_EPT_0303_1739c731_Rx: ComBitPosition=2, ComBitSize=1, ComSignalEndianness=BIG_ENDIAN, ComSignalInitValue=0, ComSignalType=BOOLEAN, ComHandleId=39, ComSystemTemplateSystemSignalRef=APTC_DriveFaltStatus
        BBF_failurestatus_oIBS_Status2_oKAMA_FP_EPSChassis1_0303_48ab3311_Rx: ComBitPosition=15, ComBitSize=1, ComSignalEndianness=BIG_ENDIAN, ComSignalInitValue=0, ComSignalType=BOOLEAN, ComHandleId=48, ComSystemTemplateSystemSignalRef=BBF_failurestatus
        BMS_PosRelayStatus_oBMS_DIRelayState_oKAMA_FP_EPT_0303_11fa2207_Rx: ComBitPosition=7, ComBitSize=2, ComSignalEndianness=BIG_ENDIAN, ComSignalInitValue=0, ComSignalType=UINT8, ComHandleId=149, ComSystemTemplateSystemSignalRef=BMS_PosRelayStatus
        MCU_TempCurrCool_oMCU_Temperature2_oKAMA_FP_EPT_0303_dee5af2e_Rx: ComBitPosition=7, ComBitSize=8, ComSignalEndianness=BIG_ENDIAN, ComSignalInitValue=255, ComSignalType=UINT8, ComHandleId=370, ComSystemTemplateSystemSignalRef=MCU_TempCurrCool
        OBC_PFCUnderVoltageError_oOBC_Error_STATUS_oKAMA_FP_EPT_0303_7a662b4c_Rx: ComBitPosition=18, ComBitSize=1, ComSignalEndianness=BIG_ENDIAN, ComSignalInitValue=0, ComSignalType=BOOLEAN, ComHandleId=466, ComSystemTemplateSystemSignalRef=OBC_PFCUnderVoltageError
        VCU_VoltageDemandLV_oVCU_DCDC_oKAMA_FP_EPT_0303_e3442b89_Tx: ComBitPosition=7, ComBitSize=9, ComSignalEndianness=BIG_ENDIAN, ComSignalInitValue=0, ComSignalType=UINT16, ComTransferProperty=PENDING, ComHandleId=123, ComSystemTemplateSystemSignalRef=VCU_VoltageDemandLV
        Uds_EPT_bootResponse_Byte3_oUds_EPT_Boot_Response_oKAMA_FP_EPT_0303_20175e05_Tx: ComBitPosition=24, ComBitSize=8, ComSignalEndianness=LITTLE_ENDIAN, ComSignalInitValue=0, ComSignalType=UINT8, ComTransferProperty=TRIGGERED_WITHOUT_REPETITION, ComHandleId=28, ComSystemTemplateSystemSignalRef=Uds_EPT_bootResponse_Byte3
        MessageCounter_046_oVCU_MCU01_oKAMA_FP_EPT_0303_943c8e54_Tx: ComBitPosition=51, ComBitSize=4, ComSignalEndianness=BIG_ENDIAN, ComSignalInitValue=0, ComSignalType=UINT8, ComTransferProperty=PENDING, ComHandleId=18, ComSystemTemplateSystemSignalRef=MessageCounter_046
        POD_faultTemp_oOBC_Error_STATUS_oKAMA_FP_EPT_0303_63cfc5a1_Rx: ComBitPosition=30, ComBitSize=1, ComSignalEndianness=BIG_ENDIAN, ComSignalInitValue=0, ComSignalType=BOOLEAN, ComHandleId=488, ComSystemTemplateSystemSignalRef=POD_faultTemp
        DCDC_InputVoltHighFault_oDCDC_VCU_02_oKAMA_FP_EPT_0303_7d394ef3_Rx: ComBitPosition=4, ComBitSize=1, ComSignalEndianness=BIG_ENDIAN, ComSignalInitValue=0, ComSignalType=BOOLEAN, ComHandleId=208, ComSystemTemplateSystemSignalRef=DCDC_InputVoltHighFault
        AEB_TargetDecel_eq_oADAS_AEB_oKAMA_FP_EPSChassis1_0303_4ed3d98a_Rx: ComBitPosition=5, ComBitSize=1, ComSignalEndianness=BIG_ENDIAN, ComSignalInitValue=0, ComSignalType=BOOLEAN, ComHandleId=31, ComSystemTemplateSystemSignalRef=AEB_TargetDecel_eq
        APTC_LostCommuFaltStatus_oAPTC_TCU_oKAMA_FP_EPT_0303_d69f2899_Rx: ComBitPosition=3, ComBitSize=1, ComSignalEndianness=BIG_ENDIAN, ComSignalInitValue=0, ComSignalType=BOOLEAN, ComHandleId=45, ComSystemTemplateSystemSignalRef=APTC_LostCommuFaltStatus
        TCU_AmbientTemperature_oTCU_AmbientTemp_oKAMA_FP_EPT_0303_efb8be2a_Rx: ComBitPosition=7, ComBitSize=8, ComSignalEndianness=BIG_ENDIAN, ComSignalInitValue=255, ComSignalType=UINT8, ComHandleId=493, ComSystemTemplateSystemSignalRef=TCU_AmbientTemperature
        VCU_DriveMotOverSpd_oVCU_HMIsignals_oKAMA_FP_EPSChassis1_0303_90bfe192_Tx: ComBitPosition=6, ComBitSize=1, ComSignalEndianness=BIG_ENDIAN, ComSignalInitValue=0, ComSignalType=BOOLEAN, ComTransferProperty=PENDING, ComHandleId=56, ComSystemTemplateSystemSignalRef=VCU_DriveMotOverSpd
        VCU_DrvModSwitchWarn_oVCU_PwrtrainRequests_oKAMA_FP_EPSChassis1_0303_8683b86c_Tx: ComBitPosition=34, ComBitSize=3, ComSignalEndianness=BIG_ENDIAN, ComSignalInitValue=0, ComSignalType=UINT8, ComTransferProperty=PENDING, ComHandleId=59, ComSystemTemplateSystemSignalRef=VCU_DrvModSwitchWarn
        VCU_UnavailHVCharging_oVCU_PlugInChrgInfo1_oKAMA_FP_EPSChassis1_0303_7c7a1d0b_Tx: ComBitPosition=3, ComBitSize=1, ComSignalEndianness=BIG_ENDIAN, ComSignalInitValue=0, ComSignalType=BOOLEAN, ComTransferProperty=PENDING, ComHandleId=116, ComSystemTemplateSystemSignalRef=VCU_UnavailHVCharging
        VCU_ActiveRgnBrkProfile_oVCU_PwrtrainRequests_oKAMA_FP_EPSChassis1_0303_f75f5f47_Tx: ComBitPosition=23, ComBitSize=3, ComSignalEndianness=BIG_ENDIAN, ComSignalInitValue=0, ComSignalType=UINT8, ComTransferProperty=PENDING, ComHandleId=39, ComSystemTemplateSystemSignalRef=VCU_ActiveRgnBrkProfile
        Checksum_1A1_oADAS_ACC_oKAMA_FP_EPSChassis1_0303_47e6c299_Rx: ComBitPosition=63, ComBitSize=8, ComSignalEndianness=BIG_ENDIAN, ComSignalInitValue=0, ComSignalType=UINT8, ComHandleId=183, ComSystemTemplateSystemSignalRef=Checksum_1A1
        DCDC_WorkMode_oDCDC_VCU_01_oKAMA_FP_EPT_0303_6085f628_Rx: ComBitPosition=31, ComBitSize=2, ComSignalEndianness=BIG_ENDIAN, ComSignalInitValue=0, ComSignalType=UINT8, ComHandleId=225, ComSystemTemplateSystemSignalRef=DCDC_WorkMode
        MessageCounter_1A3_oADAS_APA_oKAMA_FP_EPSChassis1_0303_7450109a_Rx: ComBitPosition=51, ComBitSize=4, ComSignalEndianness=BIG_ENDIAN, ComSignalInitValue=0, ComSignalType=UINT8, ComHandleId=407, ComSystemTemplateSystemSignalRef=MessageCounter_1A3
        VCU_TorqueRequestActive_oVCU_chassis_oKAMA_FP_EPSChassis1_0303_8ff9daa5_Tx: ComBitPosition=9, ComBitSize=1, ComSignalEndianness=BIG_ENDIAN, ComSignalInitValue=0, ComSignalType=BOOLEAN, ComTransferProperty=PENDING, ComHandleId=112, ComSystemTemplateSystemSignalRef=VCU_TorqueRequestActive
        MessageCounter_131_oYRS_2_oKAMA_FP_EPSChassis1_0303_18756432_Rx: ComBitPosition=48, ComBitSize=4, ComSignalEndianness=LITTLE_ENDIAN, ComSignalInitValue=0, ComSignalType=UINT8, ComHandleId=422, ComSystemTemplateSystemSignalRef=MessageCounter_131
      DonorCar_BCM_LDoorWindowState_oKAMA_FP_EPSChassis1_0303_2e82203e_Rx (ComIPdu):
        ComIPduDirection = RECEIVE
        ComIPduType = NORMAL
        ComIPduHandleId = 26
        ComIPduSignalProcessing = DEFERRED
        ComIPduCancellationSupport = false
        ComIPduGroupRef = VCU_oKAMA_FP_EPSChassis1_0303_Rx_00807295
        ComIPduSignalRef = BCM_FrontLeftDoorAjarStatus_oDonorCar_BCM_LDoorWindowState_oKAMA_FP_EPSChassis1_0303_a919870a_Rx
        ComPduIdRef = DonorCar_BCM_LDoorWindowState_oKAMA_FP_EPSChassis1_0303_2e82203e_Rx
      10 x ComSignal, all with ComSignalEndianness=BIG_ENDIAN, ComTimeout=0, ComSignalAccess=ACCESS_UNCLEAR:
        MCU_bDernTempIGBT_oMCU_DeratingStatus_oKAMA_FP_EPT_0303_ce671c37_Rx: ComBitPosition=14, ComBitSize=1, ComSignalInitValue=0, ComSignalType=BOOLEAN, ComHandleId=386, ComSystemTemplateSystemSignalRef=MCU_bDernTempIGBT
        IBS_VLCTorqueRequest_oIBS_VCUVLC_oKAMA_FP_EPSChassis1_0303_838cb94f_Rx: ComBitPosition=7, ComBitSize=11, ComSignalInitValue=1024, ComSignalType=UINT16, ComHandleId=338, ComSystemTemplateSystemSignalRef=IBS_VLCTorqueRequest
        MCU_HwVer_oMCU_HardwareNumber_oKAMA_FP_EPT_0303_c0b0dce1_Rx: ComBitPosition=7, ComBitSize=16, ComSignalInitValue=0, ComSignalType=UINT16, ComHandleId=355, ComSystemTemplateSystemSignalRef=MCU_HwVer
        MMI_FreshReciKey_oDonorCar_MMI_AC_Command_oKAMA_FP_EPT_0303_151b1ef4_Rx: ComBitPosition=5, ComBitSize=1, ComSignalInitValue=0, ComSignalType=BOOLEAN, ComHandleId=401, ComSystemTemplateSystemSignalRef=MMI_FreshReciKey
        EVCOM_CompActlCnsmpCur_oEVCOM_State_oKAMA_FP_EPT_0303_9620a508_Rx: ComBitPosition=63, ComBitSize=8, ComSignalInitValue=0, ComSignalType=UINT8, ComHandleId=262, ComSystemTemplateSystemSignalRef=EVCOM_CompActlCnsmpCur
        TCU_BattTMState_oTCU_Status_oKAMA_FP_EPT_0303_97de8d60_Rx: ComBitPosition=39, ComBitSize=3, ComSignalInitValue=0, ComSignalType=UINT8, ComHandleId=494, ComSystemTemplateSystemSignalRef=TCU_BattTMState
        IBS_ABSFault_oIBS_Status3_oKAMA_FP_EPSChassis1_0303_dc759a55_Rx: ComBitPosition=3, ComBitSize=1, ComSignalInitValue=0, ComSignalType=BOOLEAN, ComHandleId=279, ComSystemTemplateSystemSignalRef=IBS_ABSFault
        BMS_HVinterlockState_oBMS_status_oKAMA_FP_EPT_0303_0e2d87b0_Rx: ComBitPosition=17, ComBitSize=2, ComSignalInitValue=0, ComSignalType=UINT8, ComHandleId=127, ComSystemTemplateSystemSignalRef=BMS_HVinterlockState
        POD_DCPortInletTempAValid_oPOD_VCU_Status_02_oKAMA_FP_EPT_0303_72f6dbe5_Rx: ComBitPosition=5, ComBitSize=2, ComSignalInitValue=0, ComSignalType=UINT8, ComHandleId=483, ComSystemTemplateSystemSignalRef=POD_DCPortInletTempAValid
        VCU_InvldGearSel_oVCU_HMIsignals_oKAMA_FP_EPSChassis1_0303_be060888_Tx: ComBitPosition=47, ComBitSize=4, ComSignalInitValue=0, ComSignalType=UINT8, ComTransferProperty=PENDING, ComHandleId=78, ComSystemTemplateSystemSignalRef=VCU_InvldGearSel
      YRS_7_oKAMA_FP_EPSChassis1_0303_d72e0b69_Rx (ComIPdu):
        ComIPduDirection = RECEIVE
        ComIPduType = NORMAL
        ComIPduHandleId = 67
        ComIPduSignalProcessing = DEFERRED
        ComIPduCancellationSupport = false
        ComIPduGroupRef = VCU_oKAMA_FP_EPSChassis1_0303_Rx_00807295
        ComIPduSignalRef = Checksum_340_oYRS_7_oKAMA_FP_EPSChassis1_0303_cff9ab5d_Rx
        ComIPduSignalRef = MessageCounter_340_oYRS_7_oKAMA_FP_EPSChassis1_0303_c1e387d0_Rx
        ComIPduSignalRef = YRS_AxRateFailure_oYRS_7_oKAMA_FP_EPSChassis1_0303_63b15d63_Rx
        ComIPduSignalRef = YRS_AyRateFailure_oYRS_7_oKAMA_FP_EPSChassis1_0303_c027752f_Rx
        ComIPduSignalRef = YRS_BusOff_oYRS_7_oKAMA_FP_EPSChassis1_0303_50939f50_Rx
        ComIPduSignalRef = YRS_DirectionCalibrationResult_oYRS_7_oKAMA_FP_EPSChassis1_0303_60b7a114_Rx
        ComIPduSignalRef = YRS_YawRateFailure_oYRS_7_oKAMA_FP_EPSChassis1_0303_53920292_Rx
        ComIPduSignalRef = YRS_ZeroCalibrationResult_oYRS_7_oKAMA_FP_EPSChassis1_0303_ccc109a5_Rx
        ComPduIdRef = YRS_7_oKAMA_FP_EPSChassis1_0303_d72e0b69_Rx
      37 x ComSignal, all with ComTimeout=0, ComSignalAccess=ACCESS_UNCLEAR:
        IBS_AVHAvailable_oIBS_Status2_oKAMA_FP_EPSChassis1_0303_b75bd207_Rx: ComBitPosition=33, ComBitSize=1, ComSignalEndianness=BIG_ENDIAN, ComSignalInitValue=0, ComSignalType=BOOLEAN, ComHandleId=282, ComSystemTemplateSystemSignalRef=IBS_AVHAvailable
        DCDC_OutputVoltHighFault_oDCDC_VCU_02_oKAMA_FP_EPT_0303_d3f5b73e_Rx: ComBitPosition=2, ComBitSize=1, ComSignalEndianness=BIG_ENDIAN, ComSignalInitValue=0, ComSignalType=BOOLEAN, ComHandleId=219, ComSystemTemplateSystemSignalRef=DCDC_OutputVoltHighFault
        VCU_ActualGear_oVCU_MCU01_oKAMA_FP_EPT_0303_a879e708_Tx: ComBitPosition=22, ComBitSize=3, ComSignalEndianness=BIG_ENDIAN, ComSignalInitValue=0, ComSignalType=UINT8, ComTransferProperty=PENDING, ComHandleId=41, ComSystemTemplateSystemSignalRef=VCU_ActualGear
        OBC_OutputDCChargeCurrent_oOBC_VCU_STATUS2_oKAMA_FP_EPT_0303_ea500141_Rx: ComBitPosition=15, ComBitSize=13, ComSignalEndianness=BIG_ENDIAN, ComSignalInitValue=0, ComSignalType=UINT16, ComHandleId=462, ComSystemTemplateSystemSignalRef=OBC_OutputDCChargeCurrent
        EGSM_Pbutton_oDonorCar_GSM_oKAMA_FP_EPSChassis1_0303_0a0b755f_Rx: ComBitPosition=1, ComBitSize=2, ComSignalEndianness=BIG_ENDIAN, ComSignalInitValue=0, ComSignalType=UINT8, ComHandleId=251, ComSystemTemplateSystemSignalRef=EGSM_Pbutton
        POD_DCPosRelayState_oPOD_VCU_Status_02_oKAMA_FP_EPT_0303_6bf0e2d8_Rx: ComBitPosition=7, ComBitSize=2, ComSignalEndianness=BIG_ENDIAN, ComSignalInitValue=0, ComSignalType=UINT8, ComHandleId=485, ComSystemTemplateSystemSignalRef=POD_DCPosRelayState
        VCU_UdcCurr_oVCU_MCU_7A_oKAMA_FP_EPSChassis1_0303_73bf9c90_Tx: ComBitPosition=12, ComBitSize=10, ComSignalEndianness=BIG_ENDIAN, ComSignalInitValue=0, ComSignalType=UINT16, ComTransferProperty=PENDING, ComHandleId=115, ComSystemTemplateSystemSignalRef=VCU_UdcCurr
        DCDC_OutputVoltLowFault_oDCDC_VCU_02_oKAMA_FP_EPT_0303_836398cd_Rx: ComBitPosition=1, ComBitSize=1, ComSignalEndianness=BIG_ENDIAN, ComSignalInitValue=0, ComSignalType=BOOLEAN, ComHandleId=220, ComSystemTemplateSystemSignalRef=DCDC_OutputVoltLowFault
        DCDC_SecordarySideOvertempStatus_oDCDC_VCU_02_oKAMA_FP_EPT_0303_c4a03957_Rx: ComBitPosition=15, ComBitSize=1, ComSignalEndianness=BIG_ENDIAN, ComSignalInitValue=0, ComSignalType=BOOLEAN, ComHandleId=223, ComSystemTemplateSystemSignalRef=DCDC_SecordarySideOvertempStatus
        VCU_EnergyChargeSession_oVCU_PlugInChrgInfo1_oKAMA_FP_EPSChassis1_0303_b775b774_Tx: ComBitPosition=39, ComBitSize=11, ComSignalEndianness=BIG_ENDIAN, ComSignalInitValue=0, ComSignalType=UINT16, ComTransferProperty=PENDING, ComHandleId=64, ComSystemTemplateSystemSignalRef=VCU_EnergyChargeSession
        DCDC_OBC_CANBusoff_oDCDC_VCU_02_oKAMA_FP_EPT_0303_efbba3f7_Rx: ComBitPosition=23, ComBitSize=1, ComSignalEndianness=BIG_ENDIAN, ComSignalInitValue=0, ComSignalType=BOOLEAN, ComHandleId=214, ComSystemTemplateSystemSignalRef=DCDC_OBC_CANBusoff
        TCU_APTCState_oTCU_Status_oKAMA_FP_EPT_0303_68b124a6_Rx: ComBitPosition=42, ComBitSize=2, ComSignalEndianness=BIG_ENDIAN, ComSignalInitValue=0, ComSignalType=UINT8, ComHandleId=492, ComSystemTemplateSystemSignalRef=TCU_APTCState
        BMS_HeatCommand_oBMS_TCU_oKAMA_FP_EPT_0303_09b5b913_Rx: ComBitPosition=47, ComBitSize=3, ComSignalEndianness=BIG_ENDIAN, ComSignalInitValue=0, ComSignalType=UINT8, ComHandleId=129, ComSystemTemplateSystemSignalRef=BMS_HeatCommand
        MessageCounter_152_oVCU_chassis_oKAMA_FP_EPSChassis1_0303_39cf1b1b_Tx: ComBitPosition=51, ComBitSize=4, ComSignalEndianness=BIG_ENDIAN, ComSignalInitValue=0, ComSignalType=UINT8, ComTransferProperty=PENDING, ComHandleId=21, ComSystemTemplateSystemSignalRef=MessageCounter_152
        ADAS_WorkModeReq_oADAS_CCU1_Ctrl_oKAMA_FP_EPSChassis1_0303_2245bd6a_Rx: ComBitPosition=23, ComBitSize=4, ComSignalEndianness=BIG_ENDIAN, ComSignalInitValue=0, ComSignalType=UINT8, ComHandleId=23, ComSystemTemplateSystemSignalRef=ADAS_WorkModeReq
        DCDC_ComFault_oDCDC_VCU_02_oKAMA_FP_EPT_0303_9177342e_Rx: ComBitPosition=12, ComBitSize=1, ComSignalEndianness=BIG_ENDIAN, ComSignalInitValue=0, ComSignalType=BOOLEAN, ComHandleId=204, ComSystemTemplateSystemSignalRef=DCDC_ComFault
        DCDC_InternalFault_oDCDC_VCU_02_oKAMA_FP_EPT_0303_9be61bd9_Rx: ComBitPosition=10, ComBitSize=1, ComSignalEndianness=BIG_ENDIAN, ComSignalInitValue=0, ComSignalType=BOOLEAN, ComHandleId=210, ComSystemTemplateSystemSignalRef=DCDC_InternalFault
        EPS_WorkMode_oEPS_FEEDBACK_oKAMA_FP_EPSChassis1_0303_571be72d_Rx: ComBitPosition=55, ComBitSize=4, ComSignalEndianness=BIG_ENDIAN, ComSignalInitValue=0, ComSignalType=UINT8, ComHandleId=258, ComSystemTemplateSystemSignalRef=EPS_WorkMode
        BMS_ErrorLowSOC_oBMS_ErrorInfo1_oKAMA_FP_EPT_0303_0f87fb5c_Rx: ComBitPosition=37, ComBitSize=2, ComSignalEndianness=BIG_ENDIAN, ComSignalInitValue=0, ComSignalType=UINT8, ComHandleId=119, ComSystemTemplateSystemSignalRef=BMS_ErrorLowSOC
        UDS_EPT_BootCmd3_oUds_EPT_Boot_Request_oKAMA_FP_EPT_0303_d322dcd4_Rx: ComBitPosition=16, ComBitSize=8, ComSignalEndianness=LITTLE_ENDIAN, ComSignalInitValue=0, ComSignalType=UINT8, ComHandleId=511, ComSystemTemplateSystemSignalRef=UDS_EPT_BootCmd3
        VCU_ActualGear_oVCU_AccPedal_oKAMA_FP_EPSChassis1_0303_a16a27f2_Tx: ComBitPosition=27, ComBitSize=3, ComSignalEndianness=BIG_ENDIAN, ComSignalInitValue=0, ComSignalType=UINT8, ComTransferProperty=PENDING, ComHandleId=40, ComSystemTemplateSystemSignalRef=VCU_ActualGear
        VCU_HVBatVolt_VCU_oVCU_PwrtrainHVbattStatus2_oKAMA_FP_EPSChassis1_0303_46d7dc97_Tx: ComBitPosition=31, ComBitSize=12, ComSignalEndianness=BIG_ENDIAN, ComSignalInitValue=0, ComSignalType=UINT16, ComTransferProperty=PENDING, ComHandleId=74, ComSystemTemplateSystemSignalRef=VCU_HVBatVolt_VCU
        AC_AirDistributionMode_oTCU_ACStatusInfo_oKAMA_FP_EPT_0303_c0475caf_Rx: ComBitPosition=18, ComBitSize=3, ComSignalEndianness=BIG_ENDIAN, ComSignalInitValue=0, ComSignalType=UINT8, ComHandleId=11, ComSystemTemplateSystemSignalRef=AC_AirDistributionMode
        APA_APAMode_oADAS_APA_oKAMA_FP_EPSChassis1_0303_719098d0_Rx: ComBitPosition=28, ComBitSize=4, ComSignalEndianness=BIG_ENDIAN, ComSignalInitValue=0, ComSignalType=UINT8, ComHandleId=33, ComSystemTemplateSystemSignalRef=APA_APAMode
        Checksum_6A_oEPS_FEEDBACK_oKAMA_FP_EPSChassis1_0303_4006fd22_Rx: ComBitPosition=63, ComBitSize=8, ComSignalEndianness=BIG_ENDIAN, ComSignalInitValue=0, ComSignalType=UINT8, ComHandleId=195, ComSystemTemplateSystemSignalRef=Checksum_6A
        VCU_voltageFromExtChargerDc_oVCU_PlugInChrgInfo2_oKAMA_FP_EPSChassis1_0303_79e0b92b_Tx: ComBitPosition=34, ComBitSize=11, ComSignalEndianness=BIG_ENDIAN, ComSignalInitValue=0, ComSignalType=UINT16, ComTransferProperty=PENDING, ComHandleId=134, ComSystemTemplateSystemSignalRef=VCU_voltageFromExtChargerDc
        BMS_ErrorCellHighTemp_oBMS_ErrorInfo1_oKAMA_FP_EPT_0303_52599bee_Rx: ComBitPosition=3, ComBitSize=2, ComSignalEndianness=BIG_ENDIAN, ComSignalInitValue=0, ComSignalType=UINT8, ComHandleId=101, ComSystemTemplateSystemSignalRef=BMS_ErrorCellHighTemp
        VCU_TCUPowerAllowed_oVCU_TCU_oKAMA_FP_EPT_0303_c9668d8d_Tx: ComBitPosition=7, ComBitSize=8, ComSignalEndianness=BIG_ENDIAN, ComSignalInitValue=0, ComSignalType=UINT8, ComTransferProperty=PENDING, ComHandleId=109, ComSystemTemplateSystemSignalRef=VCU_TCUPowerAllowed
        VCU_CruiseControlStatus_oVCU_PwrtrainRequests_oKAMA_FP_EPSChassis1_0303_0b961c4e_Tx: ComBitPosition=19, ComBitSize=3, ComSignalEndianness=BIG_ENDIAN, ComSignalInitValue=0, ComSignalType=UINT8, ComTransferProperty=PENDING, ComHandleId=51, ComSystemTemplateSystemSignalRef=VCU_CruiseControlStatus
        VCU_BMS_Control_of_NegRelay_oVCU_BMS_oKAMA_FP_EPT_0303_daf51a5c_Tx: ComBitPosition=23, ComBitSize=2, ComSignalEndianness=BIG_ENDIAN, ComSignalInitValue=0, ComSignalType=UINT8, ComTransferProperty=PENDING, ComHandleId=46, ComSystemTemplateSystemSignalRef=VCU_BMS_Control_of_NegRelay
        VCU_DegradedRegenBraking_oVCU_HMIsignals_oKAMA_FP_EPSChassis1_0303_2763642c_Tx: ComBitPosition=8, ComBitSize=1, ComSignalEndianness=BIG_ENDIAN, ComSignalInitValue=0, ComSignalType=BOOLEAN, ComTransferProperty=PENDING, ComHandleId=55, ComSystemTemplateSystemSignalRef=VCU_DegradedRegenBraking
        EPS_SteeringwheelAngle_oEPS_FEEDBACK_oKAMA_FP_EPSChassis1_0303_9bb7fd08_Rx: ComBitPosition=7, ComBitSize=16, ComSignalEndianness=BIG_ENDIAN, ComSignalInitValue=7380, ComSignalType=UINT16, ComHandleId=257, ComSystemTemplateSystemSignalRef=EPS_SteeringwheelAngle
        VCU_AccelerationPedal_oVCU_AccPedal_oKAMA_FP_EPSChassis1_0303_2c6793be_Tx: ComBitPosition=7, ComBitSize=10, ComSignalEndianness=BIG_ENDIAN, ComSignalInitValue=0, ComSignalType=UINT16, ComTransferProperty=PENDING, ComHandleId=35, ComSystemTemplateSystemSignalRef=VCU_AccelerationPedal
        BMS_SingChgkwh_oBMS_ChargeEnergy_oKAMA_FP_EPT_0303_dc099465_Rx: ComBitPosition=7, ComBitSize=8, ComSignalEndianness=BIG_ENDIAN, ComSignalInitValue=0, ComSignalType=UINT8, ComHandleId=160, ComSystemTemplateSystemSignalRef=BMS_SingChgkwh
        IBS_ESPInfoLamp_oIBS_Status3_oKAMA_FP_EPSChassis1_0303_92916012_Rx: ComBitPosition=0, ComBitSize=1, ComSignalEndianness=BIG_ENDIAN, ComSignalInitValue=0, ComSignalType=BOOLEAN, ComHandleId=302, ComSystemTemplateSystemSignalRef=IBS_ESPInfoLamp
        EVCOM_CommunicationError_oEVCOM_State_oKAMA_FP_EPT_0303_549edb5d_Rx: ComBitPosition=2, ComBitSize=1, ComSignalEndianness=BIG_ENDIAN, ComSignalInitValue=0, ComSignalType=BOOLEAN, ComHandleId=260, ComSystemTemplateSystemSignalRef=EVCOM_CommunicationError
        OBC_StartUpAllowed_oOBC_Error_STATUS_oKAMA_FP_EPT_0303_5f4a22be_Rx: ComBitPosition=15, ComBitSize=1, ComSignalEndianness=BIG_ENDIAN, ComSignalInitValue=0, ComSignalType=BOOLEAN, ComHandleId=472, ComSystemTemplateSystemSignalRef=OBC_StartUpAllowed
      MCU_Temperature2_oKAMA_FP_EPT_0303_01c16f81_Rx (ComIPdu):
        ComIPduDirection = RECEIVE
        ComIPduType = NORMAL
        ComIPduHandleId = 49
        ComIPduSignalProcessing = DEFERRED
        ComIPduCancellationSupport = false
        ComIPduGroupRef = VCU_oKAMA_FP_EPT_0303_Rx_07e8d111
        ComIPduSignalRef = MCU_TempCurrCool_oMCU_Temperature2_oKAMA_FP_EPT_0303_dee5af2e_Rx
        ComIPduSignalRef = MCU_TempCurrStr1_oMCU_Temperature2_oKAMA_FP_EPT_0303_04a68532_Rx
        ComIPduSignalRef = MCU_TempCurrStr2_oMCU_Temperature2_oKAMA_FP_EPT_0303_5ec7ba52_Rx
        ComIPduSignalRef = MCU_TempCurrStr_oMCU_Temperature2_oKAMA_FP_EPT_0303_3aaa0a70_Rx
        ComIPduSignalRef = MCU_TempRiseCurrStr_oMCU_Temperature2_oKAMA_FP_EPT_0303_fed136d1_Rx
        ComIPduSignalRef = MCU_TempStatus_oMCU_Temperature2_oKAMA_FP_EPT_0303_499e911f_Rx
        ComPduIdRef = MCU_Temperature2_oKAMA_FP_EPT_0303_01c16f81_Rx
      20 x ComSignal, all with ComSignalEndianness=BIG_ENDIAN, ComTimeout=0, ComSignalAccess=ACCESS_UNCLEAR:
        ACC_ComfortLowBand_oADAS_ACC_oKAMA_FP_EPSChassis1_0303_177d56f3_Rx: ComBitPosition=23, ComBitSize=8, ComSignalInitValue=140, ComSignalType=UINT8, ComHandleId=0, ComSystemTemplateSystemSignalRef=ACC_ComfortLowBand
        BMS_ErrorSmoke_oBMS_ErrorInfo1_oKAMA_FP_EPT_0303_8449742c_Rx: ComBitPosition=46, ComBitSize=1, ComSignalInitValue=0, ComSignalType=BOOLEAN, ComHandleId=122, ComSystemTemplateSystemSignalRef=BMS_ErrorSmoke
        DM1_Byte5_oREPS_DM1_oKAMA_FP_EPSChassis1_0303_b9c2ba3b_Rx: ComBitPosition=47, ComBitSize=8, ComSignalInitValue=0, ComSignalType=UINT8, ComHandleId=231, ComSystemTemplateSystemSignalRef=DM1_Byte5
        VCU_CriSysFailure_oVCU_Fault_01_oKAMA_FP_EPT_0303_b5dca0b8_Tx: ComBitPosition=25, ComBitSize=2, ComSignalInitValue=0, ComSignalType=UINT8, ComTransferProperty=PENDING, ComHandleId=49, ComSystemTemplateSystemSignalRef=VCU_CriSysFailure
        BMS_ErrorEmergencyOffCrash_oBMS_ErrorInfo1_oKAMA_FP_EPT_0303_84deccdd_Rx: ComBitPosition=32, ComBitSize=1, ComSignalInitValue=0, ComSignalType=BOOLEAN, ComHandleId=111, ComSystemTemplateSystemSignalRef=BMS_ErrorEmergencyOffCrash
        OBC_ACPortTempAerror_oOBC_Error_STATUS_oKAMA_FP_EPT_0303_abb9c641_Rx: ComBitPosition=9, ComBitSize=1, ComSignalInitValue=0, ComSignalType=BOOLEAN, ComHandleId=429, ComSystemTemplateSystemSignalRef=OBC_ACPortTempAerror
        MMI_AC_OnKey_oDonorCar_MMI_AC_Command_oKAMA_FP_EPT_0303_08ae30b7_Rx: ComBitPosition=1, ComBitSize=1, ComSignalInitValue=0, ComSignalType=BOOLEAN, ComHandleId=395, ComSystemTemplateSystemSignalRef=MMI_AC_OnKey
        DM3_Byte2_oREPS_DM3_oKAMA_FP_EPSChassis1_0303_decf0890_Rx: ComBitPosition=23, ComBitSize=8, ComSignalInitValue=0, ComSignalType=UINT8, ComHandleId=244, ComSystemTemplateSystemSignalRef=DM3_Byte2
        BMS_MaxCellVoltageNO_oBMS_CellVoltage1_oKAMA_FP_EPT_0303_3c12aa06_Rx: ComBitPosition=47, ComBitSize=8, ComSignalInitValue=0, ComSignalType=UINT8, ComHandleId=137, ComSystemTemplateSystemSignalRef=BMS_MaxCellVoltageNO
        EVCOM_ActlOprtMode_oEVCOM_State_oKAMA_FP_EPT_0303_99e07245_Rx: ComBitPosition=52, ComBitSize=2, ComSignalInitValue=0, ComSignalType=UINT8, ComHandleId=259, ComSystemTemplateSystemSignalRef=EVCOM_ActlOprtMode
        IBS_CDPActive_oIBS_Status2_oKAMA_FP_EPSChassis1_0303_175fb0ee_Rx: ComBitPosition=26, ComBitSize=1, ComSignalInitValue=0, ComSignalType=BOOLEAN, ComHandleId=287, ComSystemTemplateSystemSignalRef=IBS_CDPActive
        BCM_FrontLeftDoorAjarStatus_oDonorCar_BCM_LDoorWindowState_oKAMA_FP_EPSChassis1_0303_a919870a_Rx: ComBitPosition=32, ComBitSize=1, ComSignalInitValue=0, ComSignalType=BOOLEAN, ComHandleId=49, ComSystemTemplateSystemSignalRef=BCM_FrontLeftDoorAjarStatus
        IBS_LiquidAlarm_oIBS_Status2_oKAMA_FP_EPSChassis1_0303_652223f4_Rx: ComBitPosition=35, ComBitSize=1, ComSignalInitValue=0, ComSignalType=BOOLEAN, ComHandleId=315, ComSystemTemplateSystemSignalRef=IBS_LiquidAlarm
        MCU_IGBTTempMax_oMCU_Temperature1_oKAMA_FP_EPT_0303_89ff04e3_Rx: ComBitPosition=31, ComBitSize=8, ComSignalInitValue=255, ComSignalType=UINT8, ComHandleId=356, ComSystemTemplateSystemSignalRef=MCU_IGBTTempMax
        APTC_IGBTFaltStatus_oAPTC_TCU_oKAMA_FP_EPT_0303_f2b8632d_Rx: ComBitPosition=5, ComBitSize=2, ComSignalInitValue=0, ComSignalType=UINT8, ComHandleId=43, ComSystemTemplateSystemSignalRef=APTC_IGBTFaltStatus
        POD_Temperature_oPOD_VCU_Status_01_oKAMA_FP_EPT_0303_d4d7e422_Rx: ComBitPosition=31, ComBitSize=8, ComSignalInitValue=255, ComSignalType=UINT8, ComHandleId=487, ComSystemTemplateSystemSignalRef=POD_Temperature
        DM3_Byte1_oREPS_DM3_oKAMA_FP_EPSChassis1_0303_84ae37f0_Rx: ComBitPosition=15, ComBitSize=8, ComSignalInitValue=0, ComSignalType=UINT8, ComHandleId=243, ComSystemTemplateSystemSignalRef=DM3_Byte1
        BMS_RatEnergy_oBMS_BatInfor2_oKAMA_FP_EPT_0303_7dc4c3cb_Rx: ComBitPosition=55, ComBitSize=16, ComSignalInitValue=0, ComSignalType=UINT16, ComHandleId=154, ComSystemTemplateSystemSignalRef=BMS_RatEnergy
        IBS_EBDActive_oIBS_Status3_oKAMA_FP_EPSChassis1_0303_ed1a3441_Rx: ComBitPosition=15, ComBitSize=1, ComSignalInitValue=0, ComSignalType=BOOLEAN, ComHandleId=289, ComSystemTemplateSystemSignalRef=IBS_EBDActive
        VCU_TargetDeceleration_oVCU_AccPedal_oKAMA_FP_EPSChassis1_0303_a959a382_Tx: ComBitPosition=43, ComBitSize=8, ComSignalInitValue=140, ComSignalType=UINT8, ComTransferProperty=PENDING, ComHandleId=110, ComSystemTemplateSystemSignalRef=VCU_TargetDeceleration
      BMS_ChargeStop_oKAMA_FP_EPT_0303_aeea1185_Rx (ComIPdu):
        ComIPduDirection = RECEIVE
        ComIPduType = NORMAL
        ComIPduHandleId = 11
        ComIPduSignalProcessing = DEFERRED
        ComIPduCancellationSupport = false
        ComIPduGroupRef = VCU_oKAMA_FP_EPT_0303_Rx_07e8d111
        ComIPduSignalRef = BMS_AbortAchiveSingleVolt_oBMS_ChargeStop_oKAMA_FP_EPT_0303_e577c42f_Rx
        ComIPduSignalRef = BMS_AbortAchiveTotalVolt_oBMS_ChargeStop_oKAMA_FP_EPT_0303_0c83125c_Rx
        ComIPduSignalRef = BMS_AbortAchivesetValue_oBMS_ChargeStop_oKAMA_FP_EPT_0303_8cb1da4e_Rx
        ComIPduSignalRef = BMS_AbortErrorCurrent_oBMS_ChargeStop_oKAMA_FP_EPT_0303_04e42606_Rx
        ComIPduSignalRef = BMS_AbortErrorVoltage_oBMS_ChargeStop_oKAMA_FP_EPT_0303_6dcfc714_Rx
        ComIPduSignalRef = BMS_AbortFaultBMSTemp_oBMS_ChargeStop_oKAMA_FP_EPT_0303_57447d3c_Rx
        ComIPduSignalRef = BMS_AbortFaultBatteryTemp_oBMS_ChargeStop_oKAMA_FP_EPT_0303_3fe01178_Rx
        ComIPduSignalRef = BMS_ChagComplete_oBMS_ChargeStop_oKAMA_FP_EPT_0303_71c50b25_Rx
        ComIPduSignalRef = BMS_ChrgDcChrgnReq_oBMS_ChargeStop_oKAMA_FP_EPT_0303_a146c945_Rx
        ComIPduSignalRef = BMS_DCChgMode_oBMS_ChargeStop_oKAMA_FP_EPT_0303_3d963533_Rx
        ComPduIdRef = BMS_ChargeStop_oKAMA_FP_EPT_0303_aeea1185_Rx
      3 x ComSignal, all with ComSignalEndianness=BIG_ENDIAN, ComSignalType=UINT8, ComTimeout=0, ComSignalAccess=ACCESS_UNCLEAR:
        BMS_PreRelayStatus_oBMS_DIRelayState_oKAMA_FP_EPT_0303_1751a172_Rx: ComBitPosition=1, ComBitSize=2, ComSignalInitValue=0, ComHandleId=151, ComSystemTemplateSystemSignalRef=BMS_PreRelayStatus
        DCDC_SecondarySideTemp_oDCDC_VCU_02_oKAMA_FP_EPT_0303_cf856b2c_Rx: ComBitPosition=31, ComBitSize=8, ComSignalInitValue=255, ComHandleId=222, ComSystemTemplateSystemSignalRef=DCDC_SecondarySideTemp
        BCM_RLHSHumidSensorValue_oGW_BCM_oKAMA_FP_EPT_0303_50945b36_Rx: ComBitPosition=23, ComBitSize=8, ComSignalInitValue=0, ComHandleId=50, ComSystemTemplateSystemSignalRef=BCM_RLHSHumidSensorValue
      OBC_VCU_CHRGSTATION_ST_oKAMA_FP_EPT_0303_04b5873f_Rx (ComIPdu):
        ComIPduDirection = RECEIVE
        ComIPduType = NORMAL
        ComIPduHandleId = 52
        ComIPduSignalProcessing = DEFERRED
        ComIPduCancellationSupport = false
        ComIPduGroupRef = VCU_oKAMA_FP_EPT_0303_Rx_07e8d111
        ComIPduSignalRef = OBC_CCCurrentLimit_oOBC_VCU_CHRGSTATION_ST_oKAMA_FP_EPT_0303_fbd61b32_Rx
        ComIPduSignalRef = OBC_CCStatus_oOBC_VCU_CHRGSTATION_ST_oKAMA_FP_EPT_0303_d68789ee_Rx
        ComIPduSignalRef = OBC_CPCurrentLimit_oOBC_VCU_CHRGSTATION_ST_oKAMA_FP_EPT_0303_d07af5c1_Rx
        ComIPduSignalRef = OBC_CPDuty_oOBC_VCU_CHRGSTATION_ST_oKAMA_FP_EPT_0303_d5be8004_Rx
        ComIPduSignalRef = OBC_CPFrequency_oOBC_VCU_CHRGSTATION_ST_oKAMA_FP_EPT_0303_dac52b9c_Rx
        ComIPduSignalRef = OBC_CPStatus_oOBC_VCU_CHRGSTATION_ST_oKAMA_FP_EPT_0303_04a122e7_Rx
        ComIPduSignalRef = OBC_ChargCapacibility_oOBC_VCU_CHRGSTATION_ST_oKAMA_FP_EPT_0303_a5f9f869_Rx
        ComIPduSignalRef = OBC_EMLockState_oOBC_VCU_CHRGSTATION_ST_oKAMA_FP_EPT_0303_1152b2ee_Rx
        ComIPduSignalRef = OBC_S2State_oOBC_VCU_CHRGSTATION_ST_oKAMA_FP_EPT_0303_ae3ab9ae_Rx
        ComPduIdRef = OBC_VCU_CHRGSTATION_ST_oKAMA_FP_EPT_0303_04b5873f_Rx
      18 x ComSignal, all with ComTimeout=0, ComSignalAccess=ACCESS_UNCLEAR:
        TCU_HVCHHVDCCurrent_oTCU_Status_oKAMA_FP_EPT_0303_95f720fc_Rx: ComBitPosition=23, ComBitSize=8, ComSignalEndianness=BIG_ENDIAN, ComSignalInitValue=0, ComSignalType=UINT8, ComHandleId=500, ComSystemTemplateSystemSignalRef=TCU_HVCHHVDCCurrent
        BMS_AbortFaultBatteryTemp_oBMS_ChargeStop_oKAMA_FP_EPT_0303_3fe01178_Rx: ComBitPosition=13, ComBitSize=2, ComSignalEndianness=BIG_ENDIAN, ComSignalInitValue=0, ComSignalType=UINT8, ComHandleId=61, ComSystemTemplateSystemSignalRef=BMS_AbortFaultBatteryTemp
        OBC_OutputDCChargeVoltage_oOBC_VCU_STATUS1_oKAMA_FP_EPT_0303_bad6dd41_Rx: ComBitPosition=39, ComBitSize=13, ComSignalEndianness=BIG_ENDIAN, ComSignalInitValue=0, ComSignalType=UINT16, ComHandleId=463, ComSystemTemplateSystemSignalRef=OBC_OutputDCChargeVoltage
        YRS_YawRateFailure_oYRS_7_oKAMA_FP_EPSChassis1_0303_53920292_Rx: ComBitPosition=8, ComBitSize=1, ComSignalEndianness=LITTLE_ENDIAN, ComSignalInitValue=0, ComSignalType=BOOLEAN, ComHandleId=520, ComSystemTemplateSystemSignalRef=YRS_YawRateFailure
        MessageCounter_AF_oBMS_BatInfor1_oKAMA_FP_EPT_0303_21d07ba3_Rx: ComBitPosition=51, ComBitSize=4, ComSignalEndianness=BIG_ENDIAN, ComSignalInitValue=0, ComSignalType=UINT8, ComHandleId=426, ComSystemTemplateSystemSignalRef=MessageCounter_AF
        BMS_ErrorHallOffline_oBMS_ErrorInfo1_oKAMA_FP_EPT_0303_6f921dfd_Rx: ComBitPosition=29, ComBitSize=1, ComSignalEndianness=BIG_ENDIAN, ComSignalInitValue=0, ComSignalType=BOOLEAN, ComHandleId=113, ComSystemTemplateSystemSignalRef=BMS_ErrorHallOffline
        OBC_ACPortTempA_oOBC_VCU_STATUS2_oKAMA_FP_EPT_0303_fb0087e5_Rx: ComBitPosition=31, ComBitSize=8, ComSignalEndianness=BIG_ENDIAN, ComSignalInitValue=255, ComSignalType=UINT8, ComHandleId=428, ComSystemTemplateSystemSignalRef=OBC_ACPortTempA
        BMS_PackVoltage_oBMS_PackVoltage_oKAMA_FP_EPT_0303_f61cb460_Rx: ComBitPosition=7, ComBitSize=16, ComSignalEndianness=BIG_ENDIAN, ComSignalInitValue=0, ComSignalType=UINT16, ComHandleId=148, ComSystemTemplateSystemSignalRef=BMS_PackVoltage
        VCU_HVILError_oVCU_HMIsignals_oKAMA_FP_EPSChassis1_0303_bf4b87d4_Tx: ComBitPosition=0, ComBitSize=1, ComSignalEndianness=BIG_ENDIAN, ComSignalInitValue=0, ComSignalType=BOOLEAN, ComTransferProperty=PENDING, ComHandleId=75, ComSystemTemplateSystemSignalRef=VCU_HVILError
        BMS_MinCellVoltage_oBMS_CellVoltage1_oKAMA_FP_EPT_0303_4fcd821a_Rx: ComBitPosition=23, ComBitSize=16, ComSignalEndianness=BIG_ENDIAN, ComSignalInitValue=0, ComSignalType=UINT16, ComHandleId=145, ComSystemTemplateSystemSignalRef=BMS_MinCellVoltage
        POD_DCInletTempA_oPOD_VCU_Status_01_oKAMA_FP_EPT_0303_c727af40_Rx: ComBitPosition=39, ComBitSize=8, ComSignalEndianness=BIG_ENDIAN, ComSignalInitValue=255, ComSignalType=UINT8, ComHandleId=480, ComSystemTemplateSystemSignalRef=POD_DCInletTempA
        VCU_MaxTorqueLimit_oVCU_MCU02_oKAMA_FP_EPT_0303_7fbf98d7_Tx: ComBitPosition=30, ComBitSize=11, ComSignalEndianness=BIG_ENDIAN, ComSignalInitValue=1023, ComSignalType=UINT16, ComTransferProperty=PENDING, ComHandleId=89, ComSystemTemplateSystemSignalRef=VCU_MaxTorqueLimit
        TCU_APTCRightCmd_oTCU_Cmd_oKAMA_FP_EPT_0303_5cce6618_Rx: ComBitPosition=15, ComBitSize=8, ComSignalEndianness=BIG_ENDIAN, ComSignalInitValue=0, ComSignalType=UINT8, ComHandleId=491, ComSystemTemplateSystemSignalRef=TCU_APTCRightCmd
        OBC_CCStatus_oOBC_VCU_CHRGSTATION_ST_oKAMA_FP_EPT_0303_d68789ee_Rx: ComBitPosition=15, ComBitSize=3, ComSignalEndianness=BIG_ENDIAN, ComSignalInitValue=0, ComSignalType=UINT8, ComHandleId=436, ComSystemTemplateSystemSignalRef=OBC_CCStatus
        MessageCounter_101_oADAS_CCU1_Ctrl_oKAMA_FP_EPSChassis1_0303_1e8b10bb_Rx: ComBitPosition=51, ComBitSize=4, ComSignalEndianness=BIG_ENDIAN, ComSignalInitValue=0, ComSignalType=UINT8, ComHandleId=420, ComSystemTemplateSystemSignalRef=MessageCounter_101
        BMS_ChagComplete_oBMS_ChargeStop_oKAMA_FP_EPT_0303_71c50b25_Rx: ComBitPosition=21, ComBitSize=4, ComSignalEndianness=BIG_ENDIAN, ComSignalInitValue=0, ComSignalType=UINT8, ComHandleId=87, ComSystemTemplateSystemSignalRef=BMS_ChagComplete
        GSM_AliveCounter_oDonorCar_GSM_oKAMA_FP_EPSChassis1_0303_ae6f8122_Rx: ComBitPosition=51, ComBitSize=4, ComSignalEndianness=BIG_ENDIAN, ComSignalInitValue=0, ComSignalType=UINT8, ComHandleId=277, ComSystemTemplateSystemSignalRef=GSM_AliveCounter
        IBS_VehicleSpeed_oIBS_Status3_oKAMA_FP_EPSChassis1_0303_af4591ed_Rx: ComBitPosition=36, ComBitSize=13, ComSignalEndianness=BIG_ENDIAN, ComSignalInitValue=6400, ComSignalType=UINT16, ComHandleId=339, ComSystemTemplateSystemSignalRef=IBS_VehicleSpeed
      BMS_VersionInfor_oKAMA_FP_EPT_0303_0f4b45f4_Rx (ComIPdu):
        ComIPduDirection = RECEIVE
        ComIPduType = NORMAL
        ComIPduHandleId = 21
        ComIPduSignalProcessing = DEFERRED
        ComIPduCancellationSupport = false
        ComIPduGroupRef = VCU_oKAMA_FP_EPT_0303_Rx_07e8d111
        ComIPduSignalRef = BMS_BRMVersions_oBMS_VersionInfor_oKAMA_FP_EPT_0303_374dfe3b_Rx
        ComIPduSignalRef = BMS_BatProRights_oBMS_VersionInfor_oKAMA_FP_EPT_0303_4b15e936_Rx
        ComIPduSignalRef = BMS_ComVersion_oBMS_VersionInfor_oKAMA_FP_EPT_0303_63e41227_Rx
        ComIPduSignalRef = BMS_HardVsesion_oBMS_VersionInfor_oKAMA_FP_EPT_0303_0425e35d_Rx
        ComIPduSignalRef = BMS_Life_oBMS_VersionInfor_oKAMA_FP_EPT_0303_c03d820e_Rx
        ComIPduSignalRef = BMS_SoftVsesion_oBMS_VersionInfor_oKAMA_FP_EPT_0303_e5dc0b22_Rx
        ComPduIdRef = BMS_VersionInfor_oKAMA_FP_EPT_0303_0f4b45f4_Rx
      10 x ComSignal, all with ComTimeout=0, ComSignalAccess=ACCESS_UNCLEAR:
        BMS_MaxChagVoltage_oBMS_Charge1_oKAMA_FP_EPT_0303_245ba8e6_Rx: ComBitPosition=23, ComBitSize=16, ComSignalEndianness=BIG_ENDIAN, ComSignalInitValue=0, ComSignalType=UINT16, ComHandleId=139, ComSystemTemplateSystemSignalRef=BMS_MaxChagVoltage
        TCU_CompMaxAllowPwrCmsp_oTCU_Cmd_oKAMA_FP_EPT_0303_fe53e1f3_Rx: ComBitPosition=47, ComBitSize=8, ComSignalEndianness=BIG_ENDIAN, ComSignalInitValue=0, ComSignalType=SINT8, ComHandleId=496, ComSystemTemplateSystemSignalRef=TCU_CompMaxAllowPwrCmsp
        MCU_IGBTTempRiseU_oMCU_Temperature1_oKAMA_FP_EPT_0303_67682fde_Rx: ComBitPosition=39, ComBitSize=8, ComSignalEndianness=BIG_ENDIAN, ComSignalInitValue=255, ComSignalType=UINT8, ComHandleId=358, ComSystemTemplateSystemSignalRef=MCU_IGBTTempRiseU
        APTC_LeftCoreTemp_oAPTC_TCU_oKAMA_FP_EPT_0303_35b239ff_Rx: ComBitPosition=15, ComBitSize=8, ComSignalEndianness=BIG_ENDIAN, ComSignalInitValue=40, ComSignalType=UINT8, ComHandleId=44, ComSystemTemplateSystemSignalRef=APTC_LeftCoreTemp
        BMS_BattVolt_oBMS_BatInfor1_oKAMA_FP_EPT_0303_e09a9b0e_Rx: ComBitPosition=7, ComBitSize=14, ComSignalEndianness=BIG_ENDIAN, ComSignalInitValue=0, ComSignalType=UINT16, ComHandleId=85, ComSystemTemplateSystemSignalRef=BMS_BattVolt
        AC_MaxAcState_oTCU_ACStatusInfo_oKAMA_FP_EPT_0303_4417deab_Rx: ComBitPosition=2, ComBitSize=1, ComSignalEndianness=BIG_ENDIAN, ComSignalInitValue=0, ComSignalType=BOOLEAN, ComHandleId=16, ComSystemTemplateSystemSignalRef=AC_MaxAcState
        UDS_EPT_BootCmd2_oUds_EPT_Boot_Request_oKAMA_FP_EPT_0303_3b354c75_Rx: ComBitPosition=8, ComBitSize=8, ComSignalEndianness=LITTLE_ENDIAN, ComSignalInitValue=0, ComSignalType=UINT8, ComHandleId=510, ComSystemTemplateSystemSignalRef=UDS_EPT_BootCmd2
        BMS_MinCellVoltageNO_oBMS_CellVoltage1_oKAMA_FP_EPT_0303_5b38c322_Rx: ComBitPosition=55, ComBitSize=8, ComSignalEndianness=BIG_ENDIAN, ComSignalInitValue=0, ComSignalType=UINT8, ComHandleId=144, ComSystemTemplateSystemSignalRef=BMS_MinCellVoltageNO
        TCU_HvOnReq_oTCU_Status_oKAMA_FP_EPT_0303_c5e07206_Rx: ComBitPosition=0, ComBitSize=1, ComSignalEndianness=BIG_ENDIAN, ComSignalInitValue=0, ComSignalType=BOOLEAN, ComHandleId=504, ComSystemTemplateSystemSignalRef=TCU_HvOnReq
        VCU_HVInsulResFault_oVCU_HMIsignals_oKAMA_FP_EPSChassis1_0303_83b645f6_Tx: ComBitPosition=14, ComBitSize=1, ComSignalEndianness=BIG_ENDIAN, ComSignalInitValue=0, ComSignalType=BOOLEAN, ComTransferProperty=PENDING, ComHandleId=76, ComSystemTemplateSystemSignalRef=VCU_HVInsulResFault
      3 x ComIPdu, all with ComIPduType=NORMAL, ComIPduSignalProcessing=DEFERRED, ComIPduCancellationSupport=false:
        TCU_Cmd_oKAMA_FP_EPT_0303_2f814a9a_Rx: ComIPduDirection=RECEIVE, ComIPduHandleId=62, ComIPduGroupRef=VCU_oKAMA_FP_EPT_0303_Rx_07e8d111, ComIPduSignalRef=Checksum_2C1_oTCU_Cmd_oKAMA_FP_EPT_0303_969b2a12_Rx, ComIPduSignalRef=MessageCounter_2C1_oTCU_Cmd_oKAMA_FP_EPT_0303_421443bf_Rx, ComIPduSignalRef=TCU_APTC1Enable_oTCU_Cmd_oKAMA_FP_EPT_0303_5a9ca1b3_Rx, ComIPduSignalRef=TCU_APTCLeftCmd_oTCU_Cmd_oKAMA_FP_EPT_0303_04893b04_Rx, ComIPduSignalRef=TCU_APTCRightCmd_oTCU_Cmd_oKAMA_FP_EPT_0303_5cce6618_Rx, ComIPduSignalRef=TCU_CompEnable_oTCU_Cmd_oKAMA_FP_EPT_0303_f170584d_Rx, ComIPduSignalRef=TCU_CompMaxAllowPwrCmsp_oTCU_Cmd_oKAMA_FP_EPT_0303_fe53e1f3_Rx, ComIPduSignalRef=TCU_CompTargetSpeed_oTCU_Cmd_oKAMA_FP_EPT_0303_c78c1b78_Rx, ComPduIdRef=TCU_Cmd_oKAMA_FP_EPT_0303_2f814a9a_Rx
        YRS_2_oKAMA_FP_EPSChassis1_0303_d8e37b6d_Rx: ComIPduDirection=RECEIVE, ComIPduHandleId=66, ComIPduGroupRef=VCU_oKAMA_FP_EPSChassis1_0303_Rx_00807295, ComIPduSignalRef=Checksum_131_oYRS_2_oKAMA_FP_EPSChassis1_0303_166f48bf_Rx, ComIPduSignalRef=MessageCounter_131_oYRS_2_oKAMA_FP_EPSChassis1_0303_18756432_Rx, ComIPduSignalRef=YRS_AxStatus_oYRS_2_oKAMA_FP_EPSChassis1_0303_b2c11dfd_Rx, ComIPduSignalRef=YRS_Ax_oYRS_2_oKAMA_FP_EPSChassis1_0303_24d81f17_Rx, ComPduIdRef=YRS_2_oKAMA_FP_EPSChassis1_0303_d8e37b6d_Rx
        VCU_DCDC_oKAMA_FP_EPT_0303_cea088c8_Tx: ComIPduDirection=SEND, ComIPduHandleId=3, ComIPduGroupRef=VCU_oKAMA_FP_EPT_0303_Tx_51b27697, ComIPduSignalRef=Checksum_273_oVCU_DCDC_oKAMA_FP_EPT_0303_9303159d_Tx, ComIPduSignalRef=MessageCounter_273_oVCU_DCDC_oKAMA_FP_EPT_0303_3bb045a1_Tx, ComIPduSignalRef=VCU_ModeRequestDCDC_oVCU_DCDC_oKAMA_FP_EPT_0303_f4977e35_Tx, ComIPduSignalRef=VCU_VoltageDemandLV_oVCU_DCDC_oKAMA_FP_EPT_0303_e3442b89_Tx, ComPduIdRef=VCU_DCDC_oKAMA_FP_EPT_0303_cea088c8_Tx
          ComTxIPdu: ComMinimumDelayTime=0, ComTxIPduUnusedAreasDefault=0
            ComTxModeTrue
              ComTxMode: ComTxModeMode=PERIODIC, ComTxModeTimeOffset=0, ComTxModeTimePeriod=0.1
            ComTxModeFalse
              ComTxMode: ComTxModeMode=PERIODIC, ComTxModeTimeOffset=0, ComTxModeTimePeriod=0.1
      BMS_ErrorCellOverVolt_oBMS_ErrorInfo1_oKAMA_FP_EPT_0303_e85166e5_Rx (ComSignal):
        ComBitPosition = 7
        ComBitSize = 2
        ComSignalEndianness = BIG_ENDIAN
        ComSignalInitValue = 0
        ComSignalType = UINT8
        ComTimeout = 0
        ComSignalAccess = ACCESS_UNCLEAR
        ComHandleId = 103
        ComSystemTemplateSystemSignalRef = BMS_ErrorCellOverVolt
      VCU_driverTorqueRequest_oVCU_chassis_oKAMA_FP_EPSChassis1_0303_2cc8e1fb_Tx (ComSignal):
        ComBitPosition = 7
        ComBitSize = 11
        ComSignalEndianness = BIG_ENDIAN
        ComSignalInitValue = 1023
        ComSignalType = UINT16
        ComTimeout = 0
        ComTransferProperty = PENDING
        ComSignalAccess = ACCESS_UNCLEAR
        ComHandleId = 129
        ComSystemTemplateSystemSignalRef = VCU_driverTorqueRequest
      VCU_HVbattStatus1_oKAMA_FP_EPSChassis1_0303_5305e357_Tx (ComIPdu):
        ComIPduDirection = SEND
        ComIPduType = NORMAL
        ComIPduHandleId = 6
        ComIPduSignalProcessing = DEFERRED
        ComIPduCancellationSupport = false
        ComIPduGroupRef = VCU_oKAMA_FP_EPSChassis1_0303_Tx_56dad513
        ComIPduSignalRef = VCU_AvaDrvRange_oVCU_HVbattStatus1_oKAMA_FP_EPSChassis1_0303_18b832e7_Tx
        ComIPduSignalRef = VCU_EnergyReturnedRegen_oVCU_HVbattStatus1_oKAMA_FP_EPSChassis1_0303_7b2a2c28_Tx
        ComPduIdRef = VCU_HVbattStatus1_oKAMA_FP_EPSChassis1_0303_5305e357_Tx
        ComTxIPdu: ComMinimumDelayTime=0, ComTxIPduUnusedAreasDefault=0
          ComTxModeTrue
            ComTxMode: ComTxModeMode=PERIODIC, ComTxModeTimeOffset=0, ComTxModeTimePeriod=0.2
          ComTxModeFalse
            ComTxMode: ComTxModeMode=PERIODIC, ComTxModeTimeOffset=0, ComTxModeTimePeriod=0.2
      3 x ComSignal, all with ComSignalInitValue=0, ComTimeout=0, ComSignalAccess=ACCESS_UNCLEAR:
        YRS_AxRateFailure_oYRS_7_oKAMA_FP_EPSChassis1_0303_63b15d63_Rx: ComBitPosition=11, ComBitSize=1, ComSignalEndianness=LITTLE_ENDIAN, ComSignalType=BOOLEAN, ComHandleId=512, ComSystemTemplateSystemSignalRef=YRS_AxRateFailure
        BMS_MaxCellTempNO_oBMS_Temp_oKAMA_FP_EPT_0303_0e589b9a_Rx: ComBitPosition=55, ComBitSize=8, ComSignalEndianness=BIG_ENDIAN, ComSignalType=UINT8, ComHandleId=134, ComSystemTemplateSystemSignalRef=BMS_MaxCellTempNO
        MCU_bDernTempCool_oMCU_DeratingStatus_oKAMA_FP_EPT_0303_bc6d3c4a_Rx: ComBitPosition=13, ComBitSize=1, ComSignalEndianness=BIG_ENDIAN, ComSignalType=BOOLEAN, ComHandleId=385, ComSystemTemplateSystemSignalRef=MCU_bDernTempCool
      BMS_ChargeEnergy_oKAMA_FP_EPT_0303_67f5cf8b_Rx (ComIPdu):
        ComIPduDirection = RECEIVE
        ComIPduType = NORMAL
        ComIPduHandleId = 10
        ComIPduSignalProcessing = DEFERRED
        ComIPduCancellationSupport = false
        ComIPduGroupRef = VCU_oKAMA_FP_EPT_0303_Rx_07e8d111
        ComIPduSignalRef = BMS_BatChagSum_oBMS_ChargeEnergy_oKAMA_FP_EPT_0303_c61693b2_Rx
        ComIPduSignalRef = BMS_SingChgkwh_oBMS_ChargeEnergy_oKAMA_FP_EPT_0303_dc099465_Rx
        ComIPduSignalRef = BMS_SumChgkwh_oBMS_ChargeEnergy_oKAMA_FP_EPT_0303_c03c2779_Rx
        ComPduIdRef = BMS_ChargeEnergy_oKAMA_FP_EPT_0303_67f5cf8b_Rx
      13 x ComSignal, all with ComTimeout=0, ComSignalAccess=ACCESS_UNCLEAR:
        Checksum_5F_oIBS_VCUVLC_oKAMA_FP_EPSChassis1_0303_7ca73c24_Rx: ComBitPosition=63, ComBitSize=8, ComSignalEndianness=BIG_ENDIAN, ComSignalInitValue=0, ComSignalType=UINT8, ComHandleId=193, ComSystemTemplateSystemSignalRef=Checksum_5F
        Checksum_101_oADAS_CCU1_Ctrl_oKAMA_FP_EPSChassis1_0303_deec224a_Rx: ComBitPosition=63, ComBitSize=8, ComSignalEndianness=BIG_ENDIAN, ComSignalInitValue=0, ComSignalType=UINT8, ComHandleId=197, ComSystemTemplateSystemSignalRef=Checksum_101
        Checksum_59_oIBS_WheelPulse_oKAMA_FP_EPSChassis1_0303_76e68916_Rx: ComBitPosition=63, ComBitSize=8, ComSignalEndianness=BIG_ENDIAN, ComSignalInitValue=0, ComSignalType=UINT8, ComHandleId=196, ComSystemTemplateSystemSignalRef=Checksum_59
        VCU_VirtualPedal_oVCU_AccPedal_oKAMA_FP_EPSChassis1_0303_aea157a2_Tx: ComBitPosition=12, ComBitSize=10, ComSignalEndianness=BIG_ENDIAN, ComSignalInitValue=0, ComSignalType=UINT16, ComTransferProperty=PENDING, ComHandleId=122, ComSystemTemplateSystemSignalRef=VCU_VirtualPedal
        YRS_YawRate_oYRS_1_oKAMA_FP_EPSChassis1_0303_203c933c_Rx: ComBitPosition=0, ComBitSize=16, ComSignalEndianness=LITTLE_ENDIAN, ComSignalInitValue=32768, ComSignalType=UINT16, ComHandleId=522, ComSystemTemplateSystemSignalRef=YRS_YawRate
        MessageCounter_047_oVCU_MCU02_oKAMA_FP_EPT_0303_0b0aebf5_Tx: ComBitPosition=51, ComBitSize=4, ComSignalEndianness=BIG_ENDIAN, ComSignalInitValue=0, ComSignalType=UINT8, ComTransferProperty=PENDING, ComHandleId=19, ComSystemTemplateSystemSignalRef=MessageCounter_047
        VCU_cruiseControlSetUnit_oVCU_PwrtrainRequests_oKAMA_FP_EPSChassis1_0303_660a3a8a_Tx: ComBitPosition=6, ComBitSize=1, ComSignalEndianness=BIG_ENDIAN, ComSignalInitValue=0, ComSignalType=BOOLEAN, ComTransferProperty=PENDING, ComHandleId=126, ComSystemTemplateSystemSignalRef=VCU_cruiseControlSetUnit
        DCDC_LVOutputCurrent_oDCDC_VCU_01_oKAMA_FP_EPT_0303_fc484678_Rx: ComBitPosition=11, ComBitSize=12, ComSignalEndianness=BIG_ENDIAN, ComSignalInitValue=0, ComSignalType=UINT16, ComHandleId=211, ComSystemTemplateSystemSignalRef=DCDC_LVOutputCurrent
        MessageCounter_27B_oVCU_HMIsignals_oKAMA_FP_EPSChassis1_0303_8349569e_Tx: ComBitPosition=51, ComBitSize=4, ComSignalEndianness=BIG_ENDIAN, ComSignalInitValue=0, ComSignalType=UINT8, ComTransferProperty=PENDING, ComHandleId=15, ComSystemTemplateSystemSignalRef=MessageCounter_27B
        BMS_CellNumbers_oBMS_BatInfor2_oKAMA_FP_EPT_0303_2bfb15b7_Rx: ComBitPosition=15, ComBitSize=8, ComSignalEndianness=BIG_ENDIAN, ComSignalInitValue=0, ComSignalType=UINT8, ComHandleId=86, ComSystemTemplateSystemSignalRef=BMS_CellNumbers
        BMS_StateRelay6_oBMS_DIRelayState_oKAMA_FP_EPT_0303_a215b1ff_Rx: ComBitPosition=11, ComBitSize=2, ComSignalEndianness=BIG_ENDIAN, ComSignalInitValue=0, ComSignalType=UINT8, ComHandleId=171, ComSystemTemplateSystemSignalRef=BMS_StateRelay6
        VCU_UnavailRegenBraking_oVCU_HMIsignals_oKAMA_FP_EPSChassis1_0303_8efb1b67_Tx: ComBitPosition=23, ComBitSize=1, ComSignalEndianness=BIG_ENDIAN, ComSignalInitValue=0, ComSignalType=BOOLEAN, ComTransferProperty=PENDING, ComHandleId=118, ComSystemTemplateSystemSignalRef=VCU_UnavailRegenBraking
        Checksum_27E_oVCU_PlugInChrgInfo1_oKAMA_FP_EPSChassis1_0303_b28f9723_Tx: ComBitPosition=63, ComBitSize=8, ComSignalEndianness=BIG_ENDIAN, ComSignalInitValue=0, ComSignalType=UINT8, ComTransferProperty=PENDING, ComHandleId=4, ComSystemTemplateSystemSignalRef=Checksum_27E
      GW_BCM_oKAMA_FP_EPT_0303_144b8b19_Rx (ComIPdu):
        ComIPduDirection = RECEIVE
        ComIPduType = NORMAL
        ComIPduHandleId = 33
        ComIPduSignalProcessing = DEFERRED
        ComIPduCancellationSupport = false
        ComIPduGroupRef = VCU_oKAMA_FP_EPT_0303_Rx_07e8d111
        ComIPduSignalRef = BCM_RLHSHumidSensorValue_oGW_BCM_oKAMA_FP_EPT_0303_50945b36_Rx
        ComIPduSignalRef = BCM_RLHSSolarDrvr_oGW_BCM_oKAMA_FP_EPT_0303_656d224a_Rx
        ComIPduSignalRef = BCM_RLHSSolarPass_oGW_BCM_oKAMA_FP_EPT_0303_ae2c6629_Rx
        ComIPduSignalRef = BCM_RLHSTempDewPoint_oGW_BCM_oKAMA_FP_EPT_0303_b820e988_Rx
        ComIPduSignalRef = BCM_RLHSTempSensorValue_oGW_BCM_oKAMA_FP_EPT_0303_fecee294_Rx
        ComPduIdRef = GW_BCM_oKAMA_FP_EPT_0303_144b8b19_Rx
      8 x ComSignal, all with ComSignalEndianness=BIG_ENDIAN, ComTimeout=0, ComSignalAccess=ACCESS_UNCLEAR:
        IBS_EBDFault_oIBS_Status3_oKAMA_FP_EPSChassis1_0303_472cc7a8_Rx: ComBitPosition=2, ComBitSize=1, ComSignalInitValue=0, ComSignalType=BOOLEAN, ComHandleId=290, ComSystemTemplateSystemSignalRef=IBS_EBDFault
        MCU_IGBTTempV_oMCU_Temperature1_oKAMA_FP_EPT_0303_2da4e326_Rx: ComBitPosition=15, ComBitSize=8, ComSignalInitValue=255, ComSignalType=UINT8, ComHandleId=362, ComSystemTemplateSystemSignalRef=MCU_IGBTTempV
        OBC_DCVoltLowFault_oOBC_Error_STATUS_oKAMA_FP_EPT_0303_97de0e99_Rx: ComBitPosition=3, ComBitSize=1, ComSignalInitValue=0, ComSignalType=BOOLEAN, ComHandleId=450, ComSystemTemplateSystemSignalRef=OBC_DCVoltLowFault
        VCU_TCSActive_oVCU_MCU01_oKAMA_FP_EPT_0303_03bfce1f_Tx: ComBitPosition=23, ComBitSize=1, ComSignalInitValue=0, ComSignalType=BOOLEAN, ComTransferProperty=PENDING, ComHandleId=108, ComSystemTemplateSystemSignalRef=VCU_TCSActive
        DM3_Byte4_oREPS_DM3_oKAMA_FP_EPSChassis1_0303_6a0d7650_Rx: ComBitPosition=39, ComBitSize=8, ComSignalInitValue=0, ComSignalType=UINT8, ComHandleId=246, ComSystemTemplateSystemSignalRef=DM3_Byte4
        BMS_StateRelay7_oBMS_DIRelayState_oKAMA_FP_EPT_0303_22e5a6e0_Rx: ComBitPosition=9, ComBitSize=2, ComSignalInitValue=0, ComSignalType=UINT8, ComHandleId=172, ComSystemTemplateSystemSignalRef=BMS_StateRelay7
        EPS_SteeringwheelAngleSpeed_oEPS_FEEDBACK_oKAMA_FP_EPSChassis1_0303_f5101952_Rx: ComBitPosition=23, ComBitSize=8, ComSignalInitValue=0, ComSignalType=UINT8, ComHandleId=256, ComSystemTemplateSystemSignalRef=EPS_SteeringwheelAngleSpeed
        IBS_ABSACTIVEABS_oIBS_Status3_oKAMA_FP_EPSChassis1_0303_d92cee2f_Rx: ComBitPosition=7, ComBitSize=1, ComSignalInitValue=0, ComSignalType=BOOLEAN, ComHandleId=278, ComSystemTemplateSystemSignalRef=IBS_ABSACTIVEABS
      IBS_WheelPulse_oKAMA_FP_EPSChassis1_0303_72c6c64e_Rx (ComIPdu):
        ComIPduDirection = RECEIVE
        ComIPduType = NORMAL
        ComIPduHandleId = 41
        ComIPduSignalProcessing = DEFERRED
        ComIPduCancellationSupport = false
        ComIPduGroupRef = VCU_oKAMA_FP_EPSChassis1_0303_Rx_00807295
        ComIPduSignalRef = Checksum_59_oIBS_WheelPulse_oKAMA_FP_EPSChassis1_0303_76e68916_Rx
        ComIPduSignalRef = IBS_FLWheelPulseCounter_oIBS_WheelPulse_oKAMA_FP_EPSChassis1_0303_3418d77c_Rx
        ComIPduSignalRef = IBS_FRWheelPulseCounter_oIBS_WheelPulse_oKAMA_FP_EPSChassis1_0303_1c68419b_Rx
        ComIPduSignalRef = IBS_RLWheelPulseCounter_oIBS_WheelPulse_oKAMA_FP_EPSChassis1_0303_a94c2f35_Rx
        ComIPduSignalRef = IBS_RRWheelPulseCounter_oIBS_WheelPulse_oKAMA_FP_EPSChassis1_0303_813cb9d2_Rx
        ComIPduSignalRef = MessageCounter_59_oIBS_WheelPulse_oKAMA_FP_EPSChassis1_0303_abb8d569_Rx
        ComPduIdRef = IBS_WheelPulse_oKAMA_FP_EPSChassis1_0303_72c6c64e_Rx
      IBS_WheelSpeed_oKAMA_FP_EPSChassis1_0303_11b9484c_Rx (ComIPdu):
        ComIPduDirection = RECEIVE
        ComIPduType = NORMAL
        ComIPduHandleId = 42
        ComIPduSignalProcessing = DEFERRED
        ComIPduCancellationSupport = false
        ComIPduGroupRef = VCU_oKAMA_FP_EPSChassis1_0303_Rx_00807295
        ComIPduSignalRef = IBS_FLMovingDirection_oIBS_WheelSpeed_oKAMA_FP_EPSChassis1_0303_1770163f_Rx
        ComIPduSignalRef = IBS_FLWheelSpeed_Fault_oIBS_WheelSpeed_oKAMA_FP_EPSChassis1_0303_8f0c6df1_Rx
        ComIPduSignalRef = IBS_FLWheelSpeed_oIBS_WheelSpeed_oKAMA_FP_EPSChassis1_0303_33d2c0cb_Rx
        ComIPduSignalRef = IBS_FRMovingDirection_oIBS_WheelSpeed_oKAMA_FP_EPSChassis1_0303_3e6eabf9_Rx
        ComIPduSignalRef = IBS_FRWheelSpeedFault_oIBS_WheelSpeed_oKAMA_FP_EPSChassis1_0303_da66a821_Rx
        ComIPduSignalRef = IBS_FRWheelSpeed_oIBS_WheelSpeed_oKAMA_FP_EPSChassis1_0303_2e18f492_Rx
        ComIPduSignalRef = IBS_RLMovingDirection_oIBS_WheelSpeed_oKAMA_FP_EPSChassis1_0303_4b4447ef_Rx
        ComIPduSignalRef = IBS_RLWheelSpeed_Fault_oIBS_WheelSpeed_oKAMA_FP_EPSChassis1_0303_09838b74_Rx
        ComIPduSignalRef = IBS_RLWheelSpeed_oIBS_WheelSpeed_oKAMA_FP_EPSChassis1_0303_2f1efd73_Rx
        ComIPduSignalRef = IBS_RRMovingDirection_oIBS_WheelSpeed_oKAMA_FP_EPSChassis1_0303_625afa29_Rx
        ComIPduSignalRef = IBS_RRWheelSpeed_Fault_oIBS_WheelSpeed_oKAMA_FP_EPSChassis1_0303_7badf24c_Rx
        ComIPduSignalRef = IBS_RRWheelSpeed_oIBS_WheelSpeed_oKAMA_FP_EPSChassis1_0303_32d4c92a_Rx
        ComPduIdRef = IBS_WheelSpeed_oKAMA_FP_EPSChassis1_0303_11b9484c_Rx
      MCU_CpldVer_oMCU_SoftwareNumber_oKAMA_FP_EPT_0303_880e7a85_Rx (ComSignal):
        ComBitPosition = 39
        ComBitSize = 16
        ComSignalEndianness = BIG_ENDIAN
        ComSignalInitValue = 0
        ComSignalType = UINT16
        ComTimeout = 0
        ComSignalAccess = ACCESS_UNCLEAR
        ComHandleId = 349
        ComSystemTemplateSystemSignalRef = MCU_CpldVer
      BMS_ErrorInfo1_oKAMA_FP_EPT_0303_ebb790f1_Rx (ComIPdu):
        ComIPduDirection = RECEIVE
        ComIPduType = NORMAL
        ComIPduHandleId = 15
        ComIPduSignalProcessing = DEFERRED
        ComIPduCancellationSupport = false
        ComIPduGroupRef = VCU_oKAMA_FP_EPT_0303_Rx_07e8d111
        ComIPduSignalRef = BMS_DTC_oBMS_ErrorInfo1_oKAMA_FP_EPT_0303_3e05902d_Rx
        ComIPduSignalRef = BMS_ErrorBSUBalance_oBMS_ErrorInfo1_oKAMA_FP_EPT_0303_b679af66_Rx
        ComIPduSignalRef = BMS_ErrorBSUOffline_oBMS_ErrorInfo1_oKAMA_FP_EPT_0303_93b5f08f_Rx
        ComIPduSignalRef = BMS_ErrorBatVolt_oBMS_ErrorInfo1_oKAMA_FP_EPT_0303_6eaffe03_Rx
        ComIPduSignalRef = BMS_ErrorBattOverVolt_oBMS_ErrorInfo1_oKAMA_FP_EPT_0303_ce66d81a_Rx
        ComIPduSignalRef = BMS_ErrorBattUnderVolt_oBMS_ErrorInfo1_oKAMA_FP_EPT_0303_e5dc82a6_Rx
        ComIPduSignalRef = BMS_ErrorCellHighTemp_oBMS_ErrorInfo1_oKAMA_FP_EPT_0303_52599bee_Rx
        ComIPduSignalRef = BMS_ErrorCellLowTemp_oBMS_ErrorInfo1_oKAMA_FP_EPT_0303_c372ba9c_Rx
        ComIPduSignalRef = BMS_ErrorCellOverVolt_oBMS_ErrorInfo1_oKAMA_FP_EPT_0303_e85166e5_Rx
        ComIPduSignalRef = BMS_ErrorCellTempDiff_oBMS_ErrorInfo1_oKAMA_FP_EPT_0303_df89aaaf_Rx
        ComIPduSignalRef = BMS_ErrorCellTempOffline_oBMS_ErrorInfo1_oKAMA_FP_EPT_0303_96e84a72_Rx
        ComIPduSignalRef = BMS_ErrorCellUnderVolt_oBMS_ErrorInfo1_oKAMA_FP_EPT_0303_c8f85a95_Rx
        ComIPduSignalRef = BMS_ErrorCellVoltDiff_oBMS_ErrorInfo1_oKAMA_FP_EPT_0303_2ebca49f_Rx
        ComIPduSignalRef = BMS_ErrorCellVoltOffline_oBMS_ErrorInfo1_oKAMA_FP_EPT_0303_7ab346be_Rx
        ComIPduSignalRef = BMS_ErrorChaCurrentOver_oBMS_ErrorInfo1_oKAMA_FP_EPT_0303_fb588ab7_Rx
        ComIPduSignalRef = BMS_ErrorDisChaCurrentOver_oBMS_ErrorInfo1_oKAMA_FP_EPT_0303_79378d5b_Rx
        ComIPduSignalRef = BMS_ErrorEmergencyOffCrash_oBMS_ErrorInfo1_oKAMA_FP_EPT_0303_84deccdd_Rx
        ComIPduSignalRef = BMS_ErrorHVIL_oBMS_ErrorInfo1_oKAMA_FP_EPT_0303_b89e44e5_Rx
        ComIPduSignalRef = BMS_ErrorHallOffline_oBMS_ErrorInfo1_oKAMA_FP_EPT_0303_6f921dfd_Rx
        ComIPduSignalRef = BMS_ErrorHighSoc_oBMS_ErrorInfo1_oKAMA_FP_EPT_0303_c722d2b8_Rx
        ComIPduSignalRef = BMS_ErrorIsolationSingleLow_oBMS_ErrorInfo1_oKAMA_FP_EPT_0303_0101487b_Rx
        ComIPduSignalRef = BMS_ErrorLeakCurrent_oBMS_ErrorInfo1_oKAMA_FP_EPT_0303_bc78143b_Rx
        ComIPduSignalRef = BMS_ErrorLeakDet_oBMS_ErrorInfo1_oKAMA_FP_EPT_0303_d14e6399_Rx
        ComIPduSignalRef = BMS_ErrorLowSOC_oBMS_ErrorInfo1_oKAMA_FP_EPT_0303_0f87fb5c_Rx
        ComIPduSignalRef = BMS_ErrorPreChaFailed_oBMS_ErrorInfo1_oKAMA_FP_EPT_0303_9c1be185_Rx
        ComIPduSignalRef = BMS_ErrorRelay_oBMS_ErrorInfo1_oKAMA_FP_EPT_0303_abd512da_Rx
        ComIPduSignalRef = BMS_ErrorSmoke_oBMS_ErrorInfo1_oKAMA_FP_EPT_0303_8449742c_Rx
        ComIPduSignalRef = BMS_ErrorSoCJump_RM_oBMS_ErrorInfo1_oKAMA_FP_EPT_0303_e602fab2_Rx
        ComIPduSignalRef = BMS_ErrorSystemsMatch_oBMS_ErrorInfo1_oKAMA_FP_EPT_0303_f955b6a9_Rx
        ComIPduSignalRef = BMS_ThermalRunawayFault_oBMS_ErrorInfo1_oKAMA_FP_EPT_0303_29f4ecd4_Rx
        ComPduIdRef = BMS_ErrorInfo1_oKAMA_FP_EPT_0303_ebb790f1_Rx
      MCU_bDernOvrIdc_oMCU_DeratingStatus_oKAMA_FP_EPT_0303_e4315287_Rx (ComSignal):
        ComBitPosition = 6
        ComBitSize = 1
        ComSignalEndianness = BIG_ENDIAN
        ComSignalInitValue = 0
        ComSignalType = BOOLEAN
        ComTimeout = 0
        ComSignalAccess = ACCESS_UNCLEAR
        ComHandleId = 382
        ComSystemTemplateSystemSignalRef = MCU_bDernOvrIdc
      IBS_RRWheelPulseCounter_oIBS_WheelPulse_oKAMA_FP_EPSChassis1_0303_813cb9d2_Rx (ComSignal):
        ComBitPosition = 23
        ComBitSize = 8
        ComSignalEndianness = BIG_ENDIAN
        ComSignalInitValue = 0
        ComSignalType = UINT8
        ComTimeout = 0
        ComSignalAccess = ACCESS_UNCLEAR
        ComHandleId = 324
        ComSystemTemplateSystemSignalRef = IBS_RRWheelPulseCounter
      DonorCar_ACM_Status_oKAMA_FP_EPSChassis1_0303_ae435576_Rx (ComIPdu):
        ComIPduDirection = RECEIVE
        ComIPduType = NORMAL
        ComIPduHandleId = 25
        ComIPduSignalProcessing = DEFERRED
        ComIPduCancellationSupport = false
        ComIPduGroupRef = VCU_oKAMA_FP_EPSChassis1_0303_Rx_00807295
        ComIPduSignalRef = ACU_DrvSeatbeltBucklestatus_oDonorCar_ACM_Status_oKAMA_FP_EPSChassis1_0303_31dc3457_Rx
        ComIPduSignalRef = ACU_PassSeatbeltBucklestatus_oDonorCar_ACM_Status_oKAMA_FP_EPSChassis1_0303_c6f76e0d_Rx
        ComPduIdRef = DonorCar_ACM_Status_oKAMA_FP_EPSChassis1_0303_ae435576_Rx
      12 x ComSignal, all with ComSignalEndianness=BIG_ENDIAN, ComSignalInitValue=0, ComTimeout=0, ComSignalAccess=ACCESS_UNCLEAR:
        BMS_ErrorHVIL_oBMS_ErrorInfo1_oKAMA_FP_EPT_0303_b89e44e5_Rx: ComBitPosition=33, ComBitSize=1, ComSignalType=BOOLEAN, ComHandleId=112, ComSystemTemplateSystemSignalRef=BMS_ErrorHVIL
        VCU_RrMotorSpd_oVCU_HMIsignals_oKAMA_FP_EPSChassis1_0303_17805564_Tx: ComBitPosition=39, ComBitSize=8, ComSignalType=UINT8, ComTransferProperty=PENDING, ComHandleId=106, ComSystemTemplateSystemSignalRef=VCU_RrMotorSpd
        BMS_BatCode2_oBMS_Batcode_oKAMA_FP_EPT_0303_350f5c81_Rx: ComBitPosition=31, ComBitSize=8, ComSignalType=UINT8, ComHandleId=70, ComSystemTemplateSystemSignalRef=BMS_BatCode2
        OBC_EMLockState_oOBC_VCU_CHRGSTATION_ST_oKAMA_FP_EPT_0303_1152b2ee_Rx: ComBitPosition=49, ComBitSize=2, ComSignalType=UINT8, ComHandleId=451, ComSystemTemplateSystemSignalRef=OBC_EMLockState
        VCU_AccelerationPedalValid_oVCU_AccPedal_oKAMA_FP_EPSChassis1_0303_a0ecbfb8_Tx: ComBitPosition=13, ComBitSize=1, ComSignalType=BOOLEAN, ComTransferProperty=PENDING, ComHandleId=34, ComSystemTemplateSystemSignalRef=VCU_AccelerationPedalValid
        DM1_Byte6_oREPS_DM1_oKAMA_FP_EPSChassis1_0303_e3a3855b_Rx: ComBitPosition=55, ComBitSize=8, ComSignalType=UINT8, ComHandleId=232, ComSystemTemplateSystemSignalRef=DM1_Byte6
        VCU_OBC_Control_of_em_lock_oVCU_OBC_oKAMA_FP_EPT_0303_fc5c407f_Tx: ComBitPosition=6, ComBitSize=1, ComSignalType=BOOLEAN, ComTransferProperty=PENDING, ComHandleId=96, ComSystemTemplateSystemSignalRef=VCU_OBC_Control_of_em_lock
        IBS_ESPEnableSts_oIBS_Status3_oKAMA_FP_EPSChassis1_0303_0b5f88eb_Rx: ComBitPosition=1, ComBitSize=1, ComSignalType=BOOLEAN, ComHandleId=301, ComSystemTemplateSystemSignalRef=IBS_ESPEnableSts
        OBC_CPCurrentLimit_oOBC_VCU_CHRGSTATION_ST_oKAMA_FP_EPT_0303_d07af5c1_Rx: ComBitPosition=7, ComBitSize=8, ComSignalType=UINT8, ComHandleId=437, ComSystemTemplateSystemSignalRef=OBC_CPCurrentLimit
        AEB_ABALevel_oADAS_AEB_oKAMA_FP_EPSChassis1_0303_42fed090_Rx: ComBitPosition=1, ComBitSize=2, ComSignalType=UINT8, ComHandleId=24, ComSystemTemplateSystemSignalRef=AEB_ABALevel
        IBS_RLWheelSpeed_oIBS_WheelSpeed_oKAMA_FP_EPSChassis1_0303_2f1efd73_Rx: ComBitPosition=52, ComBitSize=13, ComSignalType=UINT16, ComHandleId=322, ComSystemTemplateSystemSignalRef=IBS_RLWheelSpeed
        TCU_TMSFaultLevel_oTCU_Status_oKAMA_FP_EPT_0303_1848d01e_Rx: ComBitPosition=3, ComBitSize=3, ComSignalType=UINT8, ComHandleId=505, ComSystemTemplateSystemSignalRef=TCU_TMSFaultLevel
      BMS_BatInfor1_oKAMA_FP_EPT_0303_46423d38_Rx (ComIPdu):
        ComIPduDirection = RECEIVE
        ComIPduType = NORMAL
        ComIPduHandleId = 5
        ComIPduSignalProcessing = DEFERRED
        ComIPduCancellationSupport = false
        ComIPduGroupRef = VCU_oKAMA_FP_EPT_0303_Rx_07e8d111
        ComIPduSignalRef = BMS_BattCurr_oBMS_BatInfor1_oKAMA_FP_EPT_0303_9e118383_Rx
        ComIPduSignalRef = BMS_BattVolt_oBMS_BatInfor1_oKAMA_FP_EPT_0303_e09a9b0e_Rx
        ComIPduSignalRef = Checksum_AF_oBMS_BatInfor1_oKAMA_FP_EPT_0303_e074c4ab_Rx
        ComIPduSignalRef = MessageCounter_AF_oBMS_BatInfor1_oKAMA_FP_EPT_0303_21d07ba3_Rx
        ComPduIdRef = BMS_BatInfor1_oKAMA_FP_EPT_0303_46423d38_Rx
      DonorCar_GSM_oKAMA_FP_EPSChassis1_0303_fcfe1306_Rx (ComIPdu):
        ComIPduDirection = RECEIVE
        ComIPduType = NORMAL
        ComIPduHandleId = 27
        ComIPduSignalProcessing = DEFERRED
        ComIPduCancellationSupport = false
        ComIPduGroupRef = VCU_oKAMA_FP_EPSChassis1_0303_Rx_00807295
        ComIPduSignalRef = EGSM_Pbutton_oDonorCar_GSM_oKAMA_FP_EPSChassis1_0303_0a0b755f_Rx
        ComIPduSignalRef = EGSM_ShifterLevelFailSts_oDonorCar_GSM_oKAMA_FP_EPSChassis1_0303_2c60d3b8_Rx
        ComIPduSignalRef = EGSM_ShifterLevelPosition_oDonorCar_GSM_oKAMA_FP_EPSChassis1_0303_da86bbec_Rx
        ComIPduSignalRef = GSM_AliveCounter_oDonorCar_GSM_oKAMA_FP_EPSChassis1_0303_ae6f8122_Rx
        ComPduIdRef = DonorCar_GSM_oKAMA_FP_EPSChassis1_0303_fcfe1306_Rx
      5 x ComSignal, all with ComSignalEndianness=BIG_ENDIAN, ComTimeout=0, ComSignalInitValue=0, ComSignalAccess=ACCESS_UNCLEAR:
        BMS_BatProDatYear_oBMS_PRO_oKAMA_FP_EPT_0303_d7462553_Rx: ComBitPosition=7, ComBitSize=8, ComSignalType=UINT8, ComHandleId=79, ComSystemTemplateSystemSignalRef=BMS_BatProDatYear
        BMS_ChrgDcChrgnReq_oBMS_ChargeStop_oKAMA_FP_EPT_0303_a146c945_Rx: ComBitPosition=1, ComBitSize=2, ComSignalType=UINT8, ComHandleId=89, ComSystemTemplateSystemSignalRef=BMS_ChrgDcChrgnReq
        BMS_BalanceCommand_oBMS_TCU_oKAMA_FP_EPT_0303_857ed85f_Rx: ComBitPosition=40, ComBitSize=1, ComSignalType=BOOLEAN, ComHandleId=66, ComSystemTemplateSystemSignalRef=BMS_BalanceCommand
        IBS_TCSActive_oIBS_Status2_oKAMA_FP_EPSChassis1_0303_8ff26d77_Rx: ComBitPosition=24, ComBitSize=1, ComSignalType=BOOLEAN, ComHandleId=327, ComSystemTemplateSystemSignalRef=IBS_TCSActive
        IBS_TorqueReductionRequestValid_oIBS_Torque_oKAMA_FP_EPSChassis1_0303_55560d50_Rx: ComBitPosition=8, ComBitSize=1, ComSignalType=BOOLEAN, ComHandleId=333, ComSystemTemplateSystemSignalRef=IBS_TorqueReductionRequestValid
      GW_TCU_AmbientTemp_oKAMA_FP_EPSChassis1_0303_013ab96f_Rx (ComIPdu):
        ComIPduDirection = RECEIVE
        ComIPduType = NORMAL
        ComIPduHandleId = 34
        ComIPduSignalProcessing = DEFERRED
        ComIPduCancellationSupport = false
        ComIPduGroupRef = VCU_oKAMA_FP_EPSChassis1_0303_Rx_00807295
        ComIPduSignalRef = TCU_ambientTemperature_oGW_TCU_AmbientTemp_oKAMA_FP_EPSChassis1_0303_7c3de23e_Rx
        ComPduIdRef = GW_TCU_AmbientTemp_oKAMA_FP_EPSChassis1_0303_013ab96f_Rx
      VCU_ModeRequestDCDC_oVCU_DCDC_oKAMA_FP_EPT_0303_f4977e35_Tx (ComSignal):
        ComBitPosition = 14
        ComBitSize = 3
        ComSignalEndianness = BIG_ENDIAN
        ComSignalInitValue = 0
        ComSignalType = UINT8
        ComTimeout = 0
        ComTransferProperty = PENDING
        ComSignalAccess = ACCESS_UNCLEAR
        ComHandleId = 91
        ComSystemTemplateSystemSignalRef = VCU_ModeRequestDCDC
      REPS_DM3_oKAMA_FP_EPSChassis1_0303_4915bac6_Rx (ComIPdu):
        ComIPduDirection = RECEIVE
        ComIPduType = NORMAL
        ComIPduHandleId = 59
        ComIPduSignalProcessing = DEFERRED
        ComIPduCancellationSupport = false
        ComIPduGroupRef = VCU_oKAMA_FP_EPSChassis1_0303_Rx_00807295
        ComIPduSignalRef = DM3_Byte0_oREPS_DM3_oKAMA_FP_EPSChassis1_0303_045e20ef_Rx
        ComIPduSignalRef = DM3_Byte1_oREPS_DM3_oKAMA_FP_EPSChassis1_0303_84ae37f0_Rx
        ComIPduSignalRef = DM3_Byte2_oREPS_DM3_oKAMA_FP_EPSChassis1_0303_decf0890_Rx
        ComIPduSignalRef = DM3_Byte3_oREPS_DM3_oKAMA_FP_EPSChassis1_0303_5e3f1f8f_Rx
        ComIPduSignalRef = DM3_Byte4_oREPS_DM3_oKAMA_FP_EPSChassis1_0303_6a0d7650_Rx
        ComIPduSignalRef = DM3_Byte5_oREPS_DM3_oKAMA_FP_EPSChassis1_0303_eafd614f_Rx
        ComIPduSignalRef = DM3_Byte6_oREPS_DM3_oKAMA_FP_EPSChassis1_0303_b09c5e2f_Rx
        ComIPduSignalRef = DM3_Byte7_oREPS_DM3_oKAMA_FP_EPSChassis1_0303_306c4930_Rx
        ComPduIdRef = REPS_DM3_oKAMA_FP_EPSChassis1_0303_4915bac6_Rx
      VCU_PlugInChrgInfo2_oKAMA_FP_EPSChassis1_0303_433d97e6_Tx (ComIPdu):
        ComIPduDirection = SEND
        ComIPduType = NORMAL
        ComIPduHandleId = 15
        ComIPduSignalProcessing = DEFERRED
        ComIPduCancellationSupport = false
        ComIPduGroupRef = VCU_oKAMA_FP_EPSChassis1_0303_Tx_56dad513
        ComIPduSignalRef = VCU_currentFromExtChargerAc_oVCU_PlugInChrgInfo2_oKAMA_FP_EPSChassis1_0303_52c379dd_Tx
        ComIPduSignalRef = VCU_currentFromExtChargerDc_oVCU_PlugInChrgInfo2_oKAMA_FP_EPSChassis1_0303_8d68e041_Tx
        ComIPduSignalRef = VCU_voltageFromExtChargerAc_oVCU_PlugInChrgInfo2_oKAMA_FP_EPSChassis1_0303_a64b20b7_Tx
        ComIPduSignalRef = VCU_voltageFromExtChargerDc_oVCU_PlugInChrgInfo2_oKAMA_FP_EPSChassis1_0303_79e0b92b_Tx
        ComPduIdRef = VCU_PlugInChrgInfo2_oKAMA_FP_EPSChassis1_0303_433d97e6_Tx
        ComTxIPdu: ComMinimumDelayTime=0, ComTxIPduUnusedAreasDefault=0
          ComTxModeTrue
            ComTxMode: ComTxModeMode=PERIODIC, ComTxModeTimeOffset=0, ComTxModeTimePeriod=0.2
          ComTxModeFalse
            ComTxMode: ComTxModeMode=PERIODIC, ComTxModeTimeOffset=0, ComTxModeTimePeriod=0.2
      8 x ComSignal, all with ComSignalEndianness=BIG_ENDIAN, ComTimeout=0, ComSignalAccess=ACCESS_UNCLEAR:
        ADAS_ReqValid_oADAS_CCU1_Ctrl_oKAMA_FP_EPSChassis1_0303_8cb910c6_Rx: ComBitPosition=18, ComBitSize=1, ComSignalInitValue=0, ComSignalType=BOOLEAN, ComHandleId=18, ComSystemTemplateSystemSignalRef=ADAS_ReqValid
        OBC_CPFrequency_oOBC_VCU_CHRGSTATION_ST_oKAMA_FP_EPT_0303_dac52b9c_Rx: ComBitPosition=31, ComBitSize=11, ComSignalInitValue=0, ComSignalType=UINT16, ComHandleId=439, ComSystemTemplateSystemSignalRef=OBC_CPFrequency
        AEB_AWB_eq_oADAS_AEB_oKAMA_FP_EPSChassis1_0303_59ab8f5e_Rx: ComBitPosition=6, ComBitSize=1, ComSignalInitValue=0, ComSignalType=BOOLEAN, ComHandleId=28, ComSystemTemplateSystemSignalRef=AEB_AWB_eq
        DM1_Byte4_oREPS_DM1_oKAMA_FP_EPSChassis1_0303_3932ad24_Rx: ComBitPosition=39, ComBitSize=8, ComSignalInitValue=0, ComSignalType=UINT8, ComHandleId=230, ComSystemTemplateSystemSignalRef=DM1_Byte4
        IBS_ESCLongitudinalAccle_oIBS1_acceleration_oKAMA_FP_EPSChassis1_0303_fc10a9c9_Rx: ComBitPosition=39, ComBitSize=16, ComSignalType=UINT16, ComSignalInitValue=0, ComHandleId=299, ComSystemTemplateSystemSignalRef=IBS_ESCLongitudinalAccle
        AC_LeftSetTemperature_oTCU_ACStatusInfo_oKAMA_FP_EPT_0303_b1cc7bda_Rx: ComBitPosition=28, ComBitSize=5, ComSignalInitValue=10, ComSignalType=UINT8, ComHandleId=15, ComSystemTemplateSystemSignalRef=AC_LeftSetTemperature
        MCU_stGateDrv_oMCU_Status_oKAMA_FP_EPT_0303_99eef85c_Rx: ComBitPosition=34, ComBitSize=2, ComSignalInitValue=0, ComSignalType=UINT8, ComHandleId=394, ComSystemTemplateSystemSignalRef=MCU_stGateDrv
        TCU_APTCLeftCmd_oTCU_Cmd_oKAMA_FP_EPT_0303_04893b04_Rx: ComBitPosition=7, ComBitSize=8, ComSignalInitValue=0, ComSignalType=UINT8, ComHandleId=490, ComSystemTemplateSystemSignalRef=TCU_APTCLeftCmd
      VCU_MCU01_oKAMA_FP_EPT_0303_46a91c2b_Tx (ComIPdu):
        ComIPduDirection = SEND
        ComIPduType = NORMAL
        ComIPduHandleId = 7
        ComIPduSignalProcessing = DEFERRED
        ComIPduCancellationSupport = false
        ComIPduGroupRef = VCU_oKAMA_FP_EPT_0303_Tx_51b27697
        ComIPduSignalRef = Checksum_046_oVCU_MCU01_oKAMA_FP_EPT_0303_bbfb4183_Tx
        ComIPduSignalRef = MessageCounter_046_oVCU_MCU01_oKAMA_FP_EPT_0303_943c8e54_Tx
        ComIPduSignalRef = VCU_ActualGear_oVCU_MCU01_oKAMA_FP_EPT_0303_a879e708_Tx
        ComIPduSignalRef = VCU_BrakepedalStatus_oVCU_MCU01_oKAMA_FP_EPT_0303_a6222693_Tx
        ComIPduSignalRef = VCU_KL15On_oVCU_MCU01_oKAMA_FP_EPT_0303_a64e5491_Tx
        ComIPduSignalRef = VCU_MCUDesiredTorque_oVCU_MCU01_oKAMA_FP_EPT_0303_77ea20f3_Tx
        ComIPduSignalRef = VCU_MCURequestedState_oVCU_MCU01_oKAMA_FP_EPT_0303_c2608659_Tx
        ComIPduSignalRef = VCU_MCUSurgeDamperState_oVCU_MCU01_oKAMA_FP_EPT_0303_3c180ef9_Tx
        ComIPduSignalRef = VCU_TCSActive_oVCU_MCU01_oKAMA_FP_EPT_0303_03bfce1f_Tx
        ComPduIdRef = VCU_MCU01_oKAMA_FP_EPT_0303_46a91c2b_Tx
        ComTxIPdu: ComMinimumDelayTime=0, ComTxIPduUnusedAreasDefault=0
          ComTxModeTrue
            ComTxMode: ComTxModeMode=PERIODIC, ComTxModeTimeOffset=0, ComTxModeTimePeriod=0.01
          ComTxModeFalse
            ComTxMode: ComTxModeMode=PERIODIC, ComTxModeTimeOffset=0, ComTxModeTimePeriod=0.01
      7 x ComSignal, all with ComSignalEndianness=BIG_ENDIAN, ComSignalInitValue=0, ComTimeout=0, ComSignalAccess=ACCESS_UNCLEAR:
        BMS_AbortErrorCurrent_oBMS_ChargeStop_oKAMA_FP_EPT_0303_04e42606_Rx: ComBitPosition=11, ComBitSize=2, ComSignalType=UINT8, ComHandleId=58, ComSystemTemplateSystemSignalRef=BMS_AbortErrorCurrent
        BMS_BatCode6_oBMS_Batcode_oKAMA_FP_EPT_0303_448546ab_Rx: ComBitPosition=63, ComBitSize=8, ComSignalType=UINT8, ComHandleId=74, ComSystemTemplateSystemSignalRef=BMS_BatCode6
        DM2_Byte2_oREPS_DM2_oKAMA_FP_EPSChassis1_0303_f750e52a_Rx: ComBitPosition=23, ComBitSize=8, ComSignalType=UINT8, ComHandleId=236, ComSystemTemplateSystemSignalRef=DM2_Byte2
        DCDC_OutputTempSensorFault_oDCDC_VCU_02_oKAMA_FP_EPT_0303_dfa8507a_Rx: ComBitPosition=13, ComBitSize=1, ComSignalType=BOOLEAN, ComHandleId=218, ComSystemTemplateSystemSignalRef=DCDC_OutputTempSensorFault
        EVCOM_OverVoltageError_oEVCOM_State_oKAMA_FP_EPT_0303_ef164ac9_Rx: ComBitPosition=6, ComBitSize=1, ComSignalType=BOOLEAN, ComHandleId=273, ComSystemTemplateSystemSignalRef=EVCOM_OverVoltageError
        BMS_RemainCapacity_oBMS_DisChargeEnergy_oKAMA_FP_EPT_0303_5f548087_Rx: ComBitPosition=31, ComBitSize=8, ComSignalType=UINT8, ComHandleId=156, ComSystemTemplateSystemSignalRef=BMS_RemainCapacity
        IBS_EPBworkingStatus_oIBS_Status2_oKAMA_FP_EPSChassis1_0303_4cf5ad2b_Rx: ComBitPosition=17, ComBitSize=2, ComSignalType=UINT8, ComHandleId=297, ComSystemTemplateSystemSignalRef=IBS_EPBworkingStatus
      VCU_HMIsignals_oKAMA_FP_EPSChassis1_0303_a83a481c_Tx (ComIPdu):
        ComIPduDirection = SEND
        ComIPduType = NORMAL
        ComIPduHandleId = 5
        ComIPduSignalProcessing = DEFERRED
        ComIPduCancellationSupport = false
        ComIPduGroupRef = VCU_oKAMA_FP_EPSChassis1_0303_Tx_56dad513
        ComIPduSignalRef = Checksum_27B_oVCU_HMIsignals_oKAMA_FP_EPSChassis1_0303_432e646f_Tx
        ComIPduSignalRef = MessageCounter_27B_oVCU_HMIsignals_oKAMA_FP_EPSChassis1_0303_8349569e_Tx
        ComIPduSignalRef = VCU_CriSysFailure_oVCU_HMIsignals_oKAMA_FP_EPSChassis1_0303_2d6a9a80_Tx
        ComIPduSignalRef = VCU_DCDCFail_oVCU_HMIsignals_oKAMA_FP_EPSChassis1_0303_fe869881_Tx
        ComIPduSignalRef = VCU_DegradedPerformance_oVCU_HMIsignals_oKAMA_FP_EPSChassis1_0303_e756a720_Tx
        ComIPduSignalRef = VCU_DegradedRegenBraking_oVCU_HMIsignals_oKAMA_FP_EPSChassis1_0303_2763642c_Tx
        ComIPduSignalRef = VCU_DriveMotOverSpd_oVCU_HMIsignals_oKAMA_FP_EPSChassis1_0303_90bfe192_Tx
        ComIPduSignalRef = VCU_DriveMotOvrTemp_oVCU_HMIsignals_oKAMA_FP_EPSChassis1_0303_c9c648c4_Tx
        ComIPduSignalRef = VCU_DrvDirCtrlFlt_oVCU_HMIsignals_oKAMA_FP_EPSChassis1_0303_e23b1903_Tx
        ComIPduSignalRef = VCU_FrMotorSpd_oVCU_HMIsignals_oKAMA_FP_EPSChassis1_0303_41b87c84_Tx
        ComIPduSignalRef = VCU_HVBatCoolOvrTemp_oVCU_HMIsignals_oKAMA_FP_EPSChassis1_0303_ba1ee51c_Tx
        ComIPduSignalRef = VCU_HVBatCriFail_oVCU_HMIsignals_oKAMA_FP_EPSChassis1_0303_f3c8276f_Tx
        ComIPduSignalRef = VCU_HVBatLowSocWar_oVCU_HMIsignals_oKAMA_FP_EPSChassis1_0303_85c9d405_Tx
        ComIPduSignalRef = VCU_HVBatOvrTemp_oVCU_HMIsignals_oKAMA_FP_EPSChassis1_0303_8e116b77_Tx
        ComIPduSignalRef = VCU_HVBatUndTemp_oVCU_HMIsignals_oKAMA_FP_EPSChassis1_0303_a4c8b79a_Tx
        ComIPduSignalRef = VCU_HVILError_oVCU_HMIsignals_oKAMA_FP_EPSChassis1_0303_bf4b87d4_Tx
        ComIPduSignalRef = VCU_HVInsulResFault_oVCU_HMIsignals_oKAMA_FP_EPSChassis1_0303_83b645f6_Tx
        ComIPduSignalRef = VCU_InvldGearSel_oVCU_HMIsignals_oKAMA_FP_EPSChassis1_0303_be060888_Tx
        ComIPduSignalRef = VCU_LimpHome_oVCU_HMIsignals_oKAMA_FP_EPSChassis1_0303_c8f6a8f0_Tx
        ComIPduSignalRef = VCU_RrMotorSpd_oVCU_HMIsignals_oKAMA_FP_EPSChassis1_0303_17805564_Tx
        ComIPduSignalRef = VCU_UnavailRegenBraking_oVCU_HMIsignals_oKAMA_FP_EPSChassis1_0303_8efb1b67_Tx
        ComPduIdRef = VCU_HMIsignals_oKAMA_FP_EPSChassis1_0303_a83a481c_Tx
        ComTxIPdu: ComMinimumDelayTime=0, ComTxIPduUnusedAreasDefault=0
          ComTxModeTrue
            ComTxMode: ComTxModeMode=PERIODIC, ComTxModeTimeOffset=0, ComTxModeTimePeriod=0.2
          ComTxModeFalse
            ComTxMode: ComTxModeMode=PERIODIC, ComTxModeTimeOffset=0, ComTxModeTimePeriod=0.2
      3 x ComSignal, all with ComSignalEndianness=BIG_ENDIAN, ComSignalInitValue=0, ComTimeout=0, ComSignalAccess=ACCESS_UNCLEAR:
        BMS_StateDI8_oBMS_DIRelayState_oKAMA_FP_EPT_0303_0a4f623e_Rx: ComBitPosition=25, ComBitSize=2, ComSignalType=UINT8, ComHandleId=168, ComSystemTemplateSystemSignalRef=BMS_StateDI8
        EGSM_ShifterLevelPosition_oDonorCar_GSM_oKAMA_FP_EPSChassis1_0303_da86bbec_Rx: ComBitPosition=10, ComBitSize=3, ComSignalType=UINT8, ComHandleId=253, ComSystemTemplateSystemSignalRef=EGSM_ShifterLevelPosition
        POD_TempSensor1Fault_oPOD_VCU_Status_02_oKAMA_FP_EPT_0303_750225ed_Rx: ComBitPosition=0, ComBitSize=1, ComSignalType=BOOLEAN, ComHandleId=486, ComSystemTemplateSystemSignalRef=POD_TempSensor1Fault
      VCU_MCU_7A_oKAMA_FP_EPSChassis1_0303_0bce5bfc_Tx (ComIPdu):
        ComIPduDirection = SEND
        ComIPduType = NORMAL
        ComIPduHandleId = 9
        ComIPduSignalProcessing = DEFERRED
        ComIPduCancellationSupport = false
        ComIPduGroupRef = VCU_oKAMA_FP_EPSChassis1_0303_Tx_56dad513
        ComIPduSignalRef = Checksum_7A_oVCU_MCU_7A_oKAMA_FP_EPSChassis1_0303_7a2c896b_Tx
        ComIPduSignalRef = MessageCounter_7A_oVCU_MCU_7A_oKAMA_FP_EPSChassis1_0303_03dd8fd5_Tx
        ComIPduSignalRef = VCU_ActTrqValid_oVCU_MCU_7A_oKAMA_FP_EPSChassis1_0303_71c69d05_Tx
        ComIPduSignalRef = VCU_ActualSpeed_oVCU_MCU_7A_oKAMA_FP_EPSChassis1_0303_6bd50567_Tx
        ComIPduSignalRef = VCU_ActualTorque_oVCU_MCU_7A_oKAMA_FP_EPSChassis1_0303_7bc04833_Tx
        ComIPduSignalRef = VCU_IsCurr_oVCU_MCU_7A_oKAMA_FP_EPSChassis1_0303_8e51bd32_Tx
        ComIPduSignalRef = VCU_UdcCurr_oVCU_MCU_7A_oKAMA_FP_EPSChassis1_0303_73bf9c90_Tx
        ComPduIdRef = VCU_MCU_7A_oKAMA_FP_EPSChassis1_0303_0bce5bfc_Tx
        ComTxIPdu: ComMinimumDelayTime=0, ComTxIPduUnusedAreasDefault=0
          ComTxModeTrue
            ComTxMode: ComTxModeMode=PERIODIC, ComTxModeTimeOffset=0, ComTxModeTimePeriod=0.01
          ComTxModeFalse
            ComTxMode: ComTxModeMode=PERIODIC, ComTxModeTimeOffset=0, ComTxModeTimePeriod=0.01
      11 x ComSignal, all with ComSignalEndianness=BIG_ENDIAN, ComSignalInitValue=0, ComTimeout=0, ComSignalAccess=ACCESS_UNCLEAR:
        ACU_PassSeatbeltBucklestatus_oDonorCar_ACM_Status_oKAMA_FP_EPSChassis1_0303_c6f76e0d_Rx: ComBitPosition=1, ComBitSize=1, ComSignalType=BOOLEAN, ComHandleId=10, ComSystemTemplateSystemSignalRef=ACU_PassSeatbeltBucklestatus
        OBC_InputACVoltage_oOBC_VCU_STATUS1_oKAMA_FP_EPT_0303_5c173faa_Rx: ComBitPosition=23, ComBitSize=16, ComSignalType=UINT16, ComHandleId=454, ComSystemTemplateSystemSignalRef=OBC_InputACVoltage
        EPB_failurestatus_oIBS_Status2_oKAMA_FP_EPSChassis1_0303_1779b30f_Rx: ComBitPosition=14, ComBitSize=1, ComSignalType=BOOLEAN, ComHandleId=254, ComSystemTemplateSystemSignalRef=EPB_failurestatus
        OBC_PFCOverVoltageError_oOBC_Error_STATUS_oKAMA_FP_EPT_0303_67189211_Rx: ComBitPosition=17, ComBitSize=1, ComSignalType=BOOLEAN, ComHandleId=465, ComSystemTemplateSystemSignalRef=OBC_PFCOverVoltageError
        APTC_Core2TempSensorFaltStatus_oAPTC_TCU_oKAMA_FP_EPT_0303_4561ebba_Rx: ComBitPosition=44, ComBitSize=2, ComSignalType=UINT8, ComHandleId=38, ComSystemTemplateSystemSignalRef=APTC_Core2TempSensorFaltStatus
        MCU_bDernTrqMin_oMCU_DeratingStatus_oKAMA_FP_EPT_0303_85616feb_Rx: ComBitPosition=2, ComBitSize=1, ComSignalType=BOOLEAN, ComHandleId=388, ComSystemTemplateSystemSignalRef=MCU_bDernTrqMin
        BMS_StateDI2_oBMS_DIRelayState_oKAMA_FP_EPT_0303_0c78e73f_Rx: ComBitPosition=21, ComBitSize=2, ComSignalType=UINT8, ComHandleId=162, ComSystemTemplateSystemSignalRef=BMS_StateDI2
        ACC_MaxJerkA_oADAS_ACC_oKAMA_FP_EPSChassis1_0303_25044b1d_Rx: ComBitPosition=31, ComBitSize=7, ComSignalType=UINT8, ComHandleId=4, ComSystemTemplateSystemSignalRef=ACC_MaxJerkA
        VCU_LimpHome_oVCU_Fault_01_oKAMA_FP_EPT_0303_68b92c58_Tx: ComBitPosition=30, ComBitSize=1, ComSignalType=BOOLEAN, ComTransferProperty=PENDING, ComHandleId=82, ComSystemTemplateSystemSignalRef=VCU_LimpHome
        IBS_BrakeLightRequest_oIBS_Status2_oKAMA_FP_EPSChassis1_0303_d5ca8e90_Rx: ComBitPosition=5, ComBitSize=2, ComSignalType=UINT8, ComHandleId=284, ComSystemTemplateSystemSignalRef=IBS_BrakeLightRequest
        DCDC_HVInputVoltage_oDCDC_VCU_01_oKAMA_FP_EPT_0303_98520e04_Rx: ComBitPosition=7, ComBitSize=11, ComSignalType=UINT16, ComHandleId=207, ComSystemTemplateSystemSignalRef=DCDC_HVInputVoltage
      MCU_FailureCode_oKAMA_FP_EPT_0303_0ebb7936_Rx (ComIPdu):
        ComIPduDirection = RECEIVE
        ComIPduType = NORMAL
        ComIPduHandleId = 44
        ComIPduSignalProcessing = DEFERRED
        ComIPduCancellationSupport = false
        ComIPduGroupRef = VCU_oKAMA_FP_EPT_0303_Rx_07e8d111
        ComIPduSignalRef = MCU_CAN_Fault_oMCU_FailureCode_oKAMA_FP_EPT_0303_4bbac187_Rx
        ComIPduSignalRef = MCU_FailCode1_oMCU_FailureCode_oKAMA_FP_EPT_0303_5dfb51a4_Rx
        ComIPduSignalRef = MCU_Hardware_Fault_oMCU_FailureCode_oKAMA_FP_EPT_0303_1518a0bd_Rx
        ComIPduSignalRef = MCU_Sensor_Fault_oMCU_FailureCode_oKAMA_FP_EPT_0303_81a23755_Rx
        ComIPduSignalRef = MCU_Softwae_FaultBit_oMCU_FailureCode_oKAMA_FP_EPT_0303_68be5667_Rx
        ComPduIdRef = MCU_FailureCode_oKAMA_FP_EPT_0303_0ebb7936_Rx
      7 x ComSignal, all with ComSignalInitValue=0, ComTimeout=0, ComSignalAccess=ACCESS_UNCLEAR:
        YRS_AyStatus_oYRS_1_oKAMA_FP_EPSChassis1_0303_ae11a279_Rx: ComBitPosition=52, ComBitSize=4, ComSignalEndianness=LITTLE_ENDIAN, ComSignalType=UINT8, ComHandleId=516, ComSystemTemplateSystemSignalRef=YRS_AyStatus
        Checksum_273_oVCU_DCDC_oKAMA_FP_EPT_0303_9303159d_Tx: ComBitPosition=63, ComBitSize=8, ComSignalEndianness=BIG_ENDIAN, ComSignalType=UINT8, ComTransferProperty=PENDING, ComHandleId=10, ComSystemTemplateSystemSignalRef=Checksum_273
        DCDC_LVOutputVoltage_oDCDC_VCU_01_oKAMA_FP_EPT_0303_4ba20c4c_Rx: ComBitPosition=47, ComBitSize=8, ComSignalEndianness=BIG_ENDIAN, ComSignalType=UINT8, ComHandleId=212, ComSystemTemplateSystemSignalRef=DCDC_LVOutputVoltage
        BMS_ErrorBattUnderVolt_oBMS_ErrorInfo1_oKAMA_FP_EPT_0303_e5dc82a6_Rx: ComBitPosition=13, ComBitSize=2, ComSignalEndianness=BIG_ENDIAN, ComSignalType=UINT8, ComHandleId=100, ComSystemTemplateSystemSignalRef=BMS_ErrorBattUnderVolt
        MessageCounter_2C1_oTCU_Cmd_oKAMA_FP_EPT_0303_421443bf_Rx: ComBitPosition=51, ComBitSize=4, ComSignalEndianness=BIG_ENDIAN, ComSignalType=SINT8, ComHandleId=409, ComSystemTemplateSystemSignalRef=MessageCounter_2C1
        BMS_AbortAchiveSingleVolt_oBMS_ChargeStop_oKAMA_FP_EPT_0303_e577c42f_Rx: ComBitPosition=5, ComBitSize=2, ComSignalEndianness=BIG_ENDIAN, ComSignalType=UINT8, ComHandleId=55, ComSystemTemplateSystemSignalRef=BMS_AbortAchiveSingleVolt
        Uds_EPT_bootResponse_Byte1_oUds_EPT_Boot_Response_oKAMA_FP_EPT_0303_b9155198_Tx: ComBitPosition=8, ComBitSize=8, ComSignalEndianness=LITTLE_ENDIAN, ComSignalType=UINT8, ComTransferProperty=TRIGGERED_WITHOUT_REPETITION, ComHandleId=26, ComSystemTemplateSystemSignalRef=Uds_EPT_bootResponse_Byte1
    ComGeneral:
      ComConfigurationUseDet = true
      ComSafeBswChecks = false
      ComEnableSignalGroupArrayApi = false
      ComRetryFailedTransmitRequests = false
      ComSupportedIPduGroups = 2
      ComVersionInfoApi = false
      ComAdvancedIPduCallouts = true
      ComOptimizedIPduGroupHandling = false
      ComMetaDataSupport = false
      ComDeferredEventCacheSupport = false
      ComDescriptionGateway = false
      ComDescriptionRoutingCodeGeneration = false
      ComStrictRepetitionPeriod = false
      ComMixedModePeriodicSuppression = false
      ComSignalGateway = NONE
