AUTOSAR XML (schema 00048)
package /ActiveEcuC
  module config Can: implementation-config-variant=VARIANT-PRE-COMPILE, module-description=Can_Impl
    CanGeneral:
      CanIndex = 0
      CanChangeBaudrateApi = false
      CanDevErrorDetection = true
      CanHardwareCancellation = false
      CanIdenticalIdCancellation = false
      CanMainFunctionBusoffPeriod = 0.01
      CanMainFunctionModePeriod = 0.01
      CanMainFunctionWakeupPeriod = 0.01
      CanMultiplexedTransmission = false
      CanSetBaudrateApi = false
      CanTimeoutDuration = 0.01
      CanVersionInfoApi = false
      CanGenericPrecopy = false
      CanHardwareLoopCheck = true
      CanSecureTempBuffer = false
      CanRxFullCANSupport = false
      CanTxFullCANSupport = false
      CanRxBasicCANSupport = true
      CanUseNestedCANInterrupts = false
      CanHardwareCancelByAppl = false
      CanIndividualProcessing = false
      CanGenericConfirmation = false
      CanGenericConfirmationAPI2 = false
      CanRxQueue = false
      CanSupportMixedID = false
      CanRxQueueSize = 10
      CanMultipleBasicCANObjects = false
      CanMultipleBasicCANTxObjects = false
      CanHardwareHandleType = UINT8
      CanOptimizeOneController = false
      CanInterruptCategory = VOIDFUNCVOID
      CanGetStatus = false
      CanInterruptLock = DRIVER
      CanWakeupSupport = false
      CanRamCheck = None
      CanOverrunNotification = DET
      CanReinitStart = false
      CanGenericPreTransmit = false
      CanFdSupport = NONE
      CanRuntimeMeasurementSupport = false
      CanMaxRxDataLen = 8
      CanMaxTxDataLen = 8
      CanUsePeripheralAccessApi = false
      CanMirrorModeSupport = false
      CanUseOsInterruptControl = false
      CanSafeBswChecks = false
      CanSilentModeSupport = false
      CanHwTxFifoSupport = false
      CanMcanRevision = M_CAN_REV_315
      CanCheckWakeupCanRetType = false
      CanFdHardwareBufferOptimization = true
      CanEccInit = true
      CanUseVirtualAddressing = false
      CanCounterRef = (unset)
      CanMainFunctionRWPeriods
    CanConfigSet
      CT_KAMA_FP_EPT_0303_1b7da7f9 (CanController):
        CanControllerActivation = true
        CanBusoffProcessing = INTERRUPT
        CanControllerBaseAddress = 4028663040
        CanControllerId = 1
        CanRxProcessing = INTERRUPT
        CanTxProcessing = INTERRUPT
        CanWakeupProcessing = INTERRUPT
        CanWakeupSupport = false
        CanWakeupSourceId = 0
        CanBasisAddressEnum = M_CAN1
        CanTxBufferElementSize = ES_8
        CanRxBufferElementSize = ES_8
        CanRxFifo0ElementSize = ES_8
        CanRxFifo1ElementSize = ES_8
        CanMaxNrOfRxFifo0Elements = 64
        CanMaxNrOfRxFifo1Elements = 64
        CanMaxNrOfRxBuffers = 64
        CanMaxNrOfTxBuffers = 32
        CanIsTTCAN = false
        CanControllerDefaultBaudrate = CT_KAMA_FP_EPT_0303_1b7da7f9/CanControllerBaudrateConfig
        CanControllerSystemRef = CT_KAMA_FP_EPT_0303
        CanWakeupSourceRef = CN_KAMA_FP_EPT_0303_275b3e6e
        CanCpuClockRef = (unset)
        CanControllerBaudrateConfig:
          CanControllerBaudRate = 500
          CanControllerBaudRateConfigID = 0
          CanControllerPropSeg = 20
          CanControllerSeg1 = 30
          CanControllerSeg2 = 5
          CanControllerSyncJumpWidth = 1
          CanBaudrateClock = 1
          CanBaudratePrescaler = 2
      4 x CanHardwareObject, all with CanHandleType=BASIC, CanIdType=STANDARD, CanIdValue=0, CanHwProcessing=false, CanObjectHwHandle=0, CanMaxDataLen=8, CanFdPaddingValue=0, CanObjectMultiplexedTransmission=false, CanObjectHwFifo=false:
        CN_KAMA_FP_EPT_0303_c7999d11_Rx: CanObjectType=RECEIVE, CanObjectId=3, CanObjectHwSize=6, CanControllerRef=CT_KAMA_FP_EPT_0303_1b7da7f9
        CN_KAMA_FP_EPSChassis1_0303_66acf324_Tx: CanObjectType=TRANSMIT, CanObjectId=0, CanObjectHwSize=1, CanControllerRef=CT_KAMA_FP_EPSChassis1_0303_8c9dce8f
        CN_KAMA_FP_EPT_0303_275b3e6e_Tx: CanObjectType=TRANSMIT, CanObjectId=2, CanObjectHwSize=1, CanControllerRef=CT_KAMA_FP_EPT_0303_1b7da7f9
        CN_KAMA_FP_EPSChassis1_0303_085b9bf0_Rx: CanObjectType=RECEIVE, CanObjectId=1, CanObjectHwSize=6, CanControllerRef=CT_KAMA_FP_EPSChassis1_0303_8c9dce8f
      CT_KAMA_FP_EPSChassis1_0303_8c9dce8f (CanController):
        CanControllerActivation = true
        CanBusoffProcessing = INTERRUPT
        CanControllerBaseAddress = 4028663040
        CanControllerId = 0
        CanRxProcessing = INTERRUPT
        CanTxProcessing = INTERRUPT
        CanWakeupProcessing = INTERRUPT
        CanWakeupSupport = false
        CanWakeupSourceId = 0
        CanBasisAddressEnum = M_CAN1
        CanTxBufferElementSize = ES_8
        CanRxBufferElementSize = ES_8
        CanRxFifo0ElementSize = ES_8
        CanRxFifo1ElementSize = ES_8
        CanMaxNrOfRxFifo0Elements = 64
        CanMaxNrOfRxFifo1Elements = 64
        CanMaxNrOfRxBuffers = 64
        CanMaxNrOfTxBuffers = 32
        CanIsTTCAN = false
        CanControllerDefaultBaudrate = CT_KAMA_FP_EPSChassis1_0303_8c9dce8f/CanControllerBaudrateConfig
        CanControllerSystemRef = CT_KAMA_FP_EPSChassis1_0303
        CanWakeupSourceRef = CN_KAMA_FP_EPSChassis1_0303_66acf324
        CanCpuClockRef = (unset)
        CanControllerBaudrateConfig:
          CanControllerBaudRate = 500
          CanControllerBaudRateConfigID = 0
          CanControllerPropSeg = 20
          CanControllerSeg1 = 30
          CanControllerSeg2 = 5
          CanControllerSyncJumpWidth = 1
          CanBaudrateClock = 1
          CanBaudratePrescaler = 2
