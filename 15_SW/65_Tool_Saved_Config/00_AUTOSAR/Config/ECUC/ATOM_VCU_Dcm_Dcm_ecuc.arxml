AUTOSAR XML (schema 00048)
package /ActiveEcuC
  module config Dcm: implementation-config-variant=VARIANT-PRE-COMPILE, module-description=Dcm_Impl
    DcmConfigSet
      DcmDsl
        DcmDslProtocol
          DcmDslProtocolRow_29812fbf (DcmDslProtocolRow):
            DcmDslProtocolEndiannessConvEnabled = false
            DcmDslProtocolID = DCM_UDS_ON_CAN
            DcmDslProtocolPreemptTimeout = 0
            DcmDslProtocolPriority = 0
            DcmSendRespPendOnTransToBoot = true
            DcmTimStrP2ServerAdjust = 0
            DcmTimStrP2StarServerAdjust = 0
            DcmDslProtocolRxBufferID = (unset)
            DcmDslProtocolSIDTable = (unset)
            DcmDslProtocolTxBufferID = (unset)
            DcmDslConnection_68a956e5 (DcmDslConnection)
              DcmDslMainConnection_cd9afcd1 (DcmDslMainConnection): DcmDslProtocolRxTesterSourceAddr=(unset), DcmDslProtocolRxConnectionId=(unset)
                OBDFunRequest_oKAMA_FP_EPT_0303_f91ebc99_Rx_7586dd69 (DcmDslProtocolRx):
                  DcmDslProtocolRxAddrType = DCM_FUNCTIONAL_TYPE
                  DcmDslProtocolRxPduId = 3
                  DcmDslProtocolRxChannelId = 0
                  DcmDslProtocolRxComMChannelRef = CN_KAMA_FP_EPT_0303_275b3e6e
                  DcmDslProtocolRxPduRef = OBDFunRequest_oKAMA_FP_EPT_0303_f91ebc99_Rx
                OBDResponse_oKAMA_FP_EPT_0303_0e230f69_Tx_76c025a4 (DcmDslProtocolTx): DcmDslTxConfirmationPduId=1, DcmDslProtocolTxPduRef=OBDResponse_oKAMA_FP_EPT_0303_0e230f69_Tx
                OBDRequest_oKAMA_FP_EPT_0303_e2d185cc_Rx_34cd2842 (DcmDslProtocolRx):
                  DcmDslProtocolRxAddrType = DCM_PHYSICAL_TYPE
                  DcmDslProtocolRxPduId = 4
                  DcmDslProtocolRxChannelId = 0
                  DcmDslProtocolRxComMChannelRef = CN_KAMA_FP_EPT_0303_275b3e6e
                  DcmDslProtocolRxPduRef = OBDRequest_oKAMA_FP_EPT_0303_e2d185cc_Rx
            DcmDslConnection_2c090363 (DcmDslConnection)
              DcmDslMainConnection_c7472112 (DcmDslMainConnection): DcmDslProtocolRxTesterSourceAddr=(unset), DcmDslProtocolRxConnectionId=(unset)
                UDSRequest_oKAMA_FP_EPT_0303_39823b57_Rx_72be2e40 (DcmDslProtocolRx):
                  DcmDslProtocolRxAddrType = DCM_PHYSICAL_TYPE
                  DcmDslProtocolRxPduId = 2
                  DcmDslProtocolRxChannelId = 0
                  DcmDslProtocolRxComMChannelRef = CN_KAMA_FP_EPT_0303_275b3e6e
                  DcmDslProtocolRxPduRef = UDSRequest_oKAMA_FP_EPT_0303_39823b57_Rx
                AllFunctionRequest_oKAMA_FP_EPT_0303_a4f59624_Rx_5502a6d6 (DcmDslProtocolRx):
                  DcmDslProtocolRxAddrType = DCM_FUNCTIONAL_TYPE
                  DcmDslProtocolRxPduId = 0
                  DcmDslProtocolRxChannelId = 0
                  DcmDslProtocolRxComMChannelRef = CN_KAMA_FP_EPT_0303_275b3e6e
                  DcmDslProtocolRxPduRef = AllFunctionRequest_oKAMA_FP_EPT_0303_a4f59624_Rx
                UDSResponse_oKAMA_FP_EPT_0303_6925161b_Tx_d731ae59 (DcmDslProtocolTx): DcmDslTxConfirmationPduId=0, DcmDslProtocolTxPduRef=UDSResponse_oKAMA_FP_EPT_0303_6925161b_Tx
                UDSFunRequest_oKAMA_FP_EPT_0303_807c682b_Rx_6260012f (DcmDslProtocolRx):
                  DcmDslProtocolRxAddrType = DCM_FUNCTIONAL_TYPE
                  DcmDslProtocolRxPduId = 1
                  DcmDslProtocolRxChannelId = 0
                  DcmDslProtocolRxComMChannelRef = CN_KAMA_FP_EPT_0303_275b3e6e
                  DcmDslProtocolRxPduRef = UDSFunRequest_oKAMA_FP_EPT_0303_807c682b_Rx
        DcmDslDiagResp: DcmDslDiagRespMaxNumRespPend=0, DcmDslDiagRespOnSecondDeclinedRequest=false, DcmDslDiagRespMaxNumOfDeclinedRequests=3
      DcmGeneral:
        DcmResetToFblAfterSessionFinalResponseEnabled = false
        DcmDevErrorDetect = true
        DcmRequestManufacturerNotificationEnabled = false
        DcmRequestSupplierNotificationEnabled = false
        DcmRespondAllRequest = true
        DcmTaskTime = 0.01
        DcmVersionInfoApi = false
        DcmDspDataDefaultEndianness = LITTLE_ENDIAN
        DcmSafeBswChecks = false
        DcmSupportedIDCalculationSuppressionEnabled = false
        DcmDtrDataProvisionViaDemEnabled = true
        DcmForeignDiagnosticRequestDetectionEnabled = false
        DcmSuppressResponseOnCanTpFuncMixedAddrRequests = false
        DcmSenderReceiverPRPortsEnabled = false
      DcmDsd
        DcmDsdServiceTable
          17 x DcmDsdService:
            RequestDownload: DcmDsdSidTabServiceId=52, DcmDsdSidTabSubfuncAvail=false, DcmDsdSidTabSessionLevelRef=DcmDspSession/Programming, DcmDsdSidTabSecurityLevelRef=Unlocked_Level_4
            ProcessOBDService01: DcmDsdSidTabServiceId=1, DcmDsdSidTabSubfuncAvail=false, DcmDsdSidTabSessionLevelRef=DcmDspSession/Default, DcmDsdSidTabSessionLevelRef=DcmDspSession/Extended, DcmDsdSidTabSessionLevelRef=Coding_Session
            ClearDiagInfo: DcmDsdSidTabServiceId=20, DcmDsdSidTabSubfuncAvail=false, DcmDsdSidTabSessionLevelRef=DcmDspSession/Default, DcmDsdSidTabSessionLevelRef=DcmDspSession/Extended, DcmDsdSidTabSessionLevelRef=Coding_Session
            EcuReset: DcmDsdSidTabServiceId=17, DcmDsdSidTabSubfuncAvail=true, DcmDsdSidTabSessionLevelRef=DcmDspSession/Programming, DcmDsdSidTabSessionLevelRef=DcmDspSession/Extended, DcmDsdSidTabSessionLevelRef=Coding_Session
              Soft (DcmDsdSubService):
                DcmDsdSubServiceId = 3
                DcmDsdSubServiceSessionLevelRef = DcmDspSession/Programming
                DcmDsdSubServiceSessionLevelRef = DcmDspSession/Extended
                DcmDsdSubServiceSessionLevelRef = Coding_Session
              Hard (DcmDsdSubService):
                DcmDsdSubServiceId = 1
                DcmDsdSubServiceSessionLevelRef = DcmDspSession/Programming
                DcmDsdSubServiceSessionLevelRef = DcmDspSession/Extended
                DcmDsdSubServiceSessionLevelRef = Coding_Session
            TransferData: DcmDsdSidTabServiceId=54, DcmDsdSidTabSubfuncAvail=false, DcmDsdSidTabSessionLevelRef=DcmDspSession/Programming, DcmDsdSidTabSecurityLevelRef=Unlocked_Level_4
            ControlDtcSetting: DcmDsdSidTabServiceId=133, DcmDsdSidTabSubfuncAvail=true, DcmDsdSidTabSessionLevelRef=DcmDspSession/Extended, DcmDsdSidTabSessionLevelRef=Coding_Session
              Disable (DcmDsdSubService): DcmDsdSubServiceId=2, DcmDsdSubServiceSessionLevelRef=DcmDspSession/Extended, DcmDsdSubServiceSessionLevelRef=Coding_Session
              Enable (DcmDsdSubService): DcmDsdSubServiceId=1, DcmDsdSubServiceSessionLevelRef=DcmDspSession/Extended, DcmDsdSubServiceSessionLevelRef=Coding_Session
            WriteDataById: DcmDsdSidTabServiceId=46, DcmDsdSidTabSubfuncAvail=false, DcmDsdSidTabSessionLevelRef=DcmDspSession/Programming, DcmDsdSidTabSessionLevelRef=DcmDspSession/Extended, DcmDsdSidTabSessionLevelRef=Coding_Session, DcmDsdSidTabSecurityLevelRef=UnlockedL1, DcmDsdSidTabSecurityLevelRef=Unlocked_Level_2, DcmDsdSidTabSecurityLevelRef=Unlocked_Level_3, DcmDsdSidTabSecurityLevelRef=Unlocked_Level_4
            ReadDataById: DcmDsdSidTabServiceId=34, DcmDsdSidTabSubfuncAvail=false, DcmDsdSidTabSessionLevelRef=DcmDspSession/Default, DcmDsdSidTabSessionLevelRef=DcmDspSession/Extended, DcmDsdSidTabSessionLevelRef=Coding_Session
            Upload_Download_RequestFileTransfer: DcmDsdSidTabServiceId=56, DcmDsdSidTabSubfuncAvail=false, DcmDsdSidTabSessionLevelRef=DcmDspSession/Programming, DcmDsdSidTabSecurityLevelRef=Unlocked_Level_4
            SecurityAccess: DcmDsdSidTabServiceId=39, DcmDsdSidTabSubfuncAvail=true, DcmDsdSidTabSessionLevelRef=DcmDspSession/Programming, DcmDsdSidTabSessionLevelRef=DcmDspSession/Extended, DcmDsdSidTabSessionLevelRef=Coding_Session
              8 x DcmDsdSubService:
                SeedLevel1_Request: DcmDsdSubServiceId=1, DcmDsdSubServiceSessionLevelRef=DcmDspSession/Extended
                SendKey_Level2_Send: DcmDsdSubServiceId=4, DcmDsdSubServiceSessionLevelRef=DcmDspSession/Extended
                SendKey_Level4_Send: DcmDsdSubServiceId=8, DcmDsdSubServiceSessionLevelRef=DcmDspSession/Programming
                RequestSeed_Level3_Request: DcmDsdSubServiceId=5, DcmDsdSubServiceSessionLevelRef=Coding_Session
                RequestSeed_Level2_Request: DcmDsdSubServiceId=3, DcmDsdSubServiceSessionLevelRef=DcmDspSession/Extended
                KeyLevel1_Send: DcmDsdSubServiceId=2, DcmDsdSubServiceSessionLevelRef=DcmDspSession/Extended
                SendKey_Level3_Send: DcmDsdSubServiceId=6, DcmDsdSubServiceSessionLevelRef=Coding_Session
                RequestSeed_Level4_Request: DcmDsdSubServiceId=7, DcmDsdSubServiceSessionLevelRef=DcmDspSession/Programming
            RequestTransferExit: DcmDsdSidTabServiceId=55, DcmDsdSidTabSubfuncAvail=false, DcmDsdSidTabSessionLevelRef=DcmDspSession/Programming, DcmDsdSidTabSecurityLevelRef=Unlocked_Level_4
            ProcessOBDService09: DcmDsdSidTabServiceId=9, DcmDsdSidTabSubfuncAvail=false, DcmDsdSidTabSessionLevelRef=DcmDspSession/Default, DcmDsdSidTabSessionLevelRef=DcmDspSession/Extended, DcmDsdSidTabSessionLevelRef=Coding_Session
            ReadDtcInfo: DcmDsdSidTabServiceId=25, DcmDsdSidTabSubfuncAvail=true, DcmDsdSidTabSessionLevelRef=DcmDspSession/Default, DcmDsdSidTabSessionLevelRef=DcmDspSession/Extended, DcmDsdSidTabSessionLevelRef=Coding_Session
              6 x DcmDsdSubService, all with DcmDsdSubServiceSessionLevelRef=DcmDspSession/Default, DcmDsdSubServiceSessionLevelRef=DcmDspSession/Extended, DcmDsdSubServiceSessionLevelRef=Coding_Session:
                RDTCEDRBDN: DcmDsdSubServiceId=6
                RDTCSSI: DcmDsdSubServiceId=3
                RSUPDTC: DcmDsdSubServiceId=10
                RDTCBSM: DcmDsdSubServiceId=2
                RNODTCBSM: DcmDsdSubServiceId=1
                RDTCSSBDTC: DcmDsdSubServiceId=4
            TesterPresent: DcmDsdSidTabServiceId=62, DcmDsdSidTabSubfuncAvail=true
              TesterPresent (DcmDsdSubService): DcmDsdSubServiceId=0
            CommunicationControl: DcmDsdSidTabServiceId=40, DcmDsdSidTabSubfuncAvail=true, DcmDsdSidTabSessionLevelRef=DcmDspSession/Extended, DcmDsdSidTabSessionLevelRef=Coding_Session
              DisableRxAndTx (DcmDsdSubService): DcmDsdSubServiceId=3, DcmDsdSubServiceSessionLevelRef=DcmDspSession/Extended, DcmDsdSubServiceSessionLevelRef=Coding_Session
              EnableRxAndTx (DcmDsdSubService): DcmDsdSubServiceId=0, DcmDsdSubServiceSessionLevelRef=DcmDspSession/Extended, DcmDsdSubServiceSessionLevelRef=Coding_Session
            RoutineControl: DcmDsdSidTabServiceId=49, DcmDsdSidTabSubfuncAvail=true, DcmDsdSidTabSessionLevelRef=DcmDspSession/Programming, DcmDsdSidTabSessionLevelRef=DcmDspSession/Extended, DcmDsdSidTabSessionLevelRef=Coding_Session
            DiagSessionControl: DcmDsdSidTabServiceId=16, DcmDsdSidTabSubfuncAvail=true
              4 x DcmDsdSubService:
                Programming: DcmDsdSubServiceId=2, DcmDsdSubServiceSessionLevelRef=DcmDspSession/Programming, DcmDsdSubServiceSessionLevelRef=DcmDspSession/Extended
                Default: DcmDsdSubServiceId=1
                Extended: DcmDsdSubServiceId=3, DcmDsdSubServiceSessionLevelRef=DcmDspSession/Default, DcmDsdSubServiceSessionLevelRef=DcmDspSession/Extended, DcmDsdSubServiceSessionLevelRef=Coding_Session
                Coding_Session_Start: DcmDsdSubServiceId=65, DcmDsdSubServiceSessionLevelRef=DcmDspSession/Extended, DcmDsdSubServiceSessionLevelRef=Coding_Session
      DcmDsp: DcmDspMaxDidToRead=5, DcmDspReadDIDReportsNODIByte=false
        Date_And_Time_Date_And_Time_Second (DcmDspData):
          DcmDspDataSize = 8
          DcmDspDataType = UINT8
          DcmDspDataUsePort = USE_DATA_ASYNCH_CLIENT_SERVER
          DcmDspDataInfoRef = DataInfo_Date_And_Time_Date_And_Time_Second
        VCU_PowerMaxAllowed_parameter2_MCUPowerLimit (DcmDspData):
          DcmDspDataSize = 16
          DcmDspDataType = UINT16
          DcmDspDataUsePort = USE_DATA_ASYNCH_CLIENT_SERVER
          DcmDspDataInfoRef = DataInfo_VCU_PowerMaxAllowed_parameter2_MCUPowerLimit
        AC_charging_parameter (DcmDspDid):
          DcmDspDidIdentifier = 7429
          DcmDspDidUsed = true
          DcmDspDidUsePort = USE_DATA_ELEMENT_SPECIFIC_INTERFACES
          DcmDspDidInfoRef = DidInfo_AC_charging_parameter
          4 x DcmDspDidSignal:
            VCU_OBC_ChargeCurrentCommand: DcmDspDidDataPos=16, DcmDspDidDataRef=AC_charging_parameter_VCU_OBC_ChargeCurrentCommand
            POD_OBC_InputACVoltage: DcmDspDidDataPos=0, DcmDspDidDataRef=AC_charging_parameter_POD_OBC_InputACVoltage
            POD_OBC_OutputDCChargeVoltage: DcmDspDidDataPos=48, DcmDspDidDataRef=AC_charging_parameter_POD_OBC_OutputDCChargeVoltage
            POD_OBC_OutputDCChargeCurrent: DcmDspDidDataPos=32, DcmDspDidDataRef=AC_charging_parameter_POD_OBC_OutputDCChargeCurrent
        Coding_for_CDS_fingerprint (DcmDspDid):
          DcmDspDidIdentifier = 61706
          DcmDspDidUsed = true
          DcmDspDidUsePort = USE_DATA_ELEMENT_SPECIFIC_INTERFACES
          DcmDspDidInfoRef = DidInfo_Coding_for_CDS_fingerprint
          4 x DcmDspDidSignal:
            codingDate_byte_3_DD: DcmDspDidDataPos=16, DcmDspDidDataRef=Coding_for_CDS_fingerprint_codingDate_byte_3_DD
            codingDate_byte_2_MM: DcmDspDidDataPos=8, DcmDspDidDataRef=Coding_for_CDS_fingerprint_codingDate_byte_2_MM
            codingDate_byte_1_YY: DcmDspDidDataPos=0, DcmDspDidDataRef=Coding_for_CDS_fingerprint_codingDate_byte_1_YY
            repairShopCodeorTesterSerialNumber_byte_1_27_MSB: DcmDspDidDataPos=24, DcmDspDidDataRef=Coding_for_CDS_fingerprint_repairShopCodeorTesterSerialNumber_byte_1_27_MSB
        VCU_PowerMaxAllowed_parameter2_VCU_DCDCPowerLimit (DcmDspData):
          DcmDspDataSize = 16
          DcmDspDataType = UINT16
          DcmDspDataUsePort = USE_DATA_ASYNCH_CLIENT_SERVER
          DcmDspDataInfoRef = DataInfo_VCU_PowerMaxAllowed_parameter2_VCU_DCDCPowerLimit
        DataInfo_EcuIdentification_Group (DcmDspDataInfo): DcmDspDataFixedLength=true
        Last_service_date_Year (DcmDspData): DcmDspDataSize=8, DcmDspDataType=UINT8_N, DcmDspDataUsePort=USE_DATA_ASYNCH_CLIENT_SERVER, DcmDspDataInfoRef=DataInfo_Last_service_date_Year
        DidInfo_Supplier_ECU_hardware_part_number (DcmDspDidInfo)
          DcmDspDidAccess
            DcmDspDidRead: DcmDspDidReadSessionRef=DcmDspSession/Default, DcmDspDidReadSessionRef=DcmDspSession/Extended, DcmDspDidReadSessionRef=Coding_Session
        DataInfo_Read_Write_coding_data_string_CDS_Configuration1 (DcmDspDataInfo): DcmDspDataFixedLength=true
        DataInfo_Read_Write_coding_data_string_CDS_Configuration2 (DcmDspDataInfo): DcmDspDataFixedLength=true
        VCU_control_main_relay (DcmDspDid):
          DcmDspDidIdentifier = 7441
          DcmDspDidUsed = true
          DcmDspDidUsePort = USE_DATA_ELEMENT_SPECIFIC_INTERFACES
          DcmDspDidInfoRef = DidInfo_VCU_control_main_relay
          Mainrealy1 (DcmDspDidSignal): DcmDspDidDataPos=0, DcmDspDidDataRef=VCU_control_main_relay_Mainrealy1
          Mainrelay2 (DcmDspDidSignal): DcmDspDidDataPos=8, DcmDspDidDataRef=VCU_control_main_relay_Mainrelay2
        DidInfo_Driver_Mode (DcmDspDidInfo)
          DcmDspDidAccess
            DcmDspDidRead: DcmDspDidReadSessionRef=DcmDspSession/Default, DcmDspDidReadSessionRef=DcmDspSession/Extended, DcmDspDidReadSessionRef=Coding_Session
        3 x DcmDspDataInfo, all with DcmDspDataFixedLength=true:
          DataInfo_VCU_AccPealparameter_VCU_AccelerationPedal
          DataInfo_Write_Level3_OEM_Key_OEM_Key_Value
          DataInfo_Read_Write_complete_VIN_Vehicle_Identification_Section
        Driver_Mode_Driver_Mode (DcmDspData): DcmDspDataSize=8, DcmDspDataType=UINT8, DcmDspDataUsePort=USE_DATA_ASYNCH_CLIENT_SERVER, DcmDspDataInfoRef=DataInfo_Driver_Mode_Driver_Mode
        Chargestatus_Chargestatus (DcmDspData): DcmDspDataSize=8, DcmDspDataType=UINT8, DcmDspDataUsePort=USE_DATA_ASYNCH_CLIENT_SERVER, DcmDspDataInfoRef=DataInfo_Chargestatus_Chargestatus
        Electronic_lock_state (DcmDspDid):
          DcmDspDidIdentifier = 7431
          DcmDspDidUsed = true
          DcmDspDidUsePort = USE_DATA_ELEMENT_SPECIFIC_INTERFACES
          DcmDspDidInfoRef = DidInfo_Electronic_lock_state
          Electronic_lock_state (DcmDspDidSignal): DcmDspDidDataPos=0, DcmDspDidDataRef=Electronic_lock_state_Electronic_lock_state
        DataInfo_Date_And_Time_Date_And_Time_Year (DcmDspDataInfo): DcmDspDataFixedLength=true
        RoutineInfo_Turn_Off_HV_Turn_Off_Charging (DcmDspRoutineInfo)
          DcmDspRoutineAuthorization: DcmDspRoutineSessionRef=DcmDspSession/Programming, DcmDspRoutineSessionRef=DcmDspSession/Extended, DcmDspRoutineSessionRef=Coding_Session
          DcmDspStartRoutineOut
            Out_routineResult (DcmDspStartRoutineOutSignal): DcmDspRoutineSignalLength=8, DcmDspRoutineSignalType=UINT8, DcmDspRoutineSignalPos=0
        VCU_PowerMaxAllowed_parameter1_VCU_TCUPowerAllowed (DcmDspData):
          DcmDspDataSize = 16
          DcmDspDataType = UINT16
          DcmDspDataUsePort = USE_DATA_ASYNCH_CLIENT_SERVER
          DcmDspDataInfoRef = DataInfo_VCU_PowerMaxAllowed_parameter1_VCU_TCUPowerAllowed
        Read_active_diagnostic_session_Active_diagnostic_session (DcmDspData):
          DcmDspDataSize = 8
          DcmDspDataType = UINT8
          DcmDspDataUsePort = USE_DATA_ASYNCH_CLIENT_SERVER
          DcmDspDataInfoRef = DataInfo_Read_active_diagnostic_session_Active_diagnostic_session
        DataInfo_Read_Write_coding_data_string_CDS_CDS_CRC (DcmDspDataInfo): DcmDspDataFixedLength=true
        DataInfo_Read_Level2_OEM_Key_written_status_OEM_Key_Write_state (DcmDspDataInfo): DcmDspDataFixedLength=true
        Write_Level2_OEM_Key_OEM_Key_Value (DcmDspData):
          DcmDspDataSize = 128
          DcmDspDataType = UINT8_N
          DcmDspDataUsePort = USE_DATA_ASYNCH_CLIENT_SERVER
          DcmDspDataInfoRef = DataInfo_Write_Level2_OEM_Key_OEM_Key_Value
        Total_Odometer (DcmDspDid): DcmDspDidIdentifier=61858, DcmDspDidUsed=true, DcmDspDidUsePort=USE_DATA_ELEMENT_SPECIFIC_INTERFACES, DcmDspDidInfoRef=DidInfo_Total_Odometer
          Total_Odometer (DcmDspDidSignal): DcmDspDidDataPos=0, DcmDspDidDataRef=Total_Odometer_Total_Odometer
        3 x DcmDspDataInfo, all with DcmDspDataFixedLength=true:
          DataInfo_Last_service_date_Month
          DataInfo_Date_And_Time_Date_And_Time_Month
          DataInfo_PWT_vehicle_fault_Level_PWT_ErrorLevel
        Electronic_lock_state_Electronic_lock_state (DcmDspData):
          DcmDspDataSize = 8
          DcmDspDataType = UINT8
          DcmDspDataUsePort = USE_DATA_ASYNCH_CLIENT_SERVER
          DcmDspDataInfoRef = DataInfo_Electronic_lock_state_Electronic_lock_state
        DcmDspSecurity
          4 x DcmDspSecurityRow, all with DcmDspSecurityDelayTime=10, DcmDspSecurityDelayTimeOnBoot=0, DcmDspSecurityKeySize=16, DcmDspSecurityNumAttDelay=3, DcmDspSecuritySeedSize=16, DcmDspSecurityAttemptCounterEnabled=false, DcmDspSecurityUsePort=USE_ASYNCH_CLIENT_SERVER:
            Unlocked_Level_2: DcmDspSecurityLevel=2
            Unlocked_Level_3: DcmDspSecurityLevel=3
            UnlockedL1: DcmDspSecurityLevel=1
            Unlocked_Level_4: DcmDspSecurityLevel=4
        DataInfo_Read_Write_coding_data_string_CDS_Version_Byte_1 (DcmDspDataInfo): DcmDspDataFixedLength=true
        EcuIdentification_Execution_Package (DcmDspData):
          DcmDspDataSize = 16
          DcmDspDataType = UINT8_N
          DcmDspDataUsePort = USE_DATA_ASYNCH_CLIENT_SERVER
          DcmDspDataInfoRef = DataInfo_EcuIdentification_Execution_Package
        4 x DcmDspDataInfo, all with DcmDspDataFixedLength=true:
          DataInfo_Date_And_Time_Date_And_Time_Hour
          DataInfo_Read_Write_coding_data_string_CDS_Version_Byte_0
          DataInfo_ECU_application_software_ASW_part_number_Minor_release
          DataInfo_Driver_Mode_Driver_Mode
        DidInfo_VCU_PowerMaxAllowed_parameter1 (DcmDspDidInfo)
          DcmDspDidAccess
            DcmDspDidRead: DcmDspDidReadSessionRef=DcmDspSession/Default, DcmDspDidReadSessionRef=DcmDspSession/Extended, DcmDspDidReadSessionRef=Coding_Session
        DidInfo_VCU_PowerMaxAllowed_parameter2 (DcmDspDidInfo)
          DcmDspDidAccess
            DcmDspDidRead: DcmDspDidReadSessionRef=DcmDspSession/Default, DcmDspDidReadSessionRef=DcmDspSession/Extended, DcmDspDidReadSessionRef=Coding_Session
        EcuIdentification (DcmDspDid): DcmDspDidIdentifier=61698, DcmDspDidUsed=true, DcmDspDidUsePort=USE_DATA_ELEMENT_SPECIFIC_INTERFACES, DcmDspDidInfoRef=DidInfo_EcuIdentification
          5 x DcmDspDidSignal:
            Specific_Vehicle_Code_WMI: DcmDspDidDataPos=0, DcmDspDidDataRef=EcuIdentification_Specific_Vehicle_Code_WMI
            Detail_Code: DcmDspDidDataPos=80, DcmDspDidDataRef=EcuIdentification_Detail_Code
            Execution_Package: DcmDspDidDataPos=104, DcmDspDidDataRef=EcuIdentification_Execution_Package
            Subgroup: DcmDspDidDataPos=64, DcmDspDidDataRef=EcuIdentification_Subgroup
            Group: DcmDspDidDataPos=48, DcmDspDidDataRef=EcuIdentification_Group
        SerialNumber_ECU_production_date_in_DD_MM_YY_format (DcmDspData):
          DcmDspDataSize = 48
          DcmDspDataType = UINT8_N
          DcmDspDataUsePort = USE_DATA_ASYNCH_CLIENT_SERVER
          DcmDspDataInfoRef = DataInfo_SerialNumber_ECU_production_date_in_DD_MM_YY_format
        Supplier_ECU_hardware_part_number_Major_release (DcmDspData):
          DcmDspDataSize = 8
          DcmDspDataType = UINT8
          DcmDspDataUsePort = USE_DATA_ASYNCH_CLIENT_SERVER
          DcmDspDataInfoRef = DataInfo_Supplier_ECU_hardware_part_number_Major_release
        DataInfo_Read_ECU_manufacturing_date_ECU_Manufacturing_Date_Month (DcmDspDataInfo): DcmDspDataFixedLength=true
        SOC_SOC (DcmDspData): DcmDspDataSize=16, DcmDspDataType=UINT16, DcmDspDataUsePort=USE_DATA_ASYNCH_CLIENT_SERVER, DcmDspDataInfoRef=DataInfo_SOC_SOC
        DidInfo_Read_Level1_OEM_Key_written_status (DcmDspDidInfo)
          DcmDspDidAccess
            DcmDspDidRead: DcmDspDidReadSessionRef=DcmDspSession/Default, DcmDspDidReadSessionRef=DcmDspSession/Extended, DcmDspDidReadSessionRef=Coding_Session
        VCU_HV_InterLock_PWM_pfrequency (DcmDspDid):
          DcmDspDidIdentifier = 7432
          DcmDspDidUsed = true
          DcmDspDidUsePort = USE_DATA_ELEMENT_SPECIFIC_INTERFACES
          DcmDspDidInfoRef = DidInfo_VCU_HV_InterLock_PWM_pfrequency
          VCU_HVIL (DcmDspDidSignal): DcmDspDidDataPos=0, DcmDspDidDataRef=VCU_HV_InterLock_PWM_pfrequency_VCU_HVIL
        DidInfo_S2_status (DcmDspDidInfo)
          DcmDspDidAccess
            DcmDspDidRead: DcmDspDidReadSessionRef=DcmDspSession/Default, DcmDspDidReadSessionRef=DcmDspSession/Extended, DcmDspDidReadSessionRef=Coding_Session
        VCU_Torque_parameter_VCU_MCUDesiredTorque (DcmDspData):
          DcmDspDataSize = 16
          DcmDspDataType = UINT16
          DcmDspDataUsePort = USE_DATA_ASYNCH_CLIENT_SERVER
          DcmDspDataInfoRef = DataInfo_VCU_Torque_parameter_VCU_MCUDesiredTorque
        EcuIdentification_Group (DcmDspData): DcmDspDataSize=16, DcmDspDataType=UINT8_N, DcmDspDataUsePort=USE_DATA_ASYNCH_CLIENT_SERVER, DcmDspDataInfoRef=DataInfo_EcuIdentification_Group
        DidInfo_Last_service_date (DcmDspDidInfo)
          DcmDspDidAccess
            DcmDspDidWrite: DcmDspDidWriteSessionRef=DcmDspSession/Extended, DcmDspDidWriteSecurityLevelRef=UnlockedL1
            DcmDspDidRead: DcmDspDidReadSessionRef=DcmDspSession/Default, DcmDspDidReadSessionRef=DcmDspSession/Extended, DcmDspDidReadSessionRef=Coding_Session
        DidInfo_AC_charging_parameter (DcmDspDidInfo)
          DcmDspDidAccess
            DcmDspDidRead: DcmDspDidReadSessionRef=DcmDspSession/Default, DcmDspDidReadSessionRef=DcmDspSession/Extended, DcmDspDidReadSessionRef=Coding_Session
        3 x DcmDspDataInfo, all with DcmDspDataFixedLength=true:
          DataInfo_Read_active_diagnostic_session_Active_diagnostic_session
          DataInfo_VCU_AccPealparameter_VCU_VehicleSpeed
          DataInfo_DevelopmentData_NmVersion
        Read_Level2_OEM_Key_written_status_OEM_Key_Write_state (DcmDspData):
          DcmDspDataSize = 8
          DcmDspDataType = UINT8
          DcmDspDataUsePort = USE_DATA_ASYNCH_CLIENT_SERVER
          DcmDspDataInfoRef = DataInfo_Read_Level2_OEM_Key_written_status_OEM_Key_Write_state
        Write_Level3_OEM_Key (DcmDspDid):
          DcmDspDidIdentifier = 61460
          DcmDspDidUsed = true
          DcmDspDidUsePort = USE_DATA_ELEMENT_SPECIFIC_INTERFACES
          DcmDspDidInfoRef = DidInfo_Write_Level3_OEM_Key
          OEM_Key_Value (DcmDspDidSignal): DcmDspDidDataPos=0, DcmDspDidDataRef=Write_Level3_OEM_Key_OEM_Key_Value
        DataInfo_AC_charging_parameter_POD_OBC_InputACVoltage (DcmDspDataInfo): DcmDspDataFixedLength=true
        EcuIdentification_Detail_Code (DcmDspData):
          DcmDspDataSize = 24
          DcmDspDataType = UINT8_N
          DcmDspDataUsePort = USE_DATA_ASYNCH_CLIENT_SERVER
          DcmDspDataInfoRef = DataInfo_EcuIdentification_Detail_Code
        3 x DcmDspDataInfo, all with DcmDspDataFixedLength=true:
          DataInfo_Date_And_Time_Date_And_Time_Day
          DataInfo_Date_And_Time_Date_And_Time_Minute
          DataInfo_Coding_for_CDS_fingerprint_codingDate_byte_1_YY
        EcuIdentification_Subgroup (DcmDspData): DcmDspDataSize=16, DcmDspDataType=UINT8_N, DcmDspDataUsePort=USE_DATA_ASYNCH_CLIENT_SERVER, DcmDspDataInfoRef=DataInfo_EcuIdentification_Subgroup
        DataInfo_Write_Level1_OEM_Key_OEM_Key_Value (DcmDspDataInfo): DcmDspDataFixedLength=true
        VCU_control_main_relay_Mainrealy1 (DcmDspData):
          DcmDspDataSize = 8
          DcmDspDataType = UINT8
          DcmDspDataUsePort = USE_DATA_ASYNCH_CLIENT_SERVER
          DcmDspDataInfoRef = DataInfo_VCU_control_main_relay_Mainrealy1
        DidInfo_Write_Level1_OEM_Key (DcmDspDidInfo)
          DcmDspDidAccess
            DcmDspDidWrite: DcmDspDidWriteSessionRef=DcmDspSession/Extended, DcmDspDidWriteSecurityLevelRef=UnlockedL1
        VCU_AccPealparameter_Accelerator_pedal_sensor_1_voltage (DcmDspData):
          DcmDspDataSize = 8
          DcmDspDataType = UINT8
          DcmDspDataUsePort = USE_DATA_ASYNCH_CLIENT_SERVER
          DcmDspDataInfoRef = DataInfo_VCU_AccPealparameter_Accelerator_pedal_sensor_1_voltage
        DataInfo_ECU_application_software_ASW_part_number_No_functional_content_change (DcmDspDataInfo): DcmDspDataFixedLength=true
        DataInfo_VCU_PowerMaxAllowed_parameter1_VCU_TCUPowerAllowed (DcmDspDataInfo): DcmDspDataFixedLength=true
        Battery_Voltage_Battery_Voltage (DcmDspData):
          DcmDspDataSize = 16
          DcmDspDataType = UINT16
          DcmDspDataUsePort = USE_DATA_ASYNCH_CLIENT_SERVER
          DcmDspDataInfoRef = DataInfo_Battery_Voltage_Battery_Voltage
        VCU_Torque_parameter_Torque_MinAllowed (DcmDspData):
          DcmDspDataSize = 16
          DcmDspDataType = UINT16
          DcmDspDataUsePort = USE_DATA_ASYNCH_CLIENT_SERVER
          DcmDspDataInfoRef = DataInfo_VCU_Torque_parameter_Torque_MinAllowed
        DidInfo_Electronic_lock_state (DcmDspDidInfo)
          DcmDspDidAccess
            DcmDspDidRead: DcmDspDidReadSessionRef=DcmDspSession/Default, DcmDspDidReadSessionRef=DcmDspSession/Extended, DcmDspDidReadSessionRef=Coding_Session
        4 x DcmDspDataInfo, all with DcmDspDataFixedLength=true:
          DataInfo_SerialNumber_ECU_index_number
          DataInfo_EcuIdentification_Execution_Package
          DataInfo_Read_Level3_OEM_Key_written_status_OEM_Key_Write_state
          DataInfo_Last_service_date_Year
        Ignition_Switch_Signal (DcmDspDid):
          DcmDspDidIdentifier = 61856
          DcmDspDidUsed = true
          DcmDspDidUsePort = USE_DATA_ELEMENT_SPECIFIC_INTERFACES
          DcmDspDidInfoRef = DidInfo_Ignition_Switch_Signal
          Ignition_Switch_Signal (DcmDspDidSignal): DcmDspDidDataPos=0, DcmDspDidDataRef=Ignition_Switch_Signal_Ignition_Switch_Signal
        DataInfo_Coding_for_CDS_fingerprint_repairShopCodeorTesterSerialNumber_byte_1_27_MSB (DcmDspDataInfo): DcmDspDataFixedLength=true
        S2_status_New_Bit_Field (DcmDspData): DcmDspDataSize=8, DcmDspDataType=UINT8, DcmDspDataUsePort=USE_DATA_ASYNCH_CLIENT_SERVER, DcmDspDataInfoRef=DataInfo_S2_status_New_Bit_Field
        DidInfo_Read_Level3_OEM_Key_written_status (DcmDspDidInfo)
          DcmDspDidAccess
            DcmDspDidRead: DcmDspDidReadSessionRef=DcmDspSession/Default, DcmDspDidReadSessionRef=DcmDspSession/Extended, DcmDspDidReadSessionRef=Coding_Session
        DidInfo_VCU_AccPealparameter (DcmDspDidInfo)
          DcmDspDidAccess
            DcmDspDidRead: DcmDspDidReadSessionRef=DcmDspSession/Default, DcmDspDidReadSessionRef=DcmDspSession/Extended, DcmDspDidReadSessionRef=Coding_Session
        DataInfo_DevelopmentData_OperatingSystemVersion (DcmDspDataInfo): DcmDspDataFixedLength=true
        DataInfo_Coding_for_CDS_fingerprint_codingDate_byte_3_DD (DcmDspDataInfo): DcmDspDataFixedLength=true
        5 x DcmDspData, all with DcmDspDataSize=8, DcmDspDataUsePort=USE_DATA_ASYNCH_CLIENT_SERVER:
          Read_Write_coding_data_string_CDS_Configuration2: DcmDspDataType=UINT8_N, DcmDspDataInfoRef=DataInfo_Read_Write_coding_data_string_CDS_Configuration2
          Read_Write_coding_data_string_CDS_Configuration1: DcmDspDataType=UINT8, DcmDspDataInfoRef=DataInfo_Read_Write_coding_data_string_CDS_Configuration1
          Read_ECU_manufacturing_date_ECU_Manufacturing_Date_Year: DcmDspDataType=UINT8_N, DcmDspDataInfoRef=DataInfo_Read_ECU_manufacturing_date_ECU_Manufacturing_Date_Year
          Read_ECU_manufacturing_date_ECU_Manufacturing_Date_Month: DcmDspDataType=UINT8_N, DcmDspDataInfoRef=DataInfo_Read_ECU_manufacturing_date_ECU_Manufacturing_Date_Month
          Bootloader_version_number_Major_release: DcmDspDataType=UINT8, DcmDspDataInfoRef=DataInfo_Bootloader_version_number_Major_release
        DataInfo_Read_Level1_OEM_Key_written_status_OEM_Key_Write_state (DcmDspDataInfo): DcmDspDataFixedLength=true
        Read_Level4_OEM_Key_written_status (DcmDspDid):
          DcmDspDidIdentifier = 61463
          DcmDspDidUsed = true
          DcmDspDidUsePort = USE_DATA_ELEMENT_SPECIFIC_INTERFACES
          DcmDspDidInfoRef = DidInfo_Read_Level4_OEM_Key_written_status
          OEM_Key_Write_state (DcmDspDidSignal): DcmDspDidDataPos=0, DcmDspDidDataRef=Read_Level4_OEM_Key_written_status_OEM_Key_Write_state
        DataInfo_Vehicle_speed_Vehicle_speed (DcmDspDataInfo): DcmDspDataFixedLength=true
        HV_Status_and_Charging_Status_HV_status_and_charging_status (DcmDspData):
          DcmDspDataSize = 8
          DcmDspDataType = UINT8
          DcmDspDataUsePort = USE_DATA_ASYNCH_CLIENT_SERVER
          DcmDspDataInfoRef = DataInfo_HV_Status_and_Charging_Status_HV_status_and_charging_status
        ECU_application_software_ASW_part_number_Minor_release (DcmDspData):
          DcmDspDataSize = 8
          DcmDspDataType = UINT8
          DcmDspDataUsePort = USE_DATA_ASYNCH_CLIENT_SERVER
          DcmDspDataInfoRef = DataInfo_ECU_application_software_ASW_part_number_Minor_release
        DataInfo_AC_charging_parameter_VCU_OBC_ChargeCurrentCommand (DcmDspDataInfo): DcmDspDataFixedLength=true
        Read_ECU_Part_Number_Execution_Package (DcmDspData):
          DcmDspDataSize = 16
          DcmDspDataType = UINT8_N
          DcmDspDataUsePort = USE_DATA_ASYNCH_CLIENT_SERVER
          DcmDspDataInfoRef = DataInfo_Read_ECU_Part_Number_Execution_Package
        DataInfo_VCU_AccPealparameter_Accelerator_pedal_sensor_2_voltage (DcmDspDataInfo): DcmDspDataFixedLength=true
        Read_Write_coding_data_string_CDS_Version_Byte_0 (DcmDspData):
          DcmDspDataSize = 8
          DcmDspDataType = UINT8
          DcmDspDataUsePort = USE_DATA_ASYNCH_CLIENT_SERVER
          DcmDspDataInfoRef = DataInfo_Read_Write_coding_data_string_CDS_Version_Byte_0
        DidInfo_VCU_HV_InterLock_PWM_pfrequency (DcmDspDidInfo)
          DcmDspDidAccess
            DcmDspDidRead: DcmDspDidReadSessionRef=DcmDspSession/Default, DcmDspDidReadSessionRef=DcmDspSession/Extended, DcmDspDidReadSessionRef=Coding_Session
        VCU_PowerMaxAllowed_parameter1 (DcmDspDid):
          DcmDspDidIdentifier = 7428
          DcmDspDidUsed = true
          DcmDspDidUsePort = USE_DATA_ELEMENT_SPECIFIC_INTERFACES
          DcmDspDidInfoRef = DidInfo_VCU_PowerMaxAllowed_parameter1
          4 x DcmDspDidSignal:
            VCU_TCUPowerAllowed: DcmDspDidDataPos=0, DcmDspDidDataRef=VCU_PowerMaxAllowed_parameter1_VCU_TCUPowerAllowed
            VCU_DCDCPowerLimit: DcmDspDidDataPos=16, DcmDspDidDataRef=VCU_PowerMaxAllowed_parameter1_VCU_DCDCPowerLimit
            VCU_A2LPowerMaxAllowed: DcmDspDidDataPos=48, DcmDspDidDataRef=VCU_PowerMaxAllowed_parameter1_VCU_A2LPowerMaxAllowed
            MCUPowerLimit: DcmDspDidDataPos=32, DcmDspDidDataRef=VCU_PowerMaxAllowed_parameter1_MCUPowerLimit
        3 x DcmDspDataInfo, all with DcmDspDataFixedLength=true:
          DataInfo_VCU_PowerMaxAllowed_parameter1_VCU_DCDCPowerLimit
          DataInfo_VCU_PowerMaxAllowed_parameter2_VCU_DCDCPowerLimit
          DataInfo_AC_charging_parameter_POD_OBC_OutputDCChargeVoltage
        CheckCodingState (DcmDspRoutine):
          DcmDspRequestResultsRoutineSupported = false
          DcmDspStopRoutineSupported = false
          DcmDspRoutineIdentifier = 258
          DcmDspRoutineFixedLength = false
          DcmDspRoutineUsePort = true
          DcmDspRoutineUsed = true
          DcmDspRoutineInfoRef = RoutineInfo_CheckCodingState
        VCU_PowerMaxAllowed_parameter2 (DcmDspDid):
          DcmDspDidIdentifier = 7440
          DcmDspDidUsed = true
          DcmDspDidUsePort = USE_DATA_ELEMENT_SPECIFIC_INTERFACES
          DcmDspDidInfoRef = DidInfo_VCU_PowerMaxAllowed_parameter2
          VCU_DCDCPowerLimit (DcmDspDidSignal): DcmDspDidDataPos=0, DcmDspDidDataRef=VCU_PowerMaxAllowed_parameter2_VCU_DCDCPowerLimit
          MCUPowerLimit (DcmDspDidSignal): DcmDspDidDataPos=16, DcmDspDidDataRef=VCU_PowerMaxAllowed_parameter2_MCUPowerLimit
        DataInfo_VCU_control_main_relay_Mainrelay2 (DcmDspDataInfo): DcmDspDataFixedLength=true
        PWT_vehicle_fault_Level (DcmDspDid):
          DcmDspDidIdentifier = 7442
          DcmDspDidUsed = true
          DcmDspDidUsePort = USE_DATA_ELEMENT_SPECIFIC_INTERFACES
          DcmDspDidInfoRef = DidInfo_PWT_vehicle_fault_Level
          PWT_ErrorLevel (DcmDspDidSignal): DcmDspDidDataPos=0, DcmDspDidDataRef=PWT_vehicle_fault_Level_PWT_ErrorLevel
        3 x DcmDspDataInfo, all with DcmDspDataFixedLength=true:
          DataInfo_Battery_Voltage_Battery_Voltage
          DataInfo_Read_Write_coding_data_string_CDS_CDS_Format_Byte_High_Byte_1
          DataInfo_Read_Write_coding_data_string_CDS_CDS_Format_Byte_High_Byte_0
        Gear (DcmDspDid): DcmDspDidIdentifier=61863, DcmDspDidUsed=true, DcmDspDidUsePort=USE_DATA_ELEMENT_SPECIFIC_INTERFACES, DcmDspDidInfoRef=DidInfo_Gear
          Gear (DcmDspDidSignal): DcmDspDidDataPos=0, DcmDspDidDataRef=Gear_Gear
        Last_service_date_Month (DcmDspData): DcmDspDataSize=8, DcmDspDataType=UINT8_N, DcmDspDataUsePort=USE_DATA_ASYNCH_CLIENT_SERVER, DcmDspDataInfoRef=DataInfo_Last_service_date_Month
        DidInfo_VCU_Torque_parameter (DcmDspDidInfo)
          DcmDspDidAccess
            DcmDspDidRead: DcmDspDidReadSessionRef=DcmDspSession/Default, DcmDspDidReadSessionRef=DcmDspSession/Extended, DcmDspDidReadSessionRef=Coding_Session
        DataInfo_Last_service_date_Day (DcmDspDataInfo): DcmDspDataFixedLength=true
        DataInfo_HV_Status_and_Charging_Status_HV_status_and_charging_status (DcmDspDataInfo): DcmDspDataFixedLength=true
        Read_Write_coding_data_string_CDS_Version_Byte_1 (DcmDspData):
          DcmDspDataSize = 8
          DcmDspDataType = UINT8
          DcmDspDataUsePort = USE_DATA_ASYNCH_CLIENT_SERVER
          DcmDspDataInfoRef = DataInfo_Read_Write_coding_data_string_CDS_Version_Byte_1
        DataInfo_VCU_HVStatus_VCU_HVStatus (DcmDspDataInfo): DcmDspDataFixedLength=true
        DataInfo_Date_And_Time_Date_And_Time_Second (DcmDspDataInfo): DcmDspDataFixedLength=true
        Date_And_Time_Date_And_Time_Day (DcmDspData):
          DcmDspDataSize = 8
          DcmDspDataType = UINT8
          DcmDspDataUsePort = USE_DATA_ASYNCH_CLIENT_SERVER
          DcmDspDataInfoRef = DataInfo_Date_And_Time_Date_And_Time_Day
        Chargestatus (DcmDspDid): DcmDspDidIdentifier=7430, DcmDspDidUsed=true, DcmDspDidUsePort=USE_DATA_ELEMENT_SPECIFIC_INTERFACES, DcmDspDidInfoRef=DidInfo_Chargestatus
          Chargestatus (DcmDspDidSignal): DcmDspDidDataPos=0, DcmDspDidDataRef=Chargestatus_Chargestatus
        DataInfo_VCU_Torque_parameter_Torque_MinAllowed (DcmDspDataInfo): DcmDspDataFixedLength=true
        VCU_Torque_parameter_Torque_MaxAllowed (DcmDspData):
          DcmDspDataSize = 16
          DcmDspDataType = UINT16
          DcmDspDataUsePort = USE_DATA_ASYNCH_CLIENT_SERVER
          DcmDspDataInfoRef = DataInfo_VCU_Torque_parameter_Torque_MaxAllowed
        RoutineInfo_CheckProgrammingPreCondition (DcmDspRoutineInfo)
          DcmDspRoutineAuthorization: DcmDspRoutineSessionRef=DcmDspSession/Extended
          DcmDspStartRoutineOut
            Out_programmingPreConditionList (DcmDspStartRoutineOutSignal): DcmDspRoutineSignalLength=56, DcmDspRoutineSignalType=UINT8_N, DcmDspRoutineSignalEndianness=opaque, DcmDspRoutineSignalPos=0
        Erase_Memory (DcmDspRoutine):
          DcmDspRequestResultsRoutineSupported = false
          DcmDspStopRoutineSupported = false
          DcmDspRoutineIdentifier = 65280
          DcmDspRoutineFixedLength = false
          DcmDspRoutineUsePort = true
          DcmDspRoutineUsed = true
          DcmDspRoutineInfoRef = RoutineInfo_Erase_Memory
        DataInfo_Read_ECU_Part_Number_Specific_Vehicle_Code_WMI (DcmDspDataInfo): DcmDspDataFixedLength=true
        DataInfo_ECU_application_software_ASW_part_number_Major_release (DcmDspDataInfo): DcmDspDataFixedLength=true
        Read_Level2_OEM_Key_written_status (DcmDspDid):
          DcmDspDidIdentifier = 61459
          DcmDspDidUsed = true
          DcmDspDidUsePort = USE_DATA_ELEMENT_SPECIFIC_INTERFACES
          DcmDspDidInfoRef = DidInfo_Read_Level2_OEM_Key_written_status
          OEM_Key_Write_state (DcmDspDidSignal): DcmDspDidDataPos=0, DcmDspDidDataRef=Read_Level2_OEM_Key_written_status_OEM_Key_Write_state
        8 x DcmDspData, all with DcmDspDataType=UINT8_N, DcmDspDataUsePort=USE_DATA_ASYNCH_CLIENT_SERVER:
          Read_ECU_Part_Number_Detail_Code: DcmDspDataSize=24, DcmDspDataInfoRef=DataInfo_Read_ECU_Part_Number_Detail_Code
          Read_Write_coding_data_string_CDS_CDS_Short_VIN_High_Byte_{0..5}: DcmDspDataSize=8, DcmDspDataInfoRef=DataInfo_Read_Write_coding_data_string_CDS_CDS_Short_VIN_High_Byte_{0..5}
          Read_Write_coding_data_string_CDS_CDS_Short_VIN_High_Byte_7: DcmDspDataSize=8, DcmDspDataInfoRef=DataInfo_Read_Write_coding_data_string_CDS_CDS_Short_VIN_High_Byte_7
        DidInfo_Write_Level3_OEM_Key (DcmDspDidInfo)
          DcmDspDidAccess
            DcmDspDidWrite: DcmDspDidWriteSessionRef=Coding_Session, DcmDspDidWriteSecurityLevelRef=Unlocked_Level_3
        DidInfo_PWT_vehicle_fault_Level (DcmDspDidInfo)
          DcmDspDidAccess
            DcmDspDidRead: DcmDspDidReadSessionRef=DcmDspSession/Default, DcmDspDidReadSessionRef=DcmDspSession/Extended, DcmDspDidReadSessionRef=Coding_Session
        DataInfo_Electronic_lock_state_Electronic_lock_state (DcmDspDataInfo): DcmDspDataFixedLength=true
        Coding_for_CDS_fingerprint_codingDate_byte_2_MM (DcmDspData):
          DcmDspDataSize = 8
          DcmDspDataType = UINT8_N
          DcmDspDataUsePort = USE_DATA_ASYNCH_CLIENT_SERVER
          DcmDspDataInfoRef = DataInfo_Coding_for_CDS_fingerprint_codingDate_byte_2_MM
        DataInfo_Bootloader_version_number_No_functional_content_change (DcmDspDataInfo): DcmDspDataFixedLength=true
        VCU_PowerMaxAllowed_parameter1_MCUPowerLimit (DcmDspData):
          DcmDspDataSize = 16
          DcmDspDataType = UINT16
          DcmDspDataUsePort = USE_DATA_ASYNCH_CLIENT_SERVER
          DcmDspDataInfoRef = DataInfo_VCU_PowerMaxAllowed_parameter1_MCUPowerLimit
        ComControl (DcmDspComControl)
          DspComContolAllChannel (DcmDspComControlAllChannel): DcmDspAllComMChannelRef=(unset)
        Read_Level4_OEM_Key_written_status_OEM_Key_Write_state (DcmDspData):
          DcmDspDataSize = 8
          DcmDspDataType = UINT8
          DcmDspDataUsePort = USE_DATA_ASYNCH_CLIENT_SERVER
          DcmDspDataInfoRef = DataInfo_Read_Level4_OEM_Key_written_status_OEM_Key_Write_state
        DidInfo_HV_Status_and_Charging_Status (DcmDspDidInfo)
          DcmDspDidAccess
            DcmDspDidRead: DcmDspDidReadSessionRef=DcmDspSession/Default, DcmDspDidReadSessionRef=DcmDspSession/Extended, DcmDspDidReadSessionRef=Coding_Session
        DataInfo_Bootloader_version_number_Minor_release (DcmDspDataInfo): DcmDspDataFixedLength=true
        DidInfo_EcuIdentification (DcmDspDidInfo)
          DcmDspDidAccess
            DcmDspDidRead: DcmDspDidReadSessionRef=DcmDspSession/Default, DcmDspDidReadSessionRef=DcmDspSession/Extended, DcmDspDidReadSessionRef=Coding_Session
        DataInfo_Read_ECU_manufacturing_date_ECU_Manufacturing_Date_Year (DcmDspDataInfo): DcmDspDataFixedLength=true
        CheckProgrammingPreCondition (DcmDspRoutine):
          DcmDspRequestResultsRoutineSupported = false
          DcmDspStopRoutineSupported = false
          DcmDspRoutineIdentifier = 515
          DcmDspRoutineFixedLength = false
          DcmDspRoutineUsePort = true
          DcmDspRoutineUsed = true
          DcmDspRoutineInfoRef = RoutineInfo_CheckProgrammingPreCondition
        RoutineInfo_Check_Memory (DcmDspRoutineInfo)
          DcmDspStartRoutineIn
            In_checksum (DcmDspStartRoutineInSignal): DcmDspRoutineSignalLength=32, DcmDspRoutineSignalType=UINT32, DcmDspRoutineSignalEndianness=BIG_ENDIAN, DcmDspRoutineSignalPos=0
          DcmDspRoutineAuthorization: DcmDspRoutineSessionRef=DcmDspSession/Programming, DcmDspRoutineSecurityLevelRef=Unlocked_Level_4
          DcmDspStartRoutineOut
            Out_routineResult (DcmDspStartRoutineOutSignal): DcmDspRoutineSignalLength=8, DcmDspRoutineSignalType=UINT8, DcmDspRoutineSignalPos=0
        DidInfo_Read_active_diagnostic_session (DcmDspDidInfo)
          DcmDspDidAccess
            DcmDspDidRead: DcmDspDidReadSessionRef=DcmDspSession/Default, DcmDspDidReadSessionRef=DcmDspSession/Extended, DcmDspDidReadSessionRef=Coding_Session
        DataInfo_Read_ECU_Part_Number_Group (DcmDspDataInfo): DcmDspDataFixedLength=true
        PWT_vehicle_fault_Level_PWT_ErrorLevel (DcmDspData):
          DcmDspDataSize = 8
          DcmDspDataType = UINT8
          DcmDspDataUsePort = USE_DATA_ASYNCH_CLIENT_SERVER
          DcmDspDataInfoRef = DataInfo_PWT_vehicle_fault_Level_PWT_ErrorLevel
        DevelopmentData (DcmDspDid): DcmDspDidIdentifier=61834, DcmDspDidUsed=true, DcmDspDidUsePort=USE_DATA_ELEMENT_SPECIFIC_INTERFACES, DcmDspDidInfoRef=DidInfo_DevelopmentData
          3 x DcmDspDidSignal:
            CanDriverVersion: DcmDspDidDataPos=16, DcmDspDidDataRef=DevelopmentData_CanDriverVersion
            NmVersion: DcmDspDidDataPos=40, DcmDspDidDataRef=DevelopmentData_NmVersion
            OperatingSystemVersion: DcmDspDidDataPos=0, DcmDspDidDataRef=DevelopmentData_OperatingSystemVersion
        DataInfo_EcuIdentification_Specific_Vehicle_Code_WMI (DcmDspDataInfo): DcmDspDataFixedLength=true
        CheckProgrammingDependencies (DcmDspRoutine):
          DcmDspRequestResultsRoutineSupported = false
          DcmDspStopRoutineSupported = false
          DcmDspRoutineIdentifier = 65281
          DcmDspRoutineFixedLength = false
          DcmDspRoutineUsePort = true
          DcmDspRoutineUsed = true
          DcmDspRoutineInfoRef = RoutineInfo_CheckProgrammingDependencies
        DataInfo_Write_Level4_OEM_Key_OEM_Key_Value (DcmDspDataInfo): DcmDspDataFixedLength=true
        RoutineInfo_Erase_Memory (DcmDspRoutineInfo)
          DcmDspStartRoutineIn
            3 x DcmDspStartRoutineInSignal:
              In_memoryAddress: DcmDspRoutineSignalLength=32, DcmDspRoutineSignalType=UINT32, DcmDspRoutineSignalEndianness=BIG_ENDIAN, DcmDspRoutineSignalPos=8
              In_memorySize: DcmDspRoutineSignalLength=32, DcmDspRoutineSignalType=UINT32, DcmDspRoutineSignalEndianness=BIG_ENDIAN, DcmDspRoutineSignalPos=40
              In_addressAndLengthFormatIdentifier: DcmDspRoutineSignalLength=8, DcmDspRoutineSignalType=UINT8, DcmDspRoutineSignalPos=0
          DcmDspRoutineAuthorization: DcmDspRoutineSessionRef=DcmDspSession/Programming, DcmDspRoutineSecurityLevelRef=Unlocked_Level_4
          DcmDspStartRoutineOut
            Out_routineResult (DcmDspStartRoutineOutSignal): DcmDspRoutineSignalLength=8, DcmDspRoutineSignalType=UINT8, DcmDspRoutineSignalPos=0
        Read_active_diagnostic_session (DcmDspDid):
          DcmDspDidIdentifier = 61830
          DcmDspDidUsed = true
          DcmDspDidUsePort = USE_DATA_ELEMENT_SPECIFIC_INTERFACES
          DcmDspDidInfoRef = DidInfo_Read_active_diagnostic_session
          Active_diagnostic_session (DcmDspDidSignal): DcmDspDidDataPos=0, DcmDspDidDataRef=Read_active_diagnostic_session_Active_diagnostic_session
        Read_Write_complete_VIN_World_Manufacturers_Identification (DcmDspData):
          DcmDspDataSize = 24
          DcmDspDataType = UINT8_N
          DcmDspDataUsePort = USE_DATA_ASYNCH_CLIENT_SERVER
          DcmDspDataInfoRef = DataInfo_Read_Write_complete_VIN_World_Manufacturers_Identification
        DataInfo_Chargestatus_Chargestatus (DcmDspDataInfo): DcmDspDataFixedLength=true
        DidInfo_Date_And_Time (DcmDspDidInfo)
          DcmDspDidAccess
            DcmDspDidRead: DcmDspDidReadSessionRef=DcmDspSession/Default, DcmDspDidReadSessionRef=DcmDspSession/Extended, DcmDspDidReadSessionRef=Coding_Session
        DidInfo_Read_Write_complete_VIN (DcmDspDidInfo)
          DcmDspDidAccess
            DcmDspDidWrite: DcmDspDidWriteSessionRef=DcmDspSession/Extended, DcmDspDidWriteSecurityLevelRef=UnlockedL1, DcmDspDidWriteSecurityLevelRef=Unlocked_Level_2
            DcmDspDidRead: DcmDspDidReadSessionRef=DcmDspSession/Default, DcmDspDidReadSessionRef=DcmDspSession/Extended, DcmDspDidReadSessionRef=Coding_Session
        DataInfo_Supplier_ECU_hardware_part_number_Changes_in_electronic_components_level (DcmDspDataInfo): DcmDspDataFixedLength=true
        DataInfo_Bootloader_version_number_Major_release (DcmDspDataInfo): DcmDspDataFixedLength=true
        DidInfo_Total_Odometer (DcmDspDidInfo)
          DcmDspDidAccess
            DcmDspDidRead: DcmDspDidReadSessionRef=DcmDspSession/Default, DcmDspDidReadSessionRef=DcmDspSession/Extended, DcmDspDidReadSessionRef=Coding_Session
        Read_Write_coding_data_string_CDS_CDS_Format_Byte_High_Byte_0 (DcmDspData):
          DcmDspDataSize = 8
          DcmDspDataType = UINT8
          DcmDspDataUsePort = USE_DATA_ASYNCH_CLIENT_SERVER
          DcmDspDataInfoRef = DataInfo_Read_Write_coding_data_string_CDS_CDS_Format_Byte_High_Byte_0
        Read_ECU_Part_Number (DcmDspDid):
          DcmDspDidIdentifier = 61831
          DcmDspDidUsed = true
          DcmDspDidUsePort = USE_DATA_ELEMENT_SPECIFIC_INTERFACES
          DcmDspDidInfoRef = DidInfo_Read_ECU_Part_Number
          5 x DcmDspDidSignal:
            Specific_Vehicle_Code_WMI: DcmDspDidDataPos=0, DcmDspDidDataRef=Read_ECU_Part_Number_Specific_Vehicle_Code_WMI
            Detail_Code: DcmDspDidDataPos=80, DcmDspDidDataRef=Read_ECU_Part_Number_Detail_Code
            Execution_Package: DcmDspDidDataPos=104, DcmDspDidDataRef=Read_ECU_Part_Number_Execution_Package
            Subgroup: DcmDspDidDataPos=64, DcmDspDidDataRef=Read_ECU_Part_Number_Subgroup
            Group: DcmDspDidDataPos=48, DcmDspDidDataRef=Read_ECU_Part_Number_Group
        DidInfo_Battery_Voltage (DcmDspDidInfo)
          DcmDspDidAccess
            DcmDspDidRead: DcmDspDidReadSessionRef=DcmDspSession/Default, DcmDspDidReadSessionRef=DcmDspSession/Extended, DcmDspDidReadSessionRef=Coding_Session
        Write_Level2_OEM_Key (DcmDspDid):
          DcmDspDidIdentifier = 61458
          DcmDspDidUsed = true
          DcmDspDidUsePort = USE_DATA_ELEMENT_SPECIFIC_INTERFACES
          DcmDspDidInfoRef = DidInfo_Write_Level2_OEM_Key
          OEM_Key_Value (DcmDspDidSignal): DcmDspDidDataPos=0, DcmDspDidDataRef=Write_Level2_OEM_Key_OEM_Key_Value
        VCU_HVStatus (DcmDspDid): DcmDspDidIdentifier=61861, DcmDspDidUsed=true, DcmDspDidUsePort=USE_DATA_ELEMENT_SPECIFIC_INTERFACES, DcmDspDidInfoRef=DidInfo_VCU_HVStatus
          VCU_HVStatus (DcmDspDidSignal): DcmDspDidDataPos=0, DcmDspDidDataRef=VCU_HVStatus_VCU_HVStatus
        Read_Write_coding_data_string_CDS_CDS_Format_Byte_High_Byte_1 (DcmDspData):
          DcmDspDataSize = 8
          DcmDspDataType = UINT8
          DcmDspDataUsePort = USE_DATA_ASYNCH_CLIENT_SERVER
          DcmDspDataInfoRef = DataInfo_Read_Write_coding_data_string_CDS_CDS_Format_Byte_High_Byte_1
        S2_status (DcmDspDid): DcmDspDidIdentifier=7433, DcmDspDidUsed=true, DcmDspDidUsePort=USE_DATA_ELEMENT_SPECIFIC_INTERFACES, DcmDspDidInfoRef=DidInfo_S2_status
          New_Bit_Field (DcmDspDidSignal): DcmDspDidDataPos=0, DcmDspDidDataRef=S2_status_New_Bit_Field
        AC_charging_parameter_POD_OBC_OutputDCChargeVoltage (DcmDspData):
          DcmDspDataSize = 16
          DcmDspDataType = UINT16
          DcmDspDataUsePort = USE_DATA_ASYNCH_CLIENT_SERVER
          DcmDspDataInfoRef = DataInfo_AC_charging_parameter_POD_OBC_OutputDCChargeVoltage
        DataInfo_Read_ECU_Part_Number_Detail_Code (DcmDspDataInfo): DcmDspDataFixedLength=true
        DataInfo_Ignition_Switch_Signal_Ignition_Switch_Signal (DcmDspDataInfo): DcmDspDataFixedLength=true
        SerialNumber_Supplier_name (DcmDspData): DcmDspDataSize=40, DcmDspDataType=UINT8_N, DcmDspDataUsePort=USE_DATA_ASYNCH_CLIENT_SERVER, DcmDspDataInfoRef=DataInfo_SerialNumber_Supplier_name
        DidInfo_Write_Level2_OEM_Key (DcmDspDidInfo)
          DcmDspDidAccess
            DcmDspDidWrite: DcmDspDidWriteSessionRef=DcmDspSession/Extended, DcmDspDidWriteSecurityLevelRef=Unlocked_Level_2
        DidInfo_Read_ECU_Part_Number (DcmDspDidInfo)
          DcmDspDidAccess
            DcmDspDidRead: DcmDspDidReadSessionRef=DcmDspSession/Default, DcmDspDidReadSessionRef=DcmDspSession/Extended, DcmDspDidReadSessionRef=Coding_Session
        SerialNumber_ECU_Name (DcmDspData): DcmDspDataSize=24, DcmDspDataType=UINT8_N, DcmDspDataUsePort=USE_DATA_ASYNCH_CLIENT_SERVER, DcmDspDataInfoRef=DataInfo_SerialNumber_ECU_Name
        Driver_Mode (DcmDspDid): DcmDspDidIdentifier=7427, DcmDspDidUsed=true, DcmDspDidUsePort=USE_DATA_ELEMENT_SPECIFIC_INTERFACES, DcmDspDidInfoRef=DidInfo_Driver_Mode
          Driver_Mode (DcmDspDidSignal): DcmDspDidDataPos=0, DcmDspDidDataRef=Driver_Mode_Driver_Mode
        DataInfo_SerialNumber_ECU_production_date_in_DD_MM_YY_format (DcmDspDataInfo): DcmDspDataFixedLength=true
        DidInfo_Ignition_Switch_Signal (DcmDspDidInfo)
          DcmDspDidAccess
            DcmDspDidRead: DcmDspDidReadSessionRef=DcmDspSession/Default, DcmDspDidReadSessionRef=DcmDspSession/Extended, DcmDspDidReadSessionRef=Coding_Session
        AC_charging_parameter_POD_OBC_InputACVoltage (DcmDspData):
          DcmDspDataSize = 16
          DcmDspDataType = UINT16
          DcmDspDataUsePort = USE_DATA_ASYNCH_CLIENT_SERVER
          DcmDspDataInfoRef = DataInfo_AC_charging_parameter_POD_OBC_InputACVoltage
        VCU_AccPealparameter_Accelerator_pedal_sensor_2_voltage (DcmDspData):
          DcmDspDataSize = 8
          DcmDspDataType = UINT8
          DcmDspDataUsePort = USE_DATA_ASYNCH_CLIENT_SERVER
          DcmDspDataInfoRef = DataInfo_VCU_AccPealparameter_Accelerator_pedal_sensor_2_voltage
        Vehicle_speed (DcmDspDid): DcmDspDidIdentifier=61859, DcmDspDidUsed=true, DcmDspDidUsePort=USE_DATA_ELEMENT_SPECIFIC_INTERFACES, DcmDspDidInfoRef=DidInfo_Vehicle_speed
          Vehicle_speed (DcmDspDidSignal): DcmDspDidDataPos=0, DcmDspDidDataRef=Vehicle_speed_Vehicle_speed
        DataInfo_Read_Level4_OEM_Key_written_status_OEM_Key_Write_state (DcmDspDataInfo): DcmDspDataFixedLength=true
        Write_Level1_OEM_Key_OEM_Key_Value (DcmDspData):
          DcmDspDataSize = 128
          DcmDspDataType = UINT8_N
          DcmDspDataUsePort = USE_DATA_ASYNCH_CLIENT_SERVER
          DcmDspDataInfoRef = DataInfo_Write_Level1_OEM_Key_OEM_Key_Value
        DataInfo_AC_charging_parameter_POD_OBC_OutputDCChargeCurrent (DcmDspDataInfo): DcmDspDataFixedLength=true
        VCU_Torque_parameter_VCU_RegenTorqueCap (DcmDspData):
          DcmDspDataSize = 16
          DcmDspDataType = UINT16
          DcmDspDataUsePort = USE_DATA_ASYNCH_CLIENT_SERVER
          DcmDspDataInfoRef = DataInfo_VCU_Torque_parameter_VCU_RegenTorqueCap
        DidInfo_Gear (DcmDspDidInfo)
          DcmDspDidAccess
            DcmDspDidRead: DcmDspDidReadSessionRef=DcmDspSession/Default, DcmDspDidReadSessionRef=DcmDspSession/Extended, DcmDspDidReadSessionRef=Coding_Session
        SerialNumber (DcmDspDid): DcmDspDidIdentifier=61836, DcmDspDidUsed=true, DcmDspDidUsePort=USE_DATA_ELEMENT_SPECIFIC_INTERFACES, DcmDspDidInfoRef=DidInfo_SerialNumber
          4 x DcmDspDidSignal:
            ECU_Name: DcmDspDidDataPos=0, DcmDspDidDataRef=SerialNumber_ECU_Name
            ECU_index_number: DcmDspDidDataPos=112, DcmDspDidDataRef=SerialNumber_ECU_index_number
            ECU_production_date_in_DD_MM_YY_format: DcmDspDidDataPos=64, DcmDspDidDataRef=SerialNumber_ECU_production_date_in_DD_MM_YY_format
            Supplier_name: DcmDspDidDataPos=24, DcmDspDidDataRef=SerialNumber_Supplier_name
        3 x DcmDspData, all with DcmDspDataSize=8, DcmDspDataUsePort=USE_DATA_ASYNCH_CLIENT_SERVER:
          VCU_control_main_relay_Mainrelay2: DcmDspDataType=UINT8, DcmDspDataInfoRef=DataInfo_VCU_control_main_relay_Mainrelay2
          Read_ECU_manufacturing_date_ECU_Manufacturing_Date_Day: DcmDspDataType=UINT8_N, DcmDspDataInfoRef=DataInfo_Read_ECU_manufacturing_date_ECU_Manufacturing_Date_Day
          ECU_application_software_ASW_part_number_No_functional_content_change: DcmDspDataType=UINT8, DcmDspDataInfoRef=DataInfo_ECU_application_software_ASW_part_number_No_functional_content_change
        DidInfo_Bootloader_version_number (DcmDspDidInfo)
          DcmDspDidAccess
            DcmDspDidRead: DcmDspDidReadSessionRef=DcmDspSession/Default, DcmDspDidReadSessionRef=DcmDspSession/Extended, DcmDspDidReadSessionRef=Coding_Session
        DidInfo_VCU_control_main_relay (DcmDspDidInfo)
          DcmDspDidAccess
            DcmDspDidRead: DcmDspDidReadSessionRef=DcmDspSession/Default, DcmDspDidReadSessionRef=DcmDspSession/Extended, DcmDspDidReadSessionRef=Coding_Session
        DataInfo_DevelopmentData_CanDriverVersion (DcmDspDataInfo): DcmDspDataFixedLength=true
        DataInfo_Coding_for_CDS_fingerprint_codingDate_byte_2_MM (DcmDspDataInfo): DcmDspDataFixedLength=true
        Read_Level3_OEM_Key_written_status_OEM_Key_Write_state (DcmDspData):
          DcmDspDataSize = 8
          DcmDspDataType = UINT8
          DcmDspDataUsePort = USE_DATA_ASYNCH_CLIENT_SERVER
          DcmDspDataInfoRef = DataInfo_Read_Level3_OEM_Key_written_status_OEM_Key_Write_state
        DidInfo_SerialNumber (DcmDspDidInfo)
          DcmDspDidAccess
            DcmDspDidRead: DcmDspDidReadSessionRef=DcmDspSession/Default, DcmDspDidReadSessionRef=DcmDspSession/Extended, DcmDspDidReadSessionRef=Coding_Session
        Battery_Voltage (DcmDspDid): DcmDspDidIdentifier=61857, DcmDspDidUsed=true, DcmDspDidUsePort=USE_DATA_ELEMENT_SPECIFIC_INTERFACES, DcmDspDidInfoRef=DidInfo_Battery_Voltage
          Battery_Voltage (DcmDspDidSignal): DcmDspDidDataPos=0, DcmDspDidDataRef=Battery_Voltage_Battery_Voltage
        DataInfo_SOC_SOC (DcmDspDataInfo): DcmDspDataFixedLength=true
        DataInfo_Gear_Gear (DcmDspDataInfo): DcmDspDataFixedLength=true
        DidInfo_DevelopmentData (DcmDspDidInfo)
          DcmDspDidAccess
            DcmDspDidRead: DcmDspDidReadSessionRef=DcmDspSession/Default, DcmDspDidReadSessionRef=DcmDspSession/Extended, DcmDspDidReadSessionRef=Coding_Session
        VCU_HVStatus_VCU_HVStatus (DcmDspData): DcmDspDataSize=8, DcmDspDataType=UINT8, DcmDspDataUsePort=USE_DATA_ASYNCH_CLIENT_SERVER, DcmDspDataInfoRef=DataInfo_VCU_HVStatus_VCU_HVStatus
        AC_charging_parameter_VCU_OBC_ChargeCurrentCommand (DcmDspData):
          DcmDspDataSize = 16
          DcmDspDataType = UINT16
          DcmDspDataUsePort = USE_DATA_ASYNCH_CLIENT_SERVER
          DcmDspDataInfoRef = DataInfo_AC_charging_parameter_VCU_OBC_ChargeCurrentCommand
        Read_ECU_manufacturing_date (DcmDspDid):
          DcmDspDidIdentifier = 61835
          DcmDspDidUsed = true
          DcmDspDidUsePort = USE_DATA_ELEMENT_SPECIFIC_INTERFACES
          DcmDspDidInfoRef = DidInfo_Read_ECU_manufacturing_date
          3 x DcmDspDidSignal:
            ECU_Manufacturing_Date_Day: DcmDspDidDataPos=16, DcmDspDidDataRef=Read_ECU_manufacturing_date_ECU_Manufacturing_Date_Day
            ECU_Manufacturing_Date_Month: DcmDspDidDataPos=8, DcmDspDidDataRef=Read_ECU_manufacturing_date_ECU_Manufacturing_Date_Month
            ECU_Manufacturing_Date_Year: DcmDspDidDataPos=0, DcmDspDidDataRef=Read_ECU_manufacturing_date_ECU_Manufacturing_Date_Year
        SerialNumber_ECU_index_number (DcmDspData):
          DcmDspDataSize = 48
          DcmDspDataType = UINT8_N
          DcmDspDataUsePort = USE_DATA_ASYNCH_CLIENT_SERVER
          DcmDspDataInfoRef = DataInfo_SerialNumber_ECU_index_number
        Write_Level3_OEM_Key_OEM_Key_Value (DcmDspData):
          DcmDspDataSize = 128
          DcmDspDataType = UINT8_N
          DcmDspDataUsePort = USE_DATA_ASYNCH_CLIENT_SERVER
          DcmDspDataInfoRef = DataInfo_Write_Level3_OEM_Key_OEM_Key_Value
        DataInfo_VCU_Torque_parameter_VCU_MCUDesiredTorque (DcmDspDataInfo): DcmDspDataFixedLength=true
        DataInfo_VCU_Torque_parameter_VCU_RegenTorqueCap (DcmDspDataInfo): DcmDspDataFixedLength=true
        Gear_Gear (DcmDspData): DcmDspDataSize=8, DcmDspDataType=UINT8, DcmDspDataUsePort=USE_DATA_ASYNCH_CLIENT_SERVER, DcmDspDataInfoRef=DataInfo_Gear_Gear
        Read_Write_coding_data_string_CDS_CDS_CRC (DcmDspData):
          DcmDspDataSize = 8
          DcmDspDataType = UINT8
          DcmDspDataUsePort = USE_DATA_ASYNCH_CLIENT_SERVER
          DcmDspDataInfoRef = DataInfo_Read_Write_coding_data_string_CDS_CDS_CRC
        DataInfo_VCU_HV_InterLock_PWM_pfrequency_VCU_HVIL (DcmDspDataInfo): DcmDspDataFixedLength=true
        DidInfo_Read_ECU_manufacturing_date (DcmDspDidInfo)
          DcmDspDidAccess
            DcmDspDidRead: DcmDspDidReadSessionRef=DcmDspSession/Default, DcmDspDidReadSessionRef=DcmDspSession/Extended, DcmDspDidReadSessionRef=Coding_Session
        Supplier_ECU_hardware_part_number_Changes_in_electronic_components_level (DcmDspData):
          DcmDspDataSize = 8
          DcmDspDataType = UINT8
          DcmDspDataUsePort = USE_DATA_ASYNCH_CLIENT_SERVER
          DcmDspDataInfoRef = DataInfo_Supplier_ECU_hardware_part_number_Changes_in_electronic_components_level
        RoutineInfo_CheckCodingState (DcmDspRoutineInfo)
          DcmDspRoutineAuthorization: DcmDspRoutineSessionRef=Coding_Session, DcmDspRoutineSecurityLevelRef=Unlocked_Level_3
          DcmDspStartRoutineOut
            Out_routineResult (DcmDspStartRoutineOutSignal): DcmDspRoutineSignalLength=8, DcmDspRoutineSignalType=UINT8, DcmDspRoutineSignalPos=0
        DidInfo_SOC (DcmDspDidInfo)
          DcmDspDidAccess
            DcmDspDidRead: DcmDspDidReadSessionRef=DcmDspSession/Default, DcmDspDidReadSessionRef=DcmDspSession/Extended, DcmDspDidReadSessionRef=Coding_Session
        DidInfo_Read_Write_coding_data_string_CDS (DcmDspDidInfo)
          DcmDspDidAccess
            DcmDspDidWrite: DcmDspDidWriteSessionRef=Coding_Session, DcmDspDidWriteSecurityLevelRef=Unlocked_Level_3
            DcmDspDidRead: DcmDspDidReadSessionRef=DcmDspSession/Default, DcmDspDidReadSessionRef=DcmDspSession/Extended, DcmDspDidReadSessionRef=Coding_Session
        DataInfo_VCU_AccPealparameter_Accelerator_pedal_sensor_1_voltage (DcmDspDataInfo): DcmDspDataFixedLength=true
        DidInfo_Read_Level2_OEM_Key_written_status (DcmDspDidInfo)
          DcmDspDidAccess
            DcmDspDidRead: DcmDspDidReadSessionRef=DcmDspSession/Default, DcmDspDidReadSessionRef=DcmDspSession/Extended, DcmDspDidReadSessionRef=Coding_Session
        VCU_PowerMaxAllowed_parameter1_VCU_A2LPowerMaxAllowed (DcmDspData):
          DcmDspDataSize = 16
          DcmDspDataType = UINT16
          DcmDspDataUsePort = USE_DATA_ASYNCH_CLIENT_SERVER
          DcmDspDataInfoRef = DataInfo_VCU_PowerMaxAllowed_parameter1_VCU_A2LPowerMaxAllowed
        Read_Write_coding_data_string_CDS (DcmDspDid):
          DcmDspDidIdentifier = 61704
          DcmDspDidUsed = true
          DcmDspDidUsePort = USE_DATA_ELEMENT_SPECIFIC_INTERFACES
          DcmDspDidInfoRef = DidInfo_Read_Write_coding_data_string_CDS
          14 x DcmDspDidSignal:
            CDS_Short_VIN_High_Byte_7: DcmDspDidDataPos=64, DcmDspDidDataRef=Read_Write_coding_data_string_CDS_CDS_Short_VIN_High_Byte_7
            CDS_CRC: DcmDspDidDataPos=104, DcmDspDidDataRef=Read_Write_coding_data_string_CDS_CDS_CRC
            CDS_Format_Byte_High_Byte_0: DcmDspDidDataPos=72, DcmDspDidDataRef=Read_Write_coding_data_string_CDS_CDS_Format_Byte_High_Byte_0
            CDS_Format_Byte_High_Byte_1: DcmDspDidDataPos=80, DcmDspDidDataRef=Read_Write_coding_data_string_CDS_CDS_Format_Byte_High_Byte_1
            Version_Byte_0: DcmDspDidDataPos=0, DcmDspDidDataRef=Read_Write_coding_data_string_CDS_Version_Byte_0
            Version_Byte_1: DcmDspDidDataPos=8, DcmDspDidDataRef=Read_Write_coding_data_string_CDS_Version_Byte_1
            CDS_Short_VIN_High_Byte_4: DcmDspDidDataPos=48, DcmDspDidDataRef=Read_Write_coding_data_string_CDS_CDS_Short_VIN_High_Byte_4
            CDS_Short_VIN_High_Byte_3: DcmDspDidDataPos=40, DcmDspDidDataRef=Read_Write_coding_data_string_CDS_CDS_Short_VIN_High_Byte_3
            CDS_Short_VIN_High_Byte_5: DcmDspDidDataPos=56, DcmDspDidDataRef=Read_Write_coding_data_string_CDS_CDS_Short_VIN_High_Byte_5
            Configuration1: DcmDspDidDataPos=88, DcmDspDidDataRef=Read_Write_coding_data_string_CDS_Configuration1
            CDS_Short_VIN_High_Byte_0: DcmDspDidDataPos=16, DcmDspDidDataRef=Read_Write_coding_data_string_CDS_CDS_Short_VIN_High_Byte_0
            Configuration2: DcmDspDidDataPos=96, DcmDspDidDataRef=Read_Write_coding_data_string_CDS_Configuration2
            CDS_Short_VIN_High_Byte_2: DcmDspDidDataPos=32, DcmDspDidDataRef=Read_Write_coding_data_string_CDS_CDS_Short_VIN_High_Byte_2
            CDS_Short_VIN_High_Byte_1: DcmDspDidDataPos=24, DcmDspDidDataRef=Read_Write_coding_data_string_CDS_CDS_Short_VIN_High_Byte_1
        DidInfo_Coding_for_CDS_fingerprint (DcmDspDidInfo)
          DcmDspDidAccess
            DcmDspDidWrite: DcmDspDidWriteSessionRef=Coding_Session, DcmDspDidWriteSecurityLevelRef=Unlocked_Level_3
            DcmDspDidRead: DcmDspDidReadSessionRef=DcmDspSession/Default, DcmDspDidReadSessionRef=DcmDspSession/Extended, DcmDspDidReadSessionRef=Coding_Session
        DevelopmentData_NmVersion (DcmDspData): DcmDspDataSize=8, DcmDspDataType=UINT8_N, DcmDspDataUsePort=USE_DATA_ASYNCH_CLIENT_SERVER, DcmDspDataInfoRef=DataInfo_DevelopmentData_NmVersion
        VCU_AccPealparameter_VCU_AccelerationPedal (DcmDspData):
          DcmDspDataSize = 8
          DcmDspDataType = UINT8
          DcmDspDataUsePort = USE_DATA_ASYNCH_CLIENT_SERVER
          DcmDspDataInfoRef = DataInfo_VCU_AccPealparameter_VCU_AccelerationPedal
        HV_Status_and_Charging_Status (DcmDspDid):
          DcmDspDidIdentifier = 364
          DcmDspDidUsed = true
          DcmDspDidUsePort = USE_DATA_ELEMENT_SPECIFIC_INTERFACES
          DcmDspDidInfoRef = DidInfo_HV_Status_and_Charging_Status
          HV_status_and_charging_status (DcmDspDidSignal): DcmDspDidDataPos=0, DcmDspDidDataRef=HV_Status_and_Charging_Status_HV_status_and_charging_status
        Date_And_Time_Date_And_Time_Year (DcmDspData):
          DcmDspDataSize = 8
          DcmDspDataType = UINT8
          DcmDspDataUsePort = USE_DATA_ASYNCH_CLIENT_SERVER
          DcmDspDataInfoRef = DataInfo_Date_And_Time_Date_And_Time_Year
        3 x DcmDspDataInfo, all with DcmDspDataFixedLength=true:
          DataInfo_EcuIdentification_Detail_Code
          DataInfo_Read_ECU_Part_Number_Execution_Package
          DataInfo_Read_ECU_manufacturing_date_ECU_Manufacturing_Date_Day
        SOC (DcmDspDid): DcmDspDidIdentifier=61862, DcmDspDidUsed=true, DcmDspDidUsePort=USE_DATA_ELEMENT_SPECIFIC_INTERFACES, DcmDspDidInfoRef=DidInfo_SOC
          SOC (DcmDspDidSignal): DcmDspDidDataPos=0, DcmDspDidDataRef=SOC_SOC
        DataInfo_Read_Write_complete_VIN_Vehicle_Description_Section (DcmDspDataInfo): DcmDspDataFixedLength=true
        EcuIdentification_Specific_Vehicle_Code_WMI (DcmDspData):
          DcmDspDataSize = 48
          DcmDspDataType = UINT8_N
          DcmDspDataUsePort = USE_DATA_ASYNCH_CLIENT_SERVER
          DcmDspDataInfoRef = DataInfo_EcuIdentification_Specific_Vehicle_Code_WMI
        Coding_for_CDS_fingerprint_codingDate_byte_1_YY (DcmDspData):
          DcmDspDataSize = 8
          DcmDspDataType = UINT8_N
          DcmDspDataUsePort = USE_DATA_ASYNCH_CLIENT_SERVER
          DcmDspDataInfoRef = DataInfo_Coding_for_CDS_fingerprint_codingDate_byte_1_YY
        DataInfo_SerialNumber_Supplier_name (DcmDspDataInfo): DcmDspDataFixedLength=true
        3 x DcmDspDid, all with DcmDspDidUsed=true, DcmDspDidUsePort=USE_DATA_ELEMENT_SPECIFIC_INTERFACES:
          Supplier_ECU_hardware_part_number: DcmDspDidIdentifier=61842, DcmDspDidInfoRef=DidInfo_Supplier_ECU_hardware_part_number
            Major_release (DcmDspDidSignal): DcmDspDidDataPos=0, DcmDspDidDataRef=Supplier_ECU_hardware_part_number_Major_release
            Changes_in_electronic_components_level (DcmDspDidSignal): DcmDspDidDataPos=8, DcmDspDidDataRef=Supplier_ECU_hardware_part_number_Changes_in_electronic_components_level
          ECU_application_software_ASW_part_number: DcmDspDidIdentifier=61700, DcmDspDidInfoRef=DidInfo_ECU_application_software_ASW_part_number
            3 x DcmDspDidSignal:
              Major_release: DcmDspDidDataPos=0, DcmDspDidDataRef=ECU_application_software_ASW_part_number_Major_release
              Minor_release: DcmDspDidDataPos=8, DcmDspDidDataRef=ECU_application_software_ASW_part_number_Minor_release
              No_functional_content_change: DcmDspDidDataPos=16, DcmDspDidDataRef=ECU_application_software_ASW_part_number_No_functional_content_change
          Write_Level4_OEM_Key: DcmDspDidIdentifier=61462, DcmDspDidInfoRef=DidInfo_Write_Level4_OEM_Key
            OEM_Key_Value (DcmDspDidSignal): DcmDspDidDataPos=0, DcmDspDidDataRef=Write_Level4_OEM_Key_OEM_Key_Value
        3 x DcmDspDataInfo, all with DcmDspDataFixedLength=true:
          DataInfo_Read_Write_coding_data_string_CDS_CDS_Short_VIN_High_Byte_4
          DataInfo_Read_Write_coding_data_string_CDS_CDS_Short_VIN_High_Byte_5
          DataInfo_Read_Write_coding_data_string_CDS_CDS_Short_VIN_High_Byte_7
        Last_service_date (DcmDspDid): DcmDspDidIdentifier=61711, DcmDspDidUsed=true, DcmDspDidUsePort=USE_DATA_ELEMENT_SPECIFIC_INTERFACES, DcmDspDidInfoRef=DidInfo_Last_service_date
          3 x DcmDspDidSignal:
            Day: DcmDspDidDataPos=16, DcmDspDidDataRef=Last_service_date_Day
            Month: DcmDspDidDataPos=8, DcmDspDidDataRef=Last_service_date_Month
            Year: DcmDspDidDataPos=0, DcmDspDidDataRef=Last_service_date_Year
        4 x DcmDspDataInfo, all with DcmDspDataFixedLength=true:
          DataInfo_Read_Write_coding_data_string_CDS_CDS_Short_VIN_High_Byte_{0..3}
        VCU_AccPealparameter (DcmDspDid): DcmDspDidIdentifier=7425, DcmDspDidUsed=true, DcmDspDidUsePort=USE_DATA_ELEMENT_SPECIFIC_INTERFACES, DcmDspDidInfoRef=DidInfo_VCU_AccPealparameter
          4 x DcmDspDidSignal:
            VCU_AccelerationPedal: DcmDspDidDataPos=32, DcmDspDidDataRef=VCU_AccPealparameter_VCU_AccelerationPedal
            Accelerator_pedal_sensor_2_voltage: DcmDspDidDataPos=24, DcmDspDidDataRef=VCU_AccPealparameter_Accelerator_pedal_sensor_2_voltage
            Accelerator_pedal_sensor_1_voltage: DcmDspDidDataPos=16, DcmDspDidDataRef=VCU_AccPealparameter_Accelerator_pedal_sensor_1_voltage
            VCU_VehicleSpeed: DcmDspDidDataPos=0, DcmDspDidDataRef=VCU_AccPealparameter_VCU_VehicleSpeed
        DataInfo_SerialNumber_ECU_Name (DcmDspDataInfo): DcmDspDataFixedLength=true
        DidInfo_ECU_application_software_ASW_part_number (DcmDspDidInfo)
          DcmDspDidAccess
            DcmDspDidRead: DcmDspDidReadSessionRef=DcmDspSession/Default, DcmDspDidReadSessionRef=DcmDspSession/Extended, DcmDspDidReadSessionRef=Coding_Session
        DataInfo_EcuIdentification_Subgroup (DcmDspDataInfo): DcmDspDataFixedLength=true
        DidInfo_Write_Level4_OEM_Key (DcmDspDidInfo)
          DcmDspDidAccess
            DcmDspDidWrite: DcmDspDidWriteSessionRef=DcmDspSession/Programming, DcmDspDidWriteSecurityLevelRef=Unlocked_Level_4
        Date_And_Time_Date_And_Time_Hour (DcmDspData):
          DcmDspDataSize = 8
          DcmDspDataType = UINT8
          DcmDspDataUsePort = USE_DATA_ASYNCH_CLIENT_SERVER
          DcmDspDataInfoRef = DataInfo_Date_And_Time_Date_And_Time_Hour
        DidInfo_Read_Level4_OEM_Key_written_status (DcmDspDidInfo)
          DcmDspDidAccess
            DcmDspDidRead: DcmDspDidReadSessionRef=DcmDspSession/Default, DcmDspDidReadSessionRef=DcmDspSession/Extended, DcmDspDidReadSessionRef=Coding_Session
        Coding_for_CDS_fingerprint_codingDate_byte_3_DD (DcmDspData):
          DcmDspDataSize = 8
          DcmDspDataType = UINT8_N
          DcmDspDataUsePort = USE_DATA_ASYNCH_CLIENT_SERVER
          DcmDspDataInfoRef = DataInfo_Coding_for_CDS_fingerprint_codingDate_byte_3_DD
        DidInfo_VCU_HVStatus (DcmDspDidInfo)
          DcmDspDidAccess
            DcmDspDidRead: DcmDspDidReadSessionRef=DcmDspSession/Default, DcmDspDidReadSessionRef=DcmDspSession/Extended, DcmDspDidReadSessionRef=Coding_Session
        Date_And_Time (DcmDspDid): DcmDspDidIdentifier=61860, DcmDspDidUsed=true, DcmDspDidUsePort=USE_DATA_ELEMENT_SPECIFIC_INTERFACES, DcmDspDidInfoRef=DidInfo_Date_And_Time
          6 x DcmDspDidSignal:
            Date_And_Time_Minute: DcmDspDidDataPos=8, DcmDspDidDataRef=Date_And_Time_Date_And_Time_Minute
            Date_And_Time_Hour: DcmDspDidDataPos=16, DcmDspDidDataRef=Date_And_Time_Date_And_Time_Hour
            Date_And_Time_Year: DcmDspDidDataPos=40, DcmDspDidDataRef=Date_And_Time_Date_And_Time_Year
            Date_And_Time_Second: DcmDspDidDataPos=0, DcmDspDidDataRef=Date_And_Time_Date_And_Time_Second
            Date_And_Time_Month: DcmDspDidDataPos=32, DcmDspDidDataRef=Date_And_Time_Date_And_Time_Month
            Date_And_Time_Day: DcmDspDidDataPos=24, DcmDspDidDataRef=Date_And_Time_Date_And_Time_Day
        VCU_Torque_parameter (DcmDspDid): DcmDspDidIdentifier=7426, DcmDspDidUsed=true, DcmDspDidUsePort=USE_DATA_ELEMENT_SPECIFIC_INTERFACES, DcmDspDidInfoRef=DidInfo_VCU_Torque_parameter
          4 x DcmDspDidSignal:
            VCU_RegenTorqueCap: DcmDspDidDataPos=48, DcmDspDidDataRef=VCU_Torque_parameter_VCU_RegenTorqueCap
            Torque_MaxAllowed: DcmDspDidDataPos=16, DcmDspDidDataRef=VCU_Torque_parameter_Torque_MaxAllowed
            VCU_MCUDesiredTorque: DcmDspDidDataPos=0, DcmDspDidDataRef=VCU_Torque_parameter_VCU_MCUDesiredTorque
            Torque_MinAllowed: DcmDspDidDataPos=32, DcmDspDidDataRef=VCU_Torque_parameter_Torque_MinAllowed
        3 x DcmDspData, all with DcmDspDataUsePort=USE_DATA_ASYNCH_CLIENT_SERVER:
          Read_ECU_Part_Number_Group: DcmDspDataSize=16, DcmDspDataType=UINT8_N, DcmDspDataInfoRef=DataInfo_Read_ECU_Part_Number_Group
          ECU_application_software_ASW_part_number_Major_release: DcmDspDataSize=8, DcmDspDataType=UINT8, DcmDspDataInfoRef=DataInfo_ECU_application_software_ASW_part_number_Major_release
          Ignition_Switch_Signal_Ignition_Switch_Signal: DcmDspDataSize=8, DcmDspDataType=UINT8, DcmDspDataInfoRef=DataInfo_Ignition_Switch_Signal_Ignition_Switch_Signal
        DataInfo_Read_Write_complete_VIN_World_Manufacturers_Identification (DcmDspDataInfo): DcmDspDataFixedLength=true
        Bootloader_version_number_Minor_release (DcmDspData):
          DcmDspDataSize = 8
          DcmDspDataType = UINT8
          DcmDspDataUsePort = USE_DATA_ASYNCH_CLIENT_SERVER
          DcmDspDataInfoRef = DataInfo_Bootloader_version_number_Minor_release
        RoutineInfo_CheckProgrammingDependencies (DcmDspRoutineInfo)
          DcmDspRoutineAuthorization: DcmDspRoutineSessionRef=DcmDspSession/Programming, DcmDspRoutineSecurityLevelRef=Unlocked_Level_4
          DcmDspStartRoutineOut
            Out_routineResult (DcmDspStartRoutineOutSignal): DcmDspRoutineSignalLength=8, DcmDspRoutineSignalType=UINT8, DcmDspRoutineSignalPos=0
        Read_Write_complete_VIN_Vehicle_Identification_Section (DcmDspData):
          DcmDspDataSize = 72
          DcmDspDataType = UINT8_N
          DcmDspDataUsePort = USE_DATA_ASYNCH_CLIENT_SERVER
          DcmDspDataInfoRef = DataInfo_Read_Write_complete_VIN_Vehicle_Identification_Section
        Read_Level3_OEM_Key_written_status (DcmDspDid):
          DcmDspDidIdentifier = 61461
          DcmDspDidUsed = true
          DcmDspDidUsePort = USE_DATA_ELEMENT_SPECIFIC_INTERFACES
          DcmDspDidInfoRef = DidInfo_Read_Level3_OEM_Key_written_status
          OEM_Key_Write_state (DcmDspDidSignal): DcmDspDidDataPos=0, DcmDspDidDataRef=Read_Level3_OEM_Key_written_status_OEM_Key_Write_state
        3 x DcmDspData, all with DcmDspDataUsePort=USE_DATA_ASYNCH_CLIENT_SERVER:
          Date_And_Time_Date_And_Time_Month: DcmDspDataSize=8, DcmDspDataType=UINT8, DcmDspDataInfoRef=DataInfo_Date_And_Time_Date_And_Time_Month
          Read_ECU_Part_Number_Subgroup: DcmDspDataSize=16, DcmDspDataType=UINT8_N, DcmDspDataInfoRef=DataInfo_Read_ECU_Part_Number_Subgroup
          Bootloader_version_number_No_functional_content_change: DcmDspDataSize=8, DcmDspDataType=UINT8, DcmDspDataInfoRef=DataInfo_Bootloader_version_number_No_functional_content_change
        DataInfo_VCU_PowerMaxAllowed_parameter1_MCUPowerLimit (DcmDspDataInfo): DcmDspDataFixedLength=true
        3 x DcmDspData, all with DcmDspDataUsePort=USE_DATA_ASYNCH_CLIENT_SERVER:
          AC_charging_parameter_POD_OBC_OutputDCChargeCurrent: DcmDspDataSize=16, DcmDspDataType=UINT16, DcmDspDataInfoRef=DataInfo_AC_charging_parameter_POD_OBC_OutputDCChargeCurrent
          Write_Level4_OEM_Key_OEM_Key_Value: DcmDspDataSize=128, DcmDspDataType=UINT8_N, DcmDspDataInfoRef=DataInfo_Write_Level4_OEM_Key_OEM_Key_Value
          Vehicle_speed_Vehicle_speed: DcmDspDataSize=16, DcmDspDataType=UINT16, DcmDspDataInfoRef=DataInfo_Vehicle_speed_Vehicle_speed
        Bootloader_version_number (DcmDspDid):
          DcmDspDidIdentifier = 61697
          DcmDspDidUsed = true
          DcmDspDidUsePort = USE_DATA_ELEMENT_SPECIFIC_INTERFACES
          DcmDspDidInfoRef = DidInfo_Bootloader_version_number
          3 x DcmDspDidSignal:
            Major_release: DcmDspDidDataPos=0, DcmDspDidDataRef=Bootloader_version_number_Major_release
            Minor_release: DcmDspDidDataPos=8, DcmDspDidDataRef=Bootloader_version_number_Minor_release
            No_functional_content_change: DcmDspDidDataPos=16, DcmDspDidDataRef=Bootloader_version_number_No_functional_content_change
        DidInfo_Vehicle_speed (DcmDspDidInfo)
          DcmDspDidAccess
            DcmDspDidRead: DcmDspDidReadSessionRef=DcmDspSession/Default, DcmDspDidReadSessionRef=DcmDspSession/Extended, DcmDspDidReadSessionRef=Coding_Session
        DataInfo_VCU_Torque_parameter_Torque_MaxAllowed (DcmDspDataInfo): DcmDspDataFixedLength=true
        Write_Level1_OEM_Key (DcmDspDid):
          DcmDspDidIdentifier = 61456
          DcmDspDidUsed = true
          DcmDspDidUsePort = USE_DATA_ELEMENT_SPECIFIC_INTERFACES
          DcmDspDidInfoRef = DidInfo_Write_Level1_OEM_Key
          OEM_Key_Value (DcmDspDidSignal): DcmDspDidDataPos=0, DcmDspDidDataRef=Write_Level1_OEM_Key_OEM_Key_Value
        DataInfo_Read_ECU_Part_Number_Subgroup (DcmDspDataInfo): DcmDspDataFixedLength=true
        VCU_PowerMaxAllowed_parameter1_VCU_DCDCPowerLimit (DcmDspData):
          DcmDspDataSize = 16
          DcmDspDataType = UINT16
          DcmDspDataUsePort = USE_DATA_ASYNCH_CLIENT_SERVER
          DcmDspDataInfoRef = DataInfo_VCU_PowerMaxAllowed_parameter1_VCU_DCDCPowerLimit
        Read_ECU_Part_Number_Specific_Vehicle_Code_WMI (DcmDspData):
          DcmDspDataSize = 48
          DcmDspDataType = UINT8_N
          DcmDspDataUsePort = USE_DATA_ASYNCH_CLIENT_SERVER
          DcmDspDataInfoRef = DataInfo_Read_ECU_Part_Number_Specific_Vehicle_Code_WMI
        DataInfo_VCU_PowerMaxAllowed_parameter2_MCUPowerLimit (DcmDspDataInfo): DcmDspDataFixedLength=true
        Total_Odometer_Total_Odometer (DcmDspData):
          DcmDspDataSize = 24
          DcmDspDataType = UINT8_N
          DcmDspDataUsePort = USE_DATA_ASYNCH_CLIENT_SERVER
          DcmDspDataInfoRef = DataInfo_Total_Odometer_Total_Odometer
        Read_Write_complete_VIN_Vehicle_Description_Section (DcmDspData):
          DcmDspDataSize = 40
          DcmDspDataType = UINT8_N
          DcmDspDataUsePort = USE_DATA_ASYNCH_CLIENT_SERVER
          DcmDspDataInfoRef = DataInfo_Read_Write_complete_VIN_Vehicle_Description_Section
        Read_Write_complete_VIN (DcmDspDid):
          DcmDspDidIdentifier = 61840
          DcmDspDidUsed = true
          DcmDspDidUsePort = USE_DATA_ELEMENT_SPECIFIC_INTERFACES
          DcmDspDidInfoRef = DidInfo_Read_Write_complete_VIN
          3 x DcmDspDidSignal:
            World_Manufacturers_Identification: DcmDspDidDataPos=0, DcmDspDidDataRef=Read_Write_complete_VIN_World_Manufacturers_Identification
            Vehicle_Description_Section: DcmDspDidDataPos=24, DcmDspDidDataRef=Read_Write_complete_VIN_Vehicle_Description_Section
            Vehicle_Identification_Section: DcmDspDidDataPos=64, DcmDspDidDataRef=Read_Write_complete_VIN_Vehicle_Identification_Section
        Date_And_Time_Date_And_Time_Minute (DcmDspData):
          DcmDspDataSize = 8
          DcmDspDataType = UINT8
          DcmDspDataUsePort = USE_DATA_ASYNCH_CLIENT_SERVER
          DcmDspDataInfoRef = DataInfo_Date_And_Time_Date_And_Time_Minute
        DataInfo_VCU_PowerMaxAllowed_parameter1_VCU_A2LPowerMaxAllowed (DcmDspDataInfo): DcmDspDataFixedLength=true
        Last_service_date_Day (DcmDspData): DcmDspDataSize=8, DcmDspDataType=UINT8_N, DcmDspDataUsePort=USE_DATA_ASYNCH_CLIENT_SERVER, DcmDspDataInfoRef=DataInfo_Last_service_date_Day
        DataInfo_Supplier_ECU_hardware_part_number_Major_release (DcmDspDataInfo): DcmDspDataFixedLength=true
        Turn_Off_HV_Turn_Off_Charging (DcmDspRoutine):
          DcmDspRequestResultsRoutineSupported = false
          DcmDspStopRoutineSupported = true
          DcmDspRoutineIdentifier = 61440
          DcmDspRoutineFixedLength = false
          DcmDspRoutineUsePort = true
          DcmDspRoutineUsed = true
          DcmDspRoutineInfoRef = RoutineInfo_Turn_Off_HV_Turn_Off_Charging
        DataInfo_Write_Level2_OEM_Key_OEM_Key_Value (DcmDspDataInfo): DcmDspDataFixedLength=true
        VCU_HV_InterLock_PWM_pfrequency_VCU_HVIL (DcmDspData):
          DcmDspDataSize = 8
          DcmDspDataType = UINT8
          DcmDspDataUsePort = USE_DATA_ASYNCH_CLIENT_SERVER
          DcmDspDataInfoRef = DataInfo_VCU_HV_InterLock_PWM_pfrequency_VCU_HVIL
        DataInfo_S2_status_New_Bit_Field (DcmDspDataInfo): DcmDspDataFixedLength=true
        Read_Level1_OEM_Key_written_status_OEM_Key_Write_state (DcmDspData):
          DcmDspDataSize = 8
          DcmDspDataType = UINT8
          DcmDspDataUsePort = USE_DATA_ASYNCH_CLIENT_SERVER
          DcmDspDataInfoRef = DataInfo_Read_Level1_OEM_Key_written_status_OEM_Key_Write_state
        DevelopmentData_OperatingSystemVersion (DcmDspData):
          DcmDspDataSize = 16
          DcmDspDataType = UINT8_N
          DcmDspDataUsePort = USE_DATA_ASYNCH_CLIENT_SERVER
          DcmDspDataInfoRef = DataInfo_DevelopmentData_OperatingSystemVersion
        DataInfo_Total_Odometer_Total_Odometer (DcmDspDataInfo): DcmDspDataFixedLength=true
        DevelopmentData_CanDriverVersion (DcmDspData):
          DcmDspDataSize = 24
          DcmDspDataType = UINT8_N
          DcmDspDataUsePort = USE_DATA_ASYNCH_CLIENT_SERVER
          DcmDspDataInfoRef = DataInfo_DevelopmentData_CanDriverVersion
        DidInfo_Chargestatus (DcmDspDidInfo)
          DcmDspDidAccess
            DcmDspDidRead: DcmDspDidReadSessionRef=DcmDspSession/Default, DcmDspDidReadSessionRef=DcmDspSession/Extended, DcmDspDidReadSessionRef=Coding_Session
        DcmDspSession
          4 x DcmDspSessionRow, all with DcmDspSessionP2ServerMax=0.05, DcmDspSessionP2StarServerMax=5, DcmDspSessionForBoot=DCM_NO_BOOT:
            Default: DcmDspSessionLevel=1
            Coding_Session: DcmDspSessionLevel=65
            Programming: DcmDspSessionLevel=2
            Extended: DcmDspSessionLevel=3
        VCU_AccPealparameter_VCU_VehicleSpeed (DcmDspData):
          DcmDspDataSize = 16
          DcmDspDataType = UINT16
          DcmDspDataUsePort = USE_DATA_ASYNCH_CLIENT_SERVER
          DcmDspDataInfoRef = DataInfo_VCU_AccPealparameter_VCU_VehicleSpeed
        DataInfo_VCU_control_main_relay_Mainrealy1 (DcmDspDataInfo): DcmDspDataFixedLength=true
        Check_Memory (DcmDspRoutine):
          DcmDspRequestResultsRoutineSupported = false
          DcmDspStopRoutineSupported = false
          DcmDspRoutineIdentifier = 514
          DcmDspRoutineFixedLength = false
          DcmDspRoutineUsePort = true
          DcmDspRoutineUsed = true
          DcmDspRoutineInfoRef = RoutineInfo_Check_Memory
        Coding_for_CDS_fingerprint_repairShopCodeorTesterSerialNumber_byte_1_27_MSB (DcmDspData):
          DcmDspDataSize = 216
          DcmDspDataType = UINT8_N
          DcmDspDataUsePort = USE_DATA_ASYNCH_CLIENT_SERVER
          DcmDspDataInfoRef = DataInfo_Coding_for_CDS_fingerprint_repairShopCodeorTesterSerialNumber_byte_1_27_MSB
        Read_Level1_OEM_Key_written_status (DcmDspDid):
          DcmDspDidIdentifier = 61457
          DcmDspDidUsed = true
          DcmDspDidUsePort = USE_DATA_ELEMENT_SPECIFIC_INTERFACES
          DcmDspDidInfoRef = DidInfo_Read_Level1_OEM_Key_written_status
          OEM_Key_Write_state (DcmDspDidSignal): DcmDspDidDataPos=0, DcmDspDidDataRef=Read_Level1_OEM_Key_written_status_OEM_Key_Write_state
      DcmPageBufferCfg: DcmPagedBufferEnabled=true
