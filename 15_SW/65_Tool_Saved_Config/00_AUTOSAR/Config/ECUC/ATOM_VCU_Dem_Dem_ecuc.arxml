[part 2 of 2: package /ActiveEcuC]
AUTOSAR XML (schema 00048)
package /ActiveEcuC  (continued)
  module config Dem: implementation-config-variant=VARIANT-PRE-COMPILE, module-description=Dem_Impl  (continued)
    DemGeneral:
      DemAgingCycleCounterProcessing = DEM_PROCESS_AGINGCTR_INTERN
      DemDebounceCounterBasedSupport = true
      DemEnableConditionSupport = true
      DemPTOSupport = false
      DemDtcStatusAvailabilityMask = 9
      DemTypeOfFreezeFrameRecordNumeration = DEM_FF_RECNUM_CONFIGURED
      DemGeneralInterfaceSupport = false
      DemDataElementDefaultEndianness = LITTLE_ENDIAN
      DemAgingRequieresTestedCycle = false
      DemMaxNumberEventEntryMirror = 0
      DemTriggerMonitorInitBeforeClearOk = true
      DemExtendedDataCapture = DEM_TRIGGER_EVENT_MEMORY_STORAGE
      DemFreezeFrameCapture = DEM_TRIGGER_EVENT_MEMORY_STORAGE
      DemOperationCycleProcessing = DEM_PROCESS_OPCYC_STATE
      DemMaxNumberTimeSeriesSnapshots = 0
      DemAvailabilitySupport = DEM_NO_AVAILABILITY
      DemAvailabilityStorage = false
      DemBswErrorBufferSize = 0
      DemClearDTCBehavior = DEM_CLRRESP_VOLATILE
      DemClearDTCLimitation = DEM_ALL_SUPPORTED_DTCS
      DemDebounceTimeBasedSupport = false
      DemDevErrorDetect = true
      DemEventCombinationSupport = DEM_EVCOMB_DISABLED
      DemEventDisplacementStrategy = DEM_DISPLACEMENT_LEGACY_403
      DemEventMemoryEntryStorageTrigger = DEM_STORAGE_ON_TEST_FAILED
      DemMaxNumberEventEntryOBDFreezeFrame = 0
      DemMaxNumberEventEntryPermanent = 0
      DemMaxNumberEventEntryPrimary = 8
      DemMaxNumberEventEntrySecondary = 0
      DemMaxNumberPrestoredFF = 0
      DemOBDSupport = DEM_OBD_NO_OBD_SUPPORT
      DemOccurrenceCounterProcessing = DEM_PROCESS_OCCCTR_TF
      DemOperationCycleStatusStorage = false
      DemResetConfirmedBitOnOverflow = true
      DemStatusBitHandlingTestFailedSinceLastClear = DEM_STATUS_BIT_NORMAL
      DemStatusBitStorageTestFailed = true
      DemStorageConditionSupport = false
      DemSuppressionSupport = DEM_NO_SUPPRESSION
      DemTaskTime = 0.01
      DemTriggerDcmReports = false
      DemTriggerDltReports = false
      DemTriggerFiMReports = false
      DemTriggerFiMReportsExtended = false
      DemTriggerMonitorInitForEnableConditions = false
      DemTypeOfDTCSupported = DEM_DTC_TRANSLATION_ISO14229_1
      DemVersionInfoApi = false
      DemBswApiVersion = DEM_BSW_API_4_XX_XX
      DemBswApiVersionNvM = DEM_BSW_API_4_XX_XX
      DemBswApiVersionFiM = DEM_BSW_API_4_XX_XX
      DemAgingAfterHealing = DEM_AGING_WHILE_HEALING
      DemAgingBehavior = DEM_AGING_TYPE_1
      DemAgingCounterBehavior = DEM_AGING_COUNT_ALWAYS
      DemAgingCounterReporting = DEM_AGING_NORMAL_REPORTING
      DemAgingRetainEnvironmentalData = false
      DemCompiledPostbuildCrc = 1612189160
      DemCompiledPostbuildCrcMode = DEM_POSTBUILD_CRC_AUTOMATIC
      DemEventDisplacementFallbackStrategy = DEM_FALLBACK_DISCARD_NEW_EVENT
      DemGeneralDiagnosticInfoSupport = true
      DemJ1939Support = false
      DemNvSynchronizeSupport = false
      DemPendingDtcProcessing = DEM_PROCESS_PDTC_STOREDONLY
      DemResetDebounceBehavior = DEM_RESET_DEBOUNCE_ON_DISABLE_ENABLE_CONDITIONS
      DemResetTestFailedOnOperationCycleStart = false
      DemRetryStorageSupport = false
      DemSafeBswChecks = false
      DemUseMemcopyMacros = false
      DemUseRte = true
      DemUserControlledWirBehavior = DEM_ENABLED_DURING_CONTROLDTCSETTING
      DemUserDefinedCompareAndSwap = false
      DemWarningIndicatorRequestedProcessing = DEM_PROCESS_WIR_STOREDONLY
      DemUseMultiPartitionFiM = false
      DemReportSuppressedDTCsInService19x0A = false
      DemSupportAgingForAllDTCs = false
      DemLatchTestFailedBehavior = DEM_LATCH_TF_CONFIRMED_AND_THIS_CYCLE
      Being_001 (DemEnableCondition): DemEnableConditionId=9, DemEnableConditionStatus=true
      preheating (DemEnableCondition): DemEnableConditionId=141, DemEnableConditionStatus=true
      EnableConditionGroup_2261a858 (DemEnableConditionGroup):
        DemEnableConditionRef = AC
        DemEnableConditionRef = Close
        DemEnableConditionRef = Close
        DemEnableConditionRef = If
        DemEnableConditionRef = No
        DemEnableConditionRef = Note
        DemEnableConditionRef = OBC
        DemEnableConditionRef = Ohm
        DemEnableConditionRef = Ohm
        DemEnableConditionRef = Ohm
        DemEnableConditionRef = Ohm
        DemEnableConditionRef = POD_OBC_CCStatus
        DemEnableConditionRef = The
        DemEnableConditionRef = V
        DemEnableConditionRef = V
        DemEnableConditionRef = VCU
        DemEnableConditionRef = VCU_OBC_Control_of_em_lock
        DemEnableConditionRef = When
        DemEnableConditionRef = abnormal
        DemEnableConditionRef = active
        DemEnableConditionRef = active
        DemEnableConditionRef = again
        DemEnableConditionRef = all
        DemEnableConditionRef = any
        DemEnableConditionRef = are
        DemEnableConditionRef = battery
        DemEnableConditionRef = be
        DemEnableConditionRef = completed
        DemEnableConditionRef = conditions
        DemEnableConditionRef = conditions
        DemEnableConditionRef = conditions
        DemEnableConditionRef = confirmation
        DemEnableConditionRef = diagnosis
        DemEnableConditionRef = diagnosis
        DemEnableConditionRef = during
        DemEnableConditionRef = electronic
        DemEnableConditionRef = enable
        DemEnableConditionRef = fault
        DemEnableConditionRef = fault
        DemEnableConditionRef = fault
        DemEnableConditionRef = for
        DemEnableConditionRef = from
        DemEnableConditionRef = guns
        DemEnableConditionRef = is
        DemEnableConditionRef = is
        DemEnableConditionRef = is
        DemEnableConditionRef = is
        DemEnableConditionRef = lock
        DemEnableConditionRef = met
        DemEnableConditionRef = met
        DemEnableConditionRef = ms
        DemEnableConditionRef = normal
        DemEnableConditionRef = not
        DemEnableConditionRef = of
        DemEnableConditionRef = or
        DemEnableConditionRef = or
        DemEnableConditionRef = performed
        DemEnableConditionRef = process
        DemEnableConditionRef = recovers
        DemEnableConditionRef = requests
        DemEnableConditionRef = service
        DemEnableConditionRef = shall
        DemEnableConditionRef = the_001
        DemEnableConditionRef = the_001
        DemEnableConditionRef = the_001
        DemEnableConditionRef = the_001
        DemEnableConditionRef = the_001
        DemEnableConditionRef = the_001
        DemEnableConditionRef = the_001
        DemEnableConditionRef = to
        DemEnableConditionRef = to
        DemEnableConditionRef = trigger
        DemEnableConditionRef = voltage
        DemEnableConditionRef = voltage
        DemEnableConditionRef = x{1..5}
      EnableConditionGroup_5ad0cd2d (DemEnableConditionGroup):
        DemEnableConditionRef = All_001
        DemEnableConditionRef = Busoff
        DemEnableConditionRef = Conditions_001
        DemEnableConditionRef = Conditions_001
        DemEnableConditionRef = Confirmed
        DemEnableConditionRef = Confirmed
        DemEnableConditionRef = DTC
        DemEnableConditionRef = DTC
        DemEnableConditionRef = Enable_001
        DemEnableConditionRef = Enable_001
        DemEnableConditionRef = If
        DemEnableConditionRef = In_001
        DemEnableConditionRef = Lan
        DemEnableConditionRef = No
        DemEnableConditionRef = No
        DemEnableConditionRef = Note
        DemEnableConditionRef = PNC0
        DemEnableConditionRef = PNC15
        DemEnableConditionRef = PNC25
        DemEnableConditionRef = Reset_001
        DemEnableConditionRef = T_Delay
        DemEnableConditionRef = T_Delay
        DemEnableConditionRef = T_Delay
        DemEnableConditionRef = The
        DemEnableConditionRef = The
        DemEnableConditionRef = V
        DemEnableConditionRef = V
        DemEnableConditionRef = abnormal
        DemEnableConditionRef = active
        DemEnableConditionRef = again
        DemEnableConditionRef = again
        DemEnableConditionRef = and
        DemEnableConditionRef = and
        DemEnableConditionRef = and
        DemEnableConditionRef = any
        DemEnableConditionRef = any
        DemEnableConditionRef = are
        DemEnableConditionRef = battery
        DemEnableConditionRef = condition
        DemEnableConditionRef = conditions
        DemEnableConditionRef = criteria
        DemEnableConditionRef = criteria
        DemEnableConditionRef = do
        DemEnableConditionRef = does
        DemEnableConditionRef = fault
        DemEnableConditionRef = following
        DemEnableConditionRef = for
        DemEnableConditionRef = from
        DemEnableConditionRef = if_001
        DemEnableConditionRef = in
        DemEnableConditionRef = in
        DemEnableConditionRef = is
        DemEnableConditionRef = is
        DemEnableConditionRef = last
        DemEnableConditionRef = meet
        DemEnableConditionRef = meet
        DemEnableConditionRef = met
        DemEnableConditionRef = ms
        DemEnableConditionRef = normal
        DemEnableConditionRef = not
        DemEnableConditionRef = not
        DemEnableConditionRef = of
        DemEnableConditionRef = of
        DemEnableConditionRef = or
        DemEnableConditionRef = or
        DemEnableConditionRef = process
        DemEnableConditionRef = recovered
        DemEnableConditionRef = recovers
        DemEnableConditionRef = requirements
        DemEnableConditionRef = requirements
        DemEnableConditionRef = reset
        DemEnableConditionRef = service
        DemEnableConditionRef = simultaneously
        DemEnableConditionRef = start
        DemEnableConditionRef = start
        DemEnableConditionRef = status
        DemEnableConditionRef = the_001
        DemEnableConditionRef = the_001
        DemEnableConditionRef = the_001
        DemEnableConditionRef = the_001
        DemEnableConditionRef = the_001
        DemEnableConditionRef = the_001
        DemEnableConditionRef = the_001
        DemEnableConditionRef = the_001
        DemEnableConditionRef = timer
        DemEnableConditionRef = timing
        DemEnableConditionRef = timing
        DemEnableConditionRef = to
        DemEnableConditionRef = to
        DemEnableConditionRef = to
        DemEnableConditionRef = voltage
        DemEnableConditionRef = voltage
      4 x DemEnableCondition, all with DemEnableConditionStatus=true:
        HVActive: DemEnableConditionId=23
        performed: DemEnableConditionId=136
        request: DemEnableConditionId=146
        Heat: DemEnableConditionId=24
      Ignition_Switch_Signal (DemDidClass): DemDidIdentifier=61856, DemDidDataClassRef=DID_0xf1a0_Ignition_Switch_Signal
      4 x DemEnableCondition, all with DemEnableConditionStatus=true:
        Reset_001: DemEnableConditionId=62
        VCU_: DemEnableConditionId=71
        of: DemEnableConditionId=131
        Note: DemEnableConditionId=39
      VCU_control_main_relay (DemDidClass): DemDidIdentifier=7441, DemDidDataClassRef=DID_0x1d11_Mainrealy1, DemDidDataClassRef=DID_0x1d11_Mainrelay2
      EnableConditionGroup_b80d94d2 (DemEnableConditionGroup):
        DemEnableConditionRef = If
        DemEnableConditionRef = Init
        DemEnableConditionRef = No
        DemEnableConditionRef = Note
        DemEnableConditionRef = The
        DemEnableConditionRef = V
        DemEnableConditionRef = V
        DemEnableConditionRef = VCU_Hvstatus_001
        DemEnableConditionRef = When
        DemEnableConditionRef = abnormal
        DemEnableConditionRef = active
        DemEnableConditionRef = after
        DemEnableConditionRef = again
        DemEnableConditionRef = all
        DemEnableConditionRef = any
        DemEnableConditionRef = are
        DemEnableConditionRef = battery
        DemEnableConditionRef = be
        DemEnableConditionRef = being
        DemEnableConditionRef = completed
        DemEnableConditionRef = conditions
        DemEnableConditionRef = conditions
        DemEnableConditionRef = conditions
        DemEnableConditionRef = confirmation
        DemEnableConditionRef = diagnosis
        DemEnableConditionRef = diagnosis
        DemEnableConditionRef = during
        DemEnableConditionRef = enable
        DemEnableConditionRef = fault
        DemEnableConditionRef = fault
        DemEnableConditionRef = fault
        DemEnableConditionRef = for
        DemEnableConditionRef = from
        DemEnableConditionRef = is
        DemEnableConditionRef = is
        DemEnableConditionRef = is
        DemEnableConditionRef = met
        DemEnableConditionRef = met
        DemEnableConditionRef = ms
        DemEnableConditionRef = ms
        DemEnableConditionRef = normal
        DemEnableConditionRef = not
        DemEnableConditionRef = of
        DemEnableConditionRef = or
        DemEnableConditionRef = or
        DemEnableConditionRef = performed
        DemEnableConditionRef = process
        DemEnableConditionRef = recovers
        DemEnableConditionRef = service
        DemEnableConditionRef = shall
        DemEnableConditionRef = the_001
        DemEnableConditionRef = the_001
        DemEnableConditionRef = the_001
        DemEnableConditionRef = the_001
        DemEnableConditionRef = the_001
        DemEnableConditionRef = the_001
        DemEnableConditionRef = to
        DemEnableConditionRef = trigger
        DemEnableConditionRef = up
        DemEnableConditionRef = voltage
        DemEnableConditionRef = voltage
        DemEnableConditionRef = waked
        DemEnableConditionRef = x1
      No (DemEnableCondition): DemEnableConditionId=37, DemEnableConditionStatus=true
      Battery_Voltage (DemDidClass): DemDidIdentifier=61857, DemDidDataClassRef=DID_0xf1a1_Battery_Voltage
      EnableConditionGroup_5feb31f0 (DemEnableConditionGroup):
        DemEnableConditionRef = Accelerator
        DemEnableConditionRef = If
        DemEnableConditionRef = No
        DemEnableConditionRef = Note
        DemEnableConditionRef = The
        DemEnableConditionRef = The
        DemEnableConditionRef = V
        DemEnableConditionRef = V
        DemEnableConditionRef = V
        DemEnableConditionRef = V
        DemEnableConditionRef = When
        DemEnableConditionRef = abnormal
        DemEnableConditionRef = accelerator_001
        DemEnableConditionRef = accelerator_001
        DemEnableConditionRef = accelerator_001
        DemEnableConditionRef = active
        DemEnableConditionRef = after
        DemEnableConditionRef = again
        DemEnableConditionRef = all
        DemEnableConditionRef = and
        DemEnableConditionRef = any
        DemEnableConditionRef = are
        DemEnableConditionRef = battery
        DemEnableConditionRef = be
        DemEnableConditionRef = being
        DemEnableConditionRef = completed
        DemEnableConditionRef = conditions
        DemEnableConditionRef = conditions
        DemEnableConditionRef = conditions
        DemEnableConditionRef = confirmation
        DemEnableConditionRef = diagnosis
        DemEnableConditionRef = diagnosis
        DemEnableConditionRef = during
        DemEnableConditionRef = enable
        DemEnableConditionRef = fault
        DemEnableConditionRef = fault
        DemEnableConditionRef = fault
        DemEnableConditionRef = for
        DemEnableConditionRef = for
        DemEnableConditionRef = from
        DemEnableConditionRef = is
        DemEnableConditionRef = is
        DemEnableConditionRef = is
        DemEnableConditionRef = is
        DemEnableConditionRef = is
        DemEnableConditionRef = is
        DemEnableConditionRef = met
        DemEnableConditionRef = met
        DemEnableConditionRef = ms
        DemEnableConditionRef = ms
        DemEnableConditionRef = normal
        DemEnableConditionRef = not
        DemEnableConditionRef = not
        DemEnableConditionRef = of
        DemEnableConditionRef = opening
        DemEnableConditionRef = opening
        DemEnableConditionRef = or
        DemEnableConditionRef = or
        DemEnableConditionRef = pedal
        DemEnableConditionRef = pedal
        DemEnableConditionRef = pedal
        DemEnableConditionRef = pedal
        DemEnableConditionRef = performed
        DemEnableConditionRef = pin
        DemEnableConditionRef = pin
        DemEnableConditionRef = pin1
        DemEnableConditionRef = pin2
        DemEnableConditionRef = process
        DemEnableConditionRef = recovers
        DemEnableConditionRef = restored
        DemEnableConditionRef = restored
        DemEnableConditionRef = s
        DemEnableConditionRef = service
        DemEnableConditionRef = shall
        DemEnableConditionRef = signal
        DemEnableConditionRef = signal
        DemEnableConditionRef = the_001
        DemEnableConditionRef = the_001
        DemEnableConditionRef = the_001
        DemEnableConditionRef = the_001
        DemEnableConditionRef = the_001
        DemEnableConditionRef = the_001
        DemEnableConditionRef = the_001
        DemEnableConditionRef = times
        DemEnableConditionRef = to
        DemEnableConditionRef = to
        DemEnableConditionRef = to
        DemEnableConditionRef = trigger
        DemEnableConditionRef = up
        DemEnableConditionRef = v_001
        DemEnableConditionRef = v_001
        DemEnableConditionRef = voltage
        DemEnableConditionRef = voltage
        DemEnableConditionRef = voltage
        DemEnableConditionRef = voltage
        DemEnableConditionRef = voltage
        DemEnableConditionRef = voltage
        DemEnableConditionRef = waked
      FreezeFrameRecNumClass_f98c8aa7 (DemFreezeFrameRecNumClass):
        DemFreezeFrameRecordNumber = 1
        DemFreezeFrameRecordTrigger = DEM_RECORD_TRIGGER_TESTFAILED
        DemFreezeFrameRecordUpdate = DEM_UPDATE_RECORD_YES
        DemFreezeFrameRecordNumber = 2
        DemFreezeFrameRecordTrigger = DEM_RECORD_TRIGGER_TESTFAILED
        DemFreezeFrameRecordUpdate = DEM_UPDATE_RECORD_YES
      9 x DemEnableCondition, all with DemEnableConditionStatus=true:
        conditions: DemEnableConditionId=101
        POD_OBC_VCU_S2_State: DemEnableConditionId=57
        or: DemEnableConditionId=134
        detected_001: DemEnableConditionId=104
        Power: DemEnableConditionId=59
        Enable_001: DemEnableConditionId=22
        relay: DemEnableConditionId=145
        v_001: DemEnableConditionId=168
        message: DemEnableConditionId=125
      EnableConditionGroup_d73be567 (DemEnableConditionGroup):
        DemEnableConditionRef = All_001
        DemEnableConditionRef = Busoff
        DemEnableConditionRef = Conditions_001
        DemEnableConditionRef = Conditions_001
        DemEnableConditionRef = Confirmed
        DemEnableConditionRef = Confirmed
        DemEnableConditionRef = DTC
        DemEnableConditionRef = DTC
        DemEnableConditionRef = Enable_001
        DemEnableConditionRef = Enable_001
        DemEnableConditionRef = If
        DemEnableConditionRef = In_001
        DemEnableConditionRef = LAN_001
        DemEnableConditionRef = No
        DemEnableConditionRef = No
        DemEnableConditionRef = Note
        DemEnableConditionRef = PNC0
        DemEnableConditionRef = Reset_001
        DemEnableConditionRef = T_Delay
        DemEnableConditionRef = T_Delay
        DemEnableConditionRef = T_Delay
        DemEnableConditionRef = The
        DemEnableConditionRef = The
        DemEnableConditionRef = V
        DemEnableConditionRef = V
        DemEnableConditionRef = abnormal
        DemEnableConditionRef = active
        DemEnableConditionRef = again
        DemEnableConditionRef = again
        DemEnableConditionRef = and
        DemEnableConditionRef = and
        DemEnableConditionRef = and
        DemEnableConditionRef = any
        DemEnableConditionRef = any
        DemEnableConditionRef = are
        DemEnableConditionRef = battery
        DemEnableConditionRef = condition
        DemEnableConditionRef = conditions
        DemEnableConditionRef = criteria
        DemEnableConditionRef = criteria
        DemEnableConditionRef = do
        DemEnableConditionRef = does
        DemEnableConditionRef = fault
        DemEnableConditionRef = following
        DemEnableConditionRef = for
        DemEnableConditionRef = from
        DemEnableConditionRef = if_001
        DemEnableConditionRef = in
        DemEnableConditionRef = in
        DemEnableConditionRef = is
        DemEnableConditionRef = is
        DemEnableConditionRef = last
        DemEnableConditionRef = meet
        DemEnableConditionRef = meet
        DemEnableConditionRef = met
        DemEnableConditionRef = ms
        DemEnableConditionRef = normal
        DemEnableConditionRef = not
        DemEnableConditionRef = not
        DemEnableConditionRef = of
        DemEnableConditionRef = of
        DemEnableConditionRef = or
        DemEnableConditionRef = or
        DemEnableConditionRef = process
        DemEnableConditionRef = recovered
        DemEnableConditionRef = recovers
        DemEnableConditionRef = requirements
        DemEnableConditionRef = requirements
        DemEnableConditionRef = reset
        DemEnableConditionRef = service
        DemEnableConditionRef = simultaneously
        DemEnableConditionRef = start
        DemEnableConditionRef = start
        DemEnableConditionRef = status
        DemEnableConditionRef = the_001
        DemEnableConditionRef = the_001
        DemEnableConditionRef = the_001
        DemEnableConditionRef = the_001
        DemEnableConditionRef = the_001
        DemEnableConditionRef = the_001
        DemEnableConditionRef = the_001
        DemEnableConditionRef = the_001
        DemEnableConditionRef = timer
        DemEnableConditionRef = timing
        DemEnableConditionRef = timing
        DemEnableConditionRef = to
        DemEnableConditionRef = to
        DemEnableConditionRef = to
        DemEnableConditionRef = voltage
        DemEnableConditionRef = voltage
      5 x DemEnableCondition, all with DemEnableConditionStatus=true:
        if_001: DemEnableConditionId=118
        VCU_ModeRequestDCDC: DemEnableConditionId=78
        In_001: DemEnableConditionId=28
        On: DemEnableConditionId=43
        Conditions_001: DemEnableConditionId=15
      DID_0xf1a4_Date_And_Time_Minute (DemDataClass): DemDataElementDataSize=1, DemDataElementDataType=UINT8, DemDataElementUsePort=USE_DATA_CLIENT_SERVER_PORT, DemDataElementStoreNonVolatile=true
      EnableConditionGroup_3c74cb75 (DemEnableConditionGroup):
        DemEnableConditionRef = Disable
        DemEnableConditionRef = Disable
        DemEnableConditionRef = If
        DemEnableConditionRef = ModeRequestDCDC
        DemEnableConditionRef = No
        DemEnableConditionRef = Note
        DemEnableConditionRef = The
        DemEnableConditionRef = V
        DemEnableConditionRef = V
        DemEnableConditionRef = VCU_
        DemEnableConditionRef = VCU_EnableOBC
        DemEnableConditionRef = When
        DemEnableConditionRef = abnormal
        DemEnableConditionRef = active
        DemEnableConditionRef = after
        DemEnableConditionRef = again
        DemEnableConditionRef = all
        DemEnableConditionRef = any
        DemEnableConditionRef = are
        DemEnableConditionRef = battery
        DemEnableConditionRef = be
        DemEnableConditionRef = being
        DemEnableConditionRef = completed
        DemEnableConditionRef = conditions
        DemEnableConditionRef = conditions
        DemEnableConditionRef = conditions
        DemEnableConditionRef = confirmation
        DemEnableConditionRef = diagnosis
        DemEnableConditionRef = diagnosis
        DemEnableConditionRef = during
        DemEnableConditionRef = enable
        DemEnableConditionRef = fault
        DemEnableConditionRef = fault
        DemEnableConditionRef = fault
        DemEnableConditionRef = for
        DemEnableConditionRef = from
        DemEnableConditionRef = is
        DemEnableConditionRef = is
        DemEnableConditionRef = is
        DemEnableConditionRef = met
        DemEnableConditionRef = met
        DemEnableConditionRef = ms
        DemEnableConditionRef = ms
        DemEnableConditionRef = normal
        DemEnableConditionRef = not
        DemEnableConditionRef = of
        DemEnableConditionRef = or
        DemEnableConditionRef = or
        DemEnableConditionRef = performed
        DemEnableConditionRef = process
        DemEnableConditionRef = recovers
        DemEnableConditionRef = service
        DemEnableConditionRef = shall
        DemEnableConditionRef = the_001
        DemEnableConditionRef = the_001
        DemEnableConditionRef = the_001
        DemEnableConditionRef = the_001
        DemEnableConditionRef = the_001
        DemEnableConditionRef = the_001
        DemEnableConditionRef = to
        DemEnableConditionRef = trigger
        DemEnableConditionRef = up
        DemEnableConditionRef = voltage
        DemEnableConditionRef = voltage
        DemEnableConditionRef = waked
        DemEnableConditionRef = x2
        DemEnableConditionRef = x3
      7 x DemEnableCondition, all with DemEnableConditionStatus=true:
        Close: DemEnableConditionId=14
        meet: DemEnableConditionId=124
        again: DemEnableConditionId=87
        enable: DemEnableConditionId=111
        start: DemEnableConditionId=158
        fault: DemEnableConditionId=112
        ms: DemEnableConditionId=127
      DID_0xf1a0_Ignition_Switch_Signal (DemDataClass): DemDataElementDataSize=1, DemDataElementDataType=UINT8, DemDataElementUsePort=USE_DATA_CLIENT_SERVER_PORT, DemDataElementStoreNonVolatile=true
      ExtendedDataClass_83dcefb7 (DemExtendedDataClass): DemExtendedDataRecordClassRef=ExtendedData
      5 x DemEnableCondition, all with DemEnableConditionStatus=true:
        OBC: DemEnableConditionId=40
        not: DemEnableConditionId=130
        Open: DemEnableConditionId=44
        Detected: DemEnableConditionId=20
        BHM: DemEnableConditionId=4
      DID_0x1d01_Accelerator_pedal_sensor_2_voltage (DemDataClass): DemDataElementDataSize=1, DemDataElementDataType=UINT8, DemDataElementUsePort=USE_DATA_CLIENT_SERVER_PORT, DemDataElementStoreNonVolatile=true
      3 x DemEnableCondition, all with DemEnableConditionStatus=true:
        Accelerator: DemEnableConditionId=2
        for: DemEnableConditionId=114
        does: DemEnableConditionId=108
      FreezeFrameClass_376d31f7 (DemFreezeFrameClass):
        DemDidClassRef = Ignition_Switch_Signal
        DemDidClassRef = Battery_Voltage
        DemDidClassRef = Total_Odometer
        DemDidClassRef = Vehicle_speed
        DemDidClassRef = Date_And_Time
        DemDidClassRef = VCU_HVStatus
        DemDidClassRef = SOC
        DemDidClassRef = Gear
        DemDidClassRef = Electronic_lock_state
      charging (DemEnableCondition): DemEnableConditionId=96, DemEnableConditionStatus=true
      EnableConditionGroup_171dbb3c (DemEnableConditionGroup):
        DemEnableConditionRef = Enable_001
        DemEnableConditionRef = If
        DemEnableConditionRef = No
        DemEnableConditionRef = The
        DemEnableConditionRef = V
        DemEnableConditionRef = V
        DemEnableConditionRef = VCU_RequestedModeTCU
        DemEnableConditionRef = When
        DemEnableConditionRef = abnormal
        DemEnableConditionRef = active
        DemEnableConditionRef = after
        DemEnableConditionRef = again
        DemEnableConditionRef = all
        DemEnableConditionRef = any
        DemEnableConditionRef = are
        DemEnableConditionRef = battery
        DemEnableConditionRef = be
        DemEnableConditionRef = being
        DemEnableConditionRef = completed
        DemEnableConditionRef = conditions
        DemEnableConditionRef = conditions
        DemEnableConditionRef = conditions
        DemEnableConditionRef = confirmation
        DemEnableConditionRef = diagnosis
        DemEnableConditionRef = diagnosis
        DemEnableConditionRef = during
        DemEnableConditionRef = enable
        DemEnableConditionRef = fault
        DemEnableConditionRef = fault
        DemEnableConditionRef = fault
        DemEnableConditionRef = for
        DemEnableConditionRef = from
        DemEnableConditionRef = is
        DemEnableConditionRef = is
        DemEnableConditionRef = is
        DemEnableConditionRef = met
        DemEnableConditionRef = met
        DemEnableConditionRef = ms
        DemEnableConditionRef = ms
        DemEnableConditionRef = normal
        DemEnableConditionRef = not
        DemEnableConditionRef = of
        DemEnableConditionRef = or
        DemEnableConditionRef = or
        DemEnableConditionRef = performed
        DemEnableConditionRef = process
        DemEnableConditionRef = recovers
        DemEnableConditionRef = serviceNote
        DemEnableConditionRef = shall
        DemEnableConditionRef = the_001
        DemEnableConditionRef = the_001
        DemEnableConditionRef = the_001
        DemEnableConditionRef = the_001
        DemEnableConditionRef = the_001
        DemEnableConditionRef = the_001
        DemEnableConditionRef = to
        DemEnableConditionRef = trigger
        DemEnableConditionRef = up
        DemEnableConditionRef = voltage
        DemEnableConditionRef = voltage
        DemEnableConditionRef = waked
        DemEnableConditionRef = x3
      diagnosis (DemEnableCondition): DemEnableConditionId=105, DemEnableConditionStatus=true
      DID_0x1d11_Mainrealy1 (DemDataClass): DemDataElementDataSize=1, DemDataElementDataType=UINT8, DemDataElementUsePort=USE_DATA_CLIENT_SERVER_PORT, DemDataElementStoreNonVolatile=true
      4 x DemEnableCondition, all with DemEnableConditionStatus=true:
        Busoff: DemEnableConditionId=11
        last: DemEnableConditionId=121
        be: DemEnableConditionId=93
        recovered: DemEnableConditionId=143
      DID_0x1d05_POD_OBC_OutputDCChargeCurrent (DemDataClass):
        DemDataElementDataSize = 2
        DemDataElementDataType = UINT16
        DemDataElementEndianness = BIG_ENDIAN
        DemDataElementUsePort = USE_DATA_CLIENT_SERVER_PORT
        DemDataElementStoreNonVolatile = true
      DemEventMemorySet
      DID_0x1d01_Accelerator_pedal_sensor_1_voltage (DemDataClass): DemDataElementDataSize=1, DemDataElementDataType=UINT8, DemDataElementUsePort=USE_DATA_CLIENT_SERVER_PORT, DemDataElementStoreNonVolatile=true
      DTC (DemEnableCondition): DemEnableConditionId=19, DemEnableConditionStatus=true
      VCU_HV_InterLock_PWM_pfrequency (DemDidClass): DemDidIdentifier=7432, DemDidDataClassRef=DID_0x1d08_VCU_HVIL
      Date_And_Time (DemDidClass):
        DemDidIdentifier = 61860
        DemDidDataClassRef = DID_0xf1a4_Date_And_Time_Second
        DemDidDataClassRef = DID_0xf1a4_Date_And_Time_Minute
        DemDidDataClassRef = DID_0xf1a4_Date_And_Time_Hour
        DemDidDataClassRef = DID_0xf1a4_Date_And_Time_Day
        DemDidDataClassRef = DID_0xf1a4_Date_And_Time_Month
        DemDidDataClassRef = DID_0xf1a4_Date_And_Time_Year
      10 x DemEnableCondition, all with DemEnableConditionStatus=true:
        VCU_OBC_Control_of_em_lock: DemEnableConditionId=79
        PNC31: DemEnableConditionId=54
        shall: DemEnableConditionId=155
        all: DemEnableConditionId=88
        pin: DemEnableConditionId=137
        normal: DemEnableConditionId=129
        Ohm: DemEnableConditionId=42
        abnormal: DemEnableConditionId=83
        PNC25: DemEnableConditionId=53
        the_001: DemEnableConditionId=161
      DID_0x1d07_Electronic_lock_state (DemDataClass): DemDataElementDataSize=1, DemDataElementDataType=UINT8, DemDataElementUsePort=USE_DATA_CLIENT_SERVER_PORT, DemDataElementStoreNonVolatile=true
      Electronic_lock_state (DemDidClass): DemDidIdentifier=7431, DemDidDataClassRef=DID_0x1d07_Electronic_lock_state
      DID_0x1d09_New_Bit_Field (DemDataClass): DemDataElementDataSize=1, DemDataElementDataType=UINT8, DemDataElementUsePort=USE_DATA_CLIENT_SERVER_PORT, DemDataElementStoreNonVolatile=true
      VCU_Hvstatus_001 (DemEnableCondition): DemEnableConditionId=76, DemEnableConditionStatus=true
      DC (DemEnableCondition): DemEnableConditionId=18, DemEnableConditionStatus=true
      DID_0x1d01_VCU_VehicleSpeed (DemDataClass):
        DemDataElementDataSize = 2
        DemDataElementDataType = UINT16
        DemDataElementEndianness = BIG_ENDIAN
        DemDataElementUsePort = USE_DATA_CLIENT_SERVER_PORT
        DemDataElementStoreNonVolatile = true
      EnableConditionGroup_4392d02e (DemEnableConditionGroup):
        DemEnableConditionRef = Control
        DemEnableConditionRef = If
        DemEnableConditionRef = MCU_VCUWorkMode
        DemEnableConditionRef = No
        DemEnableConditionRef = Note
        DemEnableConditionRef = Ready
        DemEnableConditionRef = The
        DemEnableConditionRef = Torque
        DemEnableConditionRef = V
        DemEnableConditionRef = V
        DemEnableConditionRef = VCU_MCURequestedState
        DemEnableConditionRef = When
        DemEnableConditionRef = abnormal
        DemEnableConditionRef = active
        DemEnableConditionRef = after
        DemEnableConditionRef = again
        DemEnableConditionRef = all
        DemEnableConditionRef = any
        DemEnableConditionRef = are
        DemEnableConditionRef = battery
        DemEnableConditionRef = be
        DemEnableConditionRef = being
        DemEnableConditionRef = completed
        DemEnableConditionRef = conditions
        DemEnableConditionRef = conditions
        DemEnableConditionRef = conditions
        DemEnableConditionRef = confirmation
        DemEnableConditionRef = diagnosis
        DemEnableConditionRef = diagnosis
        DemEnableConditionRef = during
        DemEnableConditionRef = enable
        DemEnableConditionRef = fault
        DemEnableConditionRef = fault
        DemEnableConditionRef = fault
        DemEnableConditionRef = for
        DemEnableConditionRef = from
        DemEnableConditionRef = is
        DemEnableConditionRef = is
        DemEnableConditionRef = is
        DemEnableConditionRef = met
        DemEnableConditionRef = met
        DemEnableConditionRef = ms
        DemEnableConditionRef = ms
        DemEnableConditionRef = normal
        DemEnableConditionRef = not
        DemEnableConditionRef = of
        DemEnableConditionRef = or
        DemEnableConditionRef = or
        DemEnableConditionRef = performed
        DemEnableConditionRef = process
        DemEnableConditionRef = recovers
        DemEnableConditionRef = service
        DemEnableConditionRef = shall
        DemEnableConditionRef = the_001
        DemEnableConditionRef = the_001
        DemEnableConditionRef = the_001
        DemEnableConditionRef = the_001
        DemEnableConditionRef = the_001
        DemEnableConditionRef = the_001
        DemEnableConditionRef = to
        DemEnableConditionRef = trigger
        DemEnableConditionRef = up
        DemEnableConditionRef = voltage
        DemEnableConditionRef = voltage
        DemEnableConditionRef = waked
        DemEnableConditionRef = x0
        DemEnableConditionRef = x3
      to (DemEnableCondition): DemEnableConditionId=165, DemEnableConditionStatus=true
      EnableConditionGroup_b2fa4a09 (DemEnableConditionGroup):
        DemEnableConditionRef = If
        DemEnableConditionRef = KL15eWakeUp
        DemEnableConditionRef = No
        DemEnableConditionRef = Note
        DemEnableConditionRef = ON_001
        DemEnableConditionRef = The
        DemEnableConditionRef = V
        DemEnableConditionRef = V
        DemEnableConditionRef = When
        DemEnableConditionRef = abnormal
        DemEnableConditionRef = active
        DemEnableConditionRef = after
        DemEnableConditionRef = again
        DemEnableConditionRef = all
        DemEnableConditionRef = any
        DemEnableConditionRef = are
        DemEnableConditionRef = battery
        DemEnableConditionRef = be
        DemEnableConditionRef = being
        DemEnableConditionRef = completed
        DemEnableConditionRef = conditions
        DemEnableConditionRef = conditions
        DemEnableConditionRef = conditions
        DemEnableConditionRef = confirmation
        DemEnableConditionRef = diagnosis
        DemEnableConditionRef = diagnosis
        DemEnableConditionRef = during
        DemEnableConditionRef = enable
        DemEnableConditionRef = fault
        DemEnableConditionRef = fault
        DemEnableConditionRef = fault
        DemEnableConditionRef = for
        DemEnableConditionRef = from
        DemEnableConditionRef = is
        DemEnableConditionRef = is
        DemEnableConditionRef = is
        DemEnableConditionRef = met
        DemEnableConditionRef = met
        DemEnableConditionRef = ms
        DemEnableConditionRef = ms
        DemEnableConditionRef = normal
        DemEnableConditionRef = not
        DemEnableConditionRef = of
        DemEnableConditionRef = or
        DemEnableConditionRef = or
        DemEnableConditionRef = performed
        DemEnableConditionRef = process
        DemEnableConditionRef = recovers
        DemEnableConditionRef = service
        DemEnableConditionRef = shall
        DemEnableConditionRef = the_001
        DemEnableConditionRef = the_001
        DemEnableConditionRef = the_001
        DemEnableConditionRef = the_001
        DemEnableConditionRef = the_001
        DemEnableConditionRef = the_001
        DemEnableConditionRef = to
        DemEnableConditionRef = trigger
        DemEnableConditionRef = up
        DemEnableConditionRef = voltage
        DemEnableConditionRef = voltage
        DemEnableConditionRef = waked
      Lan (DemEnableCondition): DemEnableConditionId=34, DemEnableConditionStatus=true
      Total_Odometer (DemDidClass): DemDidIdentifier=61858, DemDidDataClassRef=DID_0xf1a2_Total_Odometer
      DemPostbuild: DemEventAvailableDefaultSupport=true, DemMaxSizeFreezeFrame=26, DemMaxNumberDtr=0, DemMaxSizeGlobalFreezeFrame=0, DemMaxSizeOBDonUDSFreezeFrame=0
      FreezeFrameClass_de0e94c2 (DemFreezeFrameClass):
        DemDidClassRef = Ignition_Switch_Signal
        DemDidClassRef = Battery_Voltage
        DemDidClassRef = Total_Odometer
        DemDidClassRef = Vehicle_speed
        DemDidClassRef = Date_And_Time
        DemDidClassRef = VCU_HVStatus
        DemDidClassRef = SOC
        DemDidClassRef = Gear
        DemDidClassRef = VCU_AccPealparameter
      EnableConditionGroup_c8259b58 (DemEnableConditionGroup):
        DemEnableConditionRef = AC
        DemEnableConditionRef = Close
        DemEnableConditionRef = If
        DemEnableConditionRef = No
        DemEnableConditionRef = Note
        DemEnableConditionRef = OBC
        DemEnableConditionRef = Ohm
        DemEnableConditionRef = Ohm
        DemEnableConditionRef = Ohm
        DemEnableConditionRef = Ohm
        DemEnableConditionRef = Open
        DemEnableConditionRef = POD_OBC_CCStatus
        DemEnableConditionRef = The
        DemEnableConditionRef = V
        DemEnableConditionRef = V
        DemEnableConditionRef = VCU
        DemEnableConditionRef = VCU_OBC_Control_of_em_lock
        DemEnableConditionRef = When
        DemEnableConditionRef = abnormal
        DemEnableConditionRef = active
        DemEnableConditionRef = active
        DemEnableConditionRef = again
        DemEnableConditionRef = all
        DemEnableConditionRef = any
        DemEnableConditionRef = are
        DemEnableConditionRef = battery
        DemEnableConditionRef = be
        DemEnableConditionRef = completed
        DemEnableConditionRef = conditions
        DemEnableConditionRef = conditions
        DemEnableConditionRef = conditions
        DemEnableConditionRef = confirmation
        DemEnableConditionRef = diagnosis
        DemEnableConditionRef = diagnosis
        DemEnableConditionRef = during
        DemEnableConditionRef = electronic
        DemEnableConditionRef = enable
        DemEnableConditionRef = fault
        DemEnableConditionRef = fault
        DemEnableConditionRef = fault
        DemEnableConditionRef = for
        DemEnableConditionRef = from
        DemEnableConditionRef = guns
        DemEnableConditionRef = is
        DemEnableConditionRef = is
        DemEnableConditionRef = is
        DemEnableConditionRef = is
        DemEnableConditionRef = lock
        DemEnableConditionRef = met
        DemEnableConditionRef = met
        DemEnableConditionRef = ms
        DemEnableConditionRef = normal
        DemEnableConditionRef = not
        DemEnableConditionRef = of
        DemEnableConditionRef = or
        DemEnableConditionRef = or
        DemEnableConditionRef = performed
        DemEnableConditionRef = process
        DemEnableConditionRef = recovers
        DemEnableConditionRef = requests
        DemEnableConditionRef = service
        DemEnableConditionRef = shall
        DemEnableConditionRef = the_001
        DemEnableConditionRef = the_001
        DemEnableConditionRef = the_001
        DemEnableConditionRef = the_001
        DemEnableConditionRef = the_001
        DemEnableConditionRef = the_001
        DemEnableConditionRef = the_001
        DemEnableConditionRef = to
        DemEnableConditionRef = to
        DemEnableConditionRef = trigger
        DemEnableConditionRef = voltage
        DemEnableConditionRef = voltage
        DemEnableConditionRef = x0
        DemEnableConditionRef = x{2..5}
      EnableConditionGroup_f1606167 (DemEnableConditionGroup):
        DemEnableConditionRef = AC
        DemEnableConditionRef = Close
        DemEnableConditionRef = If
        DemEnableConditionRef = No
        DemEnableConditionRef = Note
        DemEnableConditionRef = Ohm
        DemEnableConditionRef = Ohm
        DemEnableConditionRef = Ohm
        DemEnableConditionRef = Ohm
        DemEnableConditionRef = POD_OBC_CCStatus
        DemEnableConditionRef = POD_OBC_VCU_S2_State
        DemEnableConditionRef = S2
        DemEnableConditionRef = The
        DemEnableConditionRef = V
        DemEnableConditionRef = V
        DemEnableConditionRef = When
        DemEnableConditionRef = abnormal
        DemEnableConditionRef = active
        DemEnableConditionRef = active
        DemEnableConditionRef = again
        DemEnableConditionRef = all
        DemEnableConditionRef = any
        DemEnableConditionRef = are
        DemEnableConditionRef = battery
        DemEnableConditionRef = be
        DemEnableConditionRef = closed
        DemEnableConditionRef = completed
        DemEnableConditionRef = conditions
        DemEnableConditionRef = conditions
        DemEnableConditionRef = conditions
        DemEnableConditionRef = confirmation
        DemEnableConditionRef = diagnosis
        DemEnableConditionRef = diagnosis
        DemEnableConditionRef = during
        DemEnableConditionRef = enable
        DemEnableConditionRef = fault
        DemEnableConditionRef = fault
        DemEnableConditionRef = fault
        DemEnableConditionRef = for
        DemEnableConditionRef = from
        DemEnableConditionRef = guns
        DemEnableConditionRef = is
        DemEnableConditionRef = is
        DemEnableConditionRef = is
        DemEnableConditionRef = is
        DemEnableConditionRef = is
        DemEnableConditionRef = met
        DemEnableConditionRef = met
        DemEnableConditionRef = ms
        DemEnableConditionRef = normal
        DemEnableConditionRef = not
        DemEnableConditionRef = of
        DemEnableConditionRef = or
        DemEnableConditionRef = or
        DemEnableConditionRef = performed
        DemEnableConditionRef = process
        DemEnableConditionRef = recovers
        DemEnableConditionRef = service
        DemEnableConditionRef = shall
        DemEnableConditionRef = switch
        DemEnableConditionRef = the_001
        DemEnableConditionRef = the_001
        DemEnableConditionRef = the_001
        DemEnableConditionRef = the_001
        DemEnableConditionRef = the_001
        DemEnableConditionRef = the_001
        DemEnableConditionRef = to
        DemEnableConditionRef = trigger
        DemEnableConditionRef = voltage
        DemEnableConditionRef = voltage
        DemEnableConditionRef = x{1..5}
      requests (DemEnableCondition): DemEnableConditionId=147, DemEnableConditionStatus=true
      FreezeFrameClass_d0d51cf0 (DemFreezeFrameClass):
        DemDidClassRef = Ignition_Switch_Signal
        DemDidClassRef = Battery_Voltage
        DemDidClassRef = Total_Odometer
        DemDidClassRef = Vehicle_speed
        DemDidClassRef = Date_And_Time
        DemDidClassRef = VCU_HVStatus
        DemDidClassRef = SOC
        DemDidClassRef = Gear
        DemDidClassRef = S2_status
      PNC0 (DemEnableCondition): DemEnableConditionId=45, DemEnableConditionStatus=true
      DID_0xf1a3_Vehicle_speed (DemDataClass):
        DemDataElementDataSize = 2
        DemDataElementDataType = UINT16
        DemDataElementEndianness = BIG_ENDIAN
        DemDataElementUsePort = USE_DATA_CLIENT_SERVER_PORT
        DemDataElementStoreNonVolatile = true
      4 x DemEnableCondition, all with DemEnableConditionStatus=true:
        PNC13: DemEnableConditionId=48
        following: DemEnableConditionId=113
        BMS: DemEnableConditionId=5
        PNC15: DemEnableConditionId=50
      EnableConditionGroup_cca67fec (DemEnableConditionGroup):
        DemEnableConditionRef = All_001
        DemEnableConditionRef = Busoff
        DemEnableConditionRef = Conditions_001
        DemEnableConditionRef = Conditions_001
        DemEnableConditionRef = Confirmed
        DemEnableConditionRef = Confirmed
        DemEnableConditionRef = DTC
        DemEnableConditionRef = DTC
        DemEnableConditionRef = Enable_001
        DemEnableConditionRef = Enable_001
        DemEnableConditionRef = If
        DemEnableConditionRef = In_001
        DemEnableConditionRef = Lan
        DemEnableConditionRef = No
        DemEnableConditionRef = No
        DemEnableConditionRef = Note
        DemEnableConditionRef = PNC0
        DemEnableConditionRef = PNC03
        DemEnableConditionRef = PNC04
        DemEnableConditionRef = PNC{13..16}
        DemEnableConditionRef = PNC18
        DemEnableConditionRef = Reset_001
        DemEnableConditionRef = T_Delay
        DemEnableConditionRef = T_Delay
        DemEnableConditionRef = T_Delay
        DemEnableConditionRef = The
        DemEnableConditionRef = The
        DemEnableConditionRef = V
        DemEnableConditionRef = V
        DemEnableConditionRef = abnormal
        DemEnableConditionRef = active
        DemEnableConditionRef = again
        DemEnableConditionRef = again
        DemEnableConditionRef = and
        DemEnableConditionRef = and
        DemEnableConditionRef = and
        DemEnableConditionRef = any
        DemEnableConditionRef = any
        DemEnableConditionRef = are
        DemEnableConditionRef = battery
        DemEnableConditionRef = condition
        DemEnableConditionRef = conditions
        DemEnableConditionRef = criteria
        DemEnableConditionRef = criteria
        DemEnableConditionRef = do
        DemEnableConditionRef = does
        DemEnableConditionRef = fault
        DemEnableConditionRef = following
        DemEnableConditionRef = for
        DemEnableConditionRef = from
        DemEnableConditionRef = if_001
        DemEnableConditionRef = in
        DemEnableConditionRef = in
        DemEnableConditionRef = is
        DemEnableConditionRef = is
        DemEnableConditionRef = last
        DemEnableConditionRef = meet
        DemEnableConditionRef = meet
        DemEnableConditionRef = met
        DemEnableConditionRef = ms
        DemEnableConditionRef = normal
        DemEnableConditionRef = not
        DemEnableConditionRef = not
        DemEnableConditionRef = of
        DemEnableConditionRef = of
        DemEnableConditionRef = or
        DemEnableConditionRef = or
        DemEnableConditionRef = process
        DemEnableConditionRef = recovered
        DemEnableConditionRef = recovers
        DemEnableConditionRef = requirements
        DemEnableConditionRef = requirements
        DemEnableConditionRef = reset
        DemEnableConditionRef = service
        DemEnableConditionRef = simultaneously
        DemEnableConditionRef = start
        DemEnableConditionRef = start
        DemEnableConditionRef = status
        DemEnableConditionRef = the_001
        DemEnableConditionRef = the_001
        DemEnableConditionRef = the_001
        DemEnableConditionRef = the_001
        DemEnableConditionRef = the_001
        DemEnableConditionRef = the_001
        DemEnableConditionRef = the_001
        DemEnableConditionRef = the_001
        DemEnableConditionRef = timer
        DemEnableConditionRef = timing
        DemEnableConditionRef = timing
        DemEnableConditionRef = to
        DemEnableConditionRef = to
        DemEnableConditionRef = to
        DemEnableConditionRef = voltage
        DemEnableConditionRef = voltage
      7 x DemEnableCondition, all with DemEnableConditionStatus=true:
        PNC14: DemEnableConditionId=49
        PNC16: DemEnableConditionId=51
        PNC18: DemEnableConditionId=52
        All_001: DemEnableConditionId=3
        signal: DemEnableConditionId=156
        T_Delay: DemEnableConditionId=65
        status: DemEnableConditionId=159
      DID_0x1d05_POD_OBC_InputACVoltage (DemDataClass):
        DemDataElementDataSize = 2
        DemDataElementDataType = UINT16
        DemDataElementEndianness = BIG_ENDIAN
        DemDataElementUsePort = USE_DATA_CLIENT_SERVER_PORT
        DemDataElementStoreNonVolatile = true
      5 x DemEnableCondition, all with DemEnableConditionStatus=true:
        voltage: DemEnableConditionId=169
        Request_001: DemEnableConditionId=61
        BMS_ChargeStatus: DemEnableConditionId=6
        AC: DemEnableConditionId=1
        accelerator_001: DemEnableConditionId=84
      VCU_AccPealparameter (DemDidClass):
        DemDidIdentifier = 7425
        DemDidDataClassRef = DID_0x1d01_VCU_VehicleSpeed
        DemDidDataClassRef = DID_0x1d01_Accelerator_pedal_sensor_1_voltage
        DemDidDataClassRef = DID_0x1d01_Accelerator_pedal_sensor_2_voltage
        DemDidDataClassRef = DID_0x1d01_VCU_AccelerationPedal
      ExtendedData (DemExtendedDataRecordClass):
        DemExtendedDataRecordNumber = 1
        DemExtendedDataRecordTrigger = DEM_RECORD_TRIGGER_TESTFAILED
        DemExtendedDataRecordUpdate = DEM_UPDATE_RECORD_YES
        DemDataClassRef = ExtendedData_Fault_Ocurrence_Counter
        DemDataClassRef = ExtendedData_Fault_Aged_Counter
        DemDataClassRef = ExtendedData_Fault_Aging_Counter
      5 x DemEnableCondition, all with DemEnableConditionStatus=true:
        after: DemEnableConditionId=86
        KL15E_001: DemEnableConditionId=30
        PNC04: DemEnableConditionId=47
        PNC03: DemEnableConditionId=46
        VCU: DemEnableConditionId=70
      DID_0xf1a2_Total_Odometer (DemDataClass):
        DemDataElementDataSize = 3
        DemDataElementDataType = UINT8_N
        DemDataElementEndianness = opaque
        DemDataElementUsePort = USE_DATA_CLIENT_SERVER_PORT
        DemDataElementStoreNonVolatile = true
      8 x DemEnableCondition, all with DemEnableConditionStatus=true:
        positive: DemEnableConditionId=140
        S2: DemEnableConditionId=63
        VCU_RequestedModeTCU: DemEnableConditionId=81
        Control: DemEnableConditionId=17
        being: DemEnableConditionId=94
        POD_OBC_CCStatus: DemEnableConditionId=56
        switch: DemEnableConditionId=160
        VCU_EnableOBC: DemEnableConditionId=74
      DID_0xf1a5_VCU_HVStatus (DemDataClass): DemDataElementDataSize=1, DemDataElementDataType=UINT8, DemDataElementUsePort=USE_DATA_CLIENT_SERVER_PORT, DemDataElementStoreNonVolatile=true
      FreezeFrameClass_a7d22c66 (DemFreezeFrameClass):
        DemDidClassRef = Ignition_Switch_Signal
        DemDidClassRef = Battery_Voltage
        DemDidClassRef = Total_Odometer
        DemDidClassRef = Vehicle_speed
        DemDidClassRef = Date_And_Time
        DemDidClassRef = VCU_HVStatus
        DemDidClassRef = SOC
        DemDidClassRef = Gear
        DemDidClassRef = VCU_HV_InterLock_PWM_pfrequency
      DID_0xf1a7_Gear (DemDataClass): DemDataElementDataSize=1, DemDataElementDataType=UINT8, DemDataElementUsePort=USE_DATA_CLIENT_SERVER_PORT, DemDataElementStoreNonVolatile=true
      ExtendedData_Fault_Aging_Counter (DemDataClass): DemDataElementDataSize=1, DemDataElementDataType=UINT8, DemDataElementUsePort=USE_DATA_CLIENT_SERVER_PORT, DemDataElementStoreNonVolatile=true
      VCU_RequestedModeBMS (DemEnableCondition): DemEnableConditionId=80, DemEnableConditionStatus=true
      DID_0xf1a1_Battery_Voltage (DemDataClass):
        DemDataElementDataSize = 2
        DemDataElementDataType = UINT16
        DemDataElementEndianness = BIG_ENDIAN
        DemDataElementUsePort = USE_DATA_CLIENT_SERVER_PORT
        DemDataElementStoreNonVolatile = true
      EnableConditionGroup_0e120735 (DemEnableConditionGroup):
        DemEnableConditionRef = Buck
        DemEnableConditionRef = If
        DemEnableConditionRef = No
        DemEnableConditionRef = Note
        DemEnableConditionRef = The
        DemEnableConditionRef = V
        DemEnableConditionRef = V
        DemEnableConditionRef = VCU_ModeRequestDCDC
        DemEnableConditionRef = When
        DemEnableConditionRef = abnormal
        DemEnableConditionRef = active
        DemEnableConditionRef = after
        DemEnableConditionRef = again
        DemEnableConditionRef = all
        DemEnableConditionRef = any
        DemEnableConditionRef = are
        DemEnableConditionRef = battery
        DemEnableConditionRef = be
        DemEnableConditionRef = being
        DemEnableConditionRef = completed
        DemEnableConditionRef = conditions
        DemEnableConditionRef = conditions
        DemEnableConditionRef = conditions
        DemEnableConditionRef = confirmation
        DemEnableConditionRef = diagnosis
        DemEnableConditionRef = diagnosis
        DemEnableConditionRef = during
        DemEnableConditionRef = enable
        DemEnableConditionRef = fault
        DemEnableConditionRef = fault
        DemEnableConditionRef = fault
        DemEnableConditionRef = for
        DemEnableConditionRef = from
        DemEnableConditionRef = is
        DemEnableConditionRef = is
        DemEnableConditionRef = is
        DemEnableConditionRef = met
        DemEnableConditionRef = met
        DemEnableConditionRef = ms
        DemEnableConditionRef = ms
        DemEnableConditionRef = normal
        DemEnableConditionRef = not
        DemEnableConditionRef = of
        DemEnableConditionRef = or
        DemEnableConditionRef = or
        DemEnableConditionRef = performed
        DemEnableConditionRef = process
        DemEnableConditionRef = recovers
        DemEnableConditionRef = service
        DemEnableConditionRef = shall
        DemEnableConditionRef = the_001
        DemEnableConditionRef = the_001
        DemEnableConditionRef = the_001
        DemEnableConditionRef = the_001
        DemEnableConditionRef = the_001
        DemEnableConditionRef = the_001
        DemEnableConditionRef = to
        DemEnableConditionRef = trigger
        DemEnableConditionRef = up
        DemEnableConditionRef = voltage
        DemEnableConditionRef = voltage
        DemEnableConditionRef = waked
        DemEnableConditionRef = x1
      4 x DemEnableCondition, all with DemEnableConditionStatus=true:
        TrqCtrl: DemEnableConditionId=68
        POD: DemEnableConditionId=55
        function: DemEnableConditionId=116
        KL15eWakeUp: DemEnableConditionId=32
      DID_0xf1a4_Date_And_Time_Hour (DemDataClass): DemDataElementDataSize=1, DemDataElementDataType=UINT8, DemDataElementUsePort=USE_DATA_CLIENT_SERVER_PORT, DemDataElementStoreNonVolatile=true
      service (DemEnableCondition): DemEnableConditionId=153, DemEnableConditionStatus=true
      pin1 (DemEnableCondition): DemEnableConditionId=138, DemEnableConditionStatus=true
      Vehicle_speed (DemDidClass): DemDidIdentifier=61859, DemDidDataClassRef=DID_0xf1a3_Vehicle_speed
      pin2 (DemEnableCondition): DemEnableConditionId=139, DemEnableConditionStatus=true
      EnableConditionGroup_f26910b9 (DemEnableConditionGroup):
        DemEnableConditionRef = AC
        DemEnableConditionRef = AC
        DemEnableConditionRef = Close
        DemEnableConditionRef = If
        DemEnableConditionRef = No
        DemEnableConditionRef = Note
        DemEnableConditionRef = Ohm
        DemEnableConditionRef = Ohm
        DemEnableConditionRef = Ohm
        DemEnableConditionRef = Ohm
        DemEnableConditionRef = Ohm
        DemEnableConditionRef = Ohm
        DemEnableConditionRef = Ohm
        DemEnableConditionRef = Ohm
        DemEnableConditionRef = On
        DemEnableConditionRef = POD_OBC_CCStatus
        DemEnableConditionRef = POD_OBC_CCStatus
        DemEnableConditionRef = POD_OBC_VCU_S2_State
        DemEnableConditionRef = S2
        DemEnableConditionRef = The
        DemEnableConditionRef = V
        DemEnableConditionRef = V
        DemEnableConditionRef = When
        DemEnableConditionRef = abnormal
        DemEnableConditionRef = active
        DemEnableConditionRef = active
        DemEnableConditionRef = again
        DemEnableConditionRef = all
        DemEnableConditionRef = any
        DemEnableConditionRef = are
        DemEnableConditionRef = battery
        DemEnableConditionRef = be
        DemEnableConditionRef = charging
        DemEnableConditionRef = closed
        DemEnableConditionRef = completed
        DemEnableConditionRef = conditions
        DemEnableConditionRef = conditions
        DemEnableConditionRef = conditions
        DemEnableConditionRef = confirmation
        DemEnableConditionRef = diagnosis
        DemEnableConditionRef = diagnosis
        DemEnableConditionRef = during
        DemEnableConditionRef = enable
        DemEnableConditionRef = fault
        DemEnableConditionRef = fault
        DemEnableConditionRef = fault
        DemEnableConditionRef = for
        DemEnableConditionRef = from
        DemEnableConditionRef = guns
        DemEnableConditionRef = is
        DemEnableConditionRef = is
        DemEnableConditionRef = is
        DemEnableConditionRef = is
        DemEnableConditionRef = is
        DemEnableConditionRef = met
        DemEnableConditionRef = met
        DemEnableConditionRef = ms
        DemEnableConditionRef = normal
        DemEnableConditionRef = not
        DemEnableConditionRef = of
        DemEnableConditionRef = or
        DemEnableConditionRef = or
        DemEnableConditionRef = performed
        DemEnableConditionRef = process
        DemEnableConditionRef = recovers
        DemEnableConditionRef = service
        DemEnableConditionRef = shall
        DemEnableConditionRef = status
        DemEnableConditionRef = switch
        DemEnableConditionRef = the_001
        DemEnableConditionRef = the_001
        DemEnableConditionRef = the_001
        DemEnableConditionRef = the_001
        DemEnableConditionRef = the_001
        DemEnableConditionRef = the_001
        DemEnableConditionRef = the_001
        DemEnableConditionRef = to
        DemEnableConditionRef = trigger
        DemEnableConditionRef = voltage
        DemEnableConditionRef = voltage
        DemEnableConditionRef = x1
        DemEnableConditionRef = x2
        DemEnableConditionRef = x2
        DemEnableConditionRef = x3
        DemEnableConditionRef = x3
        DemEnableConditionRef = x4
        DemEnableConditionRef = x4
        DemEnableConditionRef = x5
        DemEnableConditionRef = x5
      4 x DemEnableCondition, all with DemEnableConditionStatus=true:
        Init: DemEnableConditionId=29
        close_001: DemEnableConditionId=97
        completed: DemEnableConditionId=99
        closed: DemEnableConditionId=98
      DID_0xf1a4_Date_And_Time_Day (DemDataClass): DemDataElementDataSize=1, DemDataElementDataType=UINT8, DemDataElementUsePort=USE_DATA_CLIENT_SERVER_PORT, DemDataElementStoreNonVolatile=true
      disconnect (DemEnableCondition): DemEnableConditionId=106, DemEnableConditionStatus=true
      EnableConditionGroup_63ddaef5 (DemEnableConditionGroup):
        DemEnableConditionRef = BMS
        DemEnableConditionRef = BMS_status
        DemEnableConditionRef = Chargestatus
        DemEnableConditionRef = Close
        DemEnableConditionRef = DC
        DemEnableConditionRef = DC
        DemEnableConditionRef = DC
        DemEnableConditionRef = DC
        DemEnableConditionRef = DC
        DemEnableConditionRef = Detected
        DemEnableConditionRef = High
        DemEnableConditionRef = If
        DemEnableConditionRef = Note
        DemEnableConditionRef = On
        DemEnableConditionRef = POD
        DemEnableConditionRef = Plug
        DemEnableConditionRef = Plug
        DemEnableConditionRef = Power
        DemEnableConditionRef = Request_001
        DemEnableConditionRef = VCU
        DemEnableConditionRef = VCU
        DemEnableConditionRef = VCU_Enable_DC_Relay
        DemEnableConditionRef = When
        DemEnableConditionRef = again
        DemEnableConditionRef = all
        DemEnableConditionRef = any
        DemEnableConditionRef = are
        DemEnableConditionRef = be
        DemEnableConditionRef = charge
        DemEnableConditionRef = charge
        DemEnableConditionRef = charging
        DemEnableConditionRef = close_001
        DemEnableConditionRef = completed
        DemEnableConditionRef = completed
        DemEnableConditionRef = conditions
        DemEnableConditionRef = conditions
        DemEnableConditionRef = conditions
        DemEnableConditionRef = confirmation
        DemEnableConditionRef = detected_001
        DemEnableConditionRef = diagnosis
        DemEnableConditionRef = diagnosis
        DemEnableConditionRef = during
        DemEnableConditionRef = enable
        DemEnableConditionRef = fault
        DemEnableConditionRef = fault
        DemEnableConditionRef = fault
        DemEnableConditionRef = for
        DemEnableConditionRef = is
        DemEnableConditionRef = is
        DemEnableConditionRef = is
        DemEnableConditionRef = is
        DemEnableConditionRef = met
        DemEnableConditionRef = met
        DemEnableConditionRef = not
        DemEnableConditionRef = of
        DemEnableConditionRef = or
        DemEnableConditionRef = performed
        DemEnableConditionRef = process
        DemEnableConditionRef = relay
        DemEnableConditionRef = request
        DemEnableConditionRef = shall
        DemEnableConditionRef = the_001
        DemEnableConditionRef = the_001
        DemEnableConditionRef = the_001
        DemEnableConditionRef = the_001
        DemEnableConditionRef = the_001
        DemEnableConditionRef = to
        DemEnableConditionRef = trigger
        DemEnableConditionRef = voltage
        DemEnableConditionRef = x1
        DemEnableConditionRef = x3
        DemEnableConditionRef = x3
      lock (DemEnableCondition): DemEnableConditionId=122, DemEnableConditionStatus=true
      VCU_ChargeStatus (DemEnableCondition): DemEnableConditionId=73, DemEnableConditionStatus=true
      EnableConditionGroup_eb032f9a (DemEnableConditionGroup):
        DemEnableConditionRef = All_001
        DemEnableConditionRef = Busoff
        DemEnableConditionRef = Conditions_001
        DemEnableConditionRef = Conditions_001
        DemEnableConditionRef = Confirmed
        DemEnableConditionRef = Confirmed
        DemEnableConditionRef = DTC
        DemEnableConditionRef = DTC
        DemEnableConditionRef = Enable_001
        DemEnableConditionRef = Enable_001
        DemEnableConditionRef = If
        DemEnableConditionRef = In_001
        DemEnableConditionRef = Lan
        DemEnableConditionRef = No
        DemEnableConditionRef = No
        DemEnableConditionRef = Note
        DemEnableConditionRef = PNC0
        DemEnableConditionRef = PNC03
        DemEnableConditionRef = PNC{13..15}
        DemEnableConditionRef = PNC31
        DemEnableConditionRef = Reset_001
        DemEnableConditionRef = T_Delay
        DemEnableConditionRef = T_Delay
        DemEnableConditionRef = T_Delay
        DemEnableConditionRef = The
        DemEnableConditionRef = The
        DemEnableConditionRef = V
        DemEnableConditionRef = V
        DemEnableConditionRef = abnormal
        DemEnableConditionRef = active
        DemEnableConditionRef = again
        DemEnableConditionRef = again
        DemEnableConditionRef = and
        DemEnableConditionRef = and
        DemEnableConditionRef = and
        DemEnableConditionRef = any
        DemEnableConditionRef = any
        DemEnableConditionRef = are
        DemEnableConditionRef = battery
        DemEnableConditionRef = condition
        DemEnableConditionRef = conditions
        DemEnableConditionRef = criteria
        DemEnableConditionRef = criteria
        DemEnableConditionRef = do
        DemEnableConditionRef = does
        DemEnableConditionRef = fault
        DemEnableConditionRef = following
        DemEnableConditionRef = for
        DemEnableConditionRef = from
        DemEnableConditionRef = if_001
        DemEnableConditionRef = in
        DemEnableConditionRef = in
        DemEnableConditionRef = is
        DemEnableConditionRef = is
        DemEnableConditionRef = last
        DemEnableConditionRef = meet
        DemEnableConditionRef = meet
        DemEnableConditionRef = met
        DemEnableConditionRef = ms
        DemEnableConditionRef = normal
        DemEnableConditionRef = not
        DemEnableConditionRef = not
        DemEnableConditionRef = of
        DemEnableConditionRef = of
        DemEnableConditionRef = or
        DemEnableConditionRef = or
        DemEnableConditionRef = process
        DemEnableConditionRef = recovered
        DemEnableConditionRef = recovers
        DemEnableConditionRef = requirements
        DemEnableConditionRef = requirements
        DemEnableConditionRef = reset
        DemEnableConditionRef = service
        DemEnableConditionRef = simultaneously
        DemEnableConditionRef = start
        DemEnableConditionRef = start
        DemEnableConditionRef = status
        DemEnableConditionRef = the_001
        DemEnableConditionRef = the_001
        DemEnableConditionRef = the_001
        DemEnableConditionRef = the_001
        DemEnableConditionRef = the_001
        DemEnableConditionRef = the_001
        DemEnableConditionRef = the_001
        DemEnableConditionRef = the_001
        DemEnableConditionRef = timer
        DemEnableConditionRef = timing
        DemEnableConditionRef = timing
        DemEnableConditionRef = to
        DemEnableConditionRef = to
        DemEnableConditionRef = to
        DemEnableConditionRef = voltage
        DemEnableConditionRef = voltage
      3 x DemEnableCondition, all with DemEnableConditionStatus=true:
        guns: DemEnableConditionId=117
        VCU_Enable_DC_Relay: DemEnableConditionId=75
        BRM: DemEnableConditionId=8
      EnableConditionGroup_c779eeed (DemEnableConditionGroup):
        DemEnableConditionRef = All_001
        DemEnableConditionRef = Busoff
        DemEnableConditionRef = Conditions_001
        DemEnableConditionRef = Conditions_001
        DemEnableConditionRef = Confirmed
        DemEnableConditionRef = Confirmed
        DemEnableConditionRef = DTC
        DemEnableConditionRef = DTC
        DemEnableConditionRef = Enable_001
        DemEnableConditionRef = Enable_001
        DemEnableConditionRef = If
        DemEnableConditionRef = In_001
        DemEnableConditionRef = KL15e
        DemEnableConditionRef = No
        DemEnableConditionRef = No
        DemEnableConditionRef = Note
        DemEnableConditionRef = ON_001
        DemEnableConditionRef = Reset_001
        DemEnableConditionRef = T_Delay
        DemEnableConditionRef = T_Delay
        DemEnableConditionRef = T_Delay
        DemEnableConditionRef = The
        DemEnableConditionRef = V
        DemEnableConditionRef = V
        DemEnableConditionRef = abnormal
        DemEnableConditionRef = active
        DemEnableConditionRef = again
        DemEnableConditionRef = again
        DemEnableConditionRef = and
        DemEnableConditionRef = and
        DemEnableConditionRef = and
        DemEnableConditionRef = any
        DemEnableConditionRef = any
        DemEnableConditionRef = are
        DemEnableConditionRef = battery
        DemEnableConditionRef = condition
        DemEnableConditionRef = conditions
        DemEnableConditionRef = criteria
        DemEnableConditionRef = criteria
        DemEnableConditionRef = do
        DemEnableConditionRef = does
        DemEnableConditionRef = fault
        DemEnableConditionRef = following
        DemEnableConditionRef = for
        DemEnableConditionRef = from
        DemEnableConditionRef = if_001
        DemEnableConditionRef = in
        DemEnableConditionRef = in
        DemEnableConditionRef = is
        DemEnableConditionRef = is
        DemEnableConditionRef = last
        DemEnableConditionRef = meet
        DemEnableConditionRef = meet
        DemEnableConditionRef = met
        DemEnableConditionRef = ms
        DemEnableConditionRef = normal
        DemEnableConditionRef = not
        DemEnableConditionRef = not
        DemEnableConditionRef = of
        DemEnableConditionRef = of
        DemEnableConditionRef = or
        DemEnableConditionRef = or
        DemEnableConditionRef = process
        DemEnableConditionRef = recovered
        DemEnableConditionRef = recovers
        DemEnableConditionRef = requirements
        DemEnableConditionRef = requirements
        DemEnableConditionRef = reset
        DemEnableConditionRef = service
        DemEnableConditionRef = simultaneously
        DemEnableConditionRef = start
        DemEnableConditionRef = start
        DemEnableConditionRef = status
        DemEnableConditionRef = status
        DemEnableConditionRef = the_001
        DemEnableConditionRef = the_001
        DemEnableConditionRef = the_001
        DemEnableConditionRef = the_001
        DemEnableConditionRef = the_001
        DemEnableConditionRef = the_001
        DemEnableConditionRef = the_001
        DemEnableConditionRef = the_001
        DemEnableConditionRef = timer
        DemEnableConditionRef = timing
        DemEnableConditionRef = timing
        DemEnableConditionRef = to
        DemEnableConditionRef = to
        DemEnableConditionRef = to
        DemEnableConditionRef = voltage
        DemEnableConditionRef = voltage
      ON_001 (DemEnableCondition): DemEnableConditionId=41, DemEnableConditionStatus=true
      electronic (DemEnableCondition): DemEnableConditionId=110, DemEnableConditionStatus=true
      EnableConditionGroup_048c220e (DemEnableConditionGroup):
        DemEnableConditionRef = Accelerator
        DemEnableConditionRef = If
        DemEnableConditionRef = No
        DemEnableConditionRef = Note
        DemEnableConditionRef = The
        DemEnableConditionRef = V
        DemEnableConditionRef = V
        DemEnableConditionRef = V
        DemEnableConditionRef = V
        DemEnableConditionRef = When
        DemEnableConditionRef = abnormal
        DemEnableConditionRef = accelerator_001
        DemEnableConditionRef = active
        DemEnableConditionRef = after
        DemEnableConditionRef = again
        DemEnableConditionRef = all
        DemEnableConditionRef = and
        DemEnableConditionRef = any
        DemEnableConditionRef = are
        DemEnableConditionRef = battery
        DemEnableConditionRef = be
        DemEnableConditionRef = being
        DemEnableConditionRef = completed
        DemEnableConditionRef = conditions
        DemEnableConditionRef = conditions
        DemEnableConditionRef = conditions
        DemEnableConditionRef = confirmation
        DemEnableConditionRef = diagnosis
        DemEnableConditionRef = diagnosis
        DemEnableConditionRef = during
        DemEnableConditionRef = enable
        DemEnableConditionRef = fault
        DemEnableConditionRef = fault
        DemEnableConditionRef = fault
        DemEnableConditionRef = for
        DemEnableConditionRef = from
        DemEnableConditionRef = is
        DemEnableConditionRef = is
        DemEnableConditionRef = is
        DemEnableConditionRef = is
        DemEnableConditionRef = is
        DemEnableConditionRef = met
        DemEnableConditionRef = met
        DemEnableConditionRef = ms
        DemEnableConditionRef = ms
        DemEnableConditionRef = normal
        DemEnableConditionRef = not
        DemEnableConditionRef = of
        DemEnableConditionRef = or
        DemEnableConditionRef = or
        DemEnableConditionRef = pedal
        DemEnableConditionRef = pedal
        DemEnableConditionRef = performed
        DemEnableConditionRef = pin1
        DemEnableConditionRef = pin2
        DemEnableConditionRef = process
        DemEnableConditionRef = recovers
        DemEnableConditionRef = restored
        DemEnableConditionRef = restored
        DemEnableConditionRef = service
        DemEnableConditionRef = shall
        DemEnableConditionRef = the_001
        DemEnableConditionRef = the_001
        DemEnableConditionRef = the_001
        DemEnableConditionRef = the_001
        DemEnableConditionRef = the_001
        DemEnableConditionRef = the_001
        DemEnableConditionRef = to
        DemEnableConditionRef = to
        DemEnableConditionRef = to
        DemEnableConditionRef = trigger
        DemEnableConditionRef = up
        DemEnableConditionRef = v_001
        DemEnableConditionRef = v_001
        DemEnableConditionRef = voltage
        DemEnableConditionRef = voltage
        DemEnableConditionRef = voltage
        DemEnableConditionRef = voltage
        DemEnableConditionRef = waked
      EnableConditionGroup_36bf5180 (DemEnableConditionGroup):
        DemEnableConditionRef = BMS
        DemEnableConditionRef = BMS_status
        DemEnableConditionRef = BRM
        DemEnableConditionRef = Chargestatus
        DemEnableConditionRef = DC
        DemEnableConditionRef = DC
        DemEnableConditionRef = DC
        DemEnableConditionRef = DC
        DemEnableConditionRef = Detected
        DemEnableConditionRef = High
        DemEnableConditionRef = If
        DemEnableConditionRef = No
        DemEnableConditionRef = Note
        DemEnableConditionRef = On
        DemEnableConditionRef = Plug
        DemEnableConditionRef = Plug
        DemEnableConditionRef = Power
        DemEnableConditionRef = The
        DemEnableConditionRef = V
        DemEnableConditionRef = V
        DemEnableConditionRef = VCU
        DemEnableConditionRef = VCU
        DemEnableConditionRef = When
        DemEnableConditionRef = abnormal
        DemEnableConditionRef = active
        DemEnableConditionRef = again
        DemEnableConditionRef = all
        DemEnableConditionRef = any
        DemEnableConditionRef = are
        DemEnableConditionRef = battery
        DemEnableConditionRef = be
        DemEnableConditionRef = charge
        DemEnableConditionRef = charge
        DemEnableConditionRef = completed
        DemEnableConditionRef = completed
        DemEnableConditionRef = conditions
        DemEnableConditionRef = conditions
        DemEnableConditionRef = conditions
        DemEnableConditionRef = confirmation
        DemEnableConditionRef = detected_001
        DemEnableConditionRef = diagnosis
        DemEnableConditionRef = diagnosis
        DemEnableConditionRef = during
        DemEnableConditionRef = enable
        DemEnableConditionRef = fault
        DemEnableConditionRef = fault
        DemEnableConditionRef = fault
        DemEnableConditionRef = for
        DemEnableConditionRef = for
        DemEnableConditionRef = from
        DemEnableConditionRef = is
        DemEnableConditionRef = is
        DemEnableConditionRef = is
        DemEnableConditionRef = is
        DemEnableConditionRef = is
        DemEnableConditionRef = message
        DemEnableConditionRef = met
        DemEnableConditionRef = met
        DemEnableConditionRef = ms
        DemEnableConditionRef = normal
        DemEnableConditionRef = not
        DemEnableConditionRef = of
        DemEnableConditionRef = or
        DemEnableConditionRef = or
        DemEnableConditionRef = performed
        DemEnableConditionRef = process
        DemEnableConditionRef = recovers
        DemEnableConditionRef = sends
        DemEnableConditionRef = service
        DemEnableConditionRef = shall
        DemEnableConditionRef = the_001
        DemEnableConditionRef = the_001
        DemEnableConditionRef = the_001
        DemEnableConditionRef = the_001
        DemEnableConditionRef = the_001
        DemEnableConditionRef = the_001
        DemEnableConditionRef = to
        DemEnableConditionRef = trigger
        DemEnableConditionRef = voltage
        DemEnableConditionRef = voltage
        DemEnableConditionRef = voltage
        DemEnableConditionRef = x3
        DemEnableConditionRef = x3
      VCU_MCURequestedState (DemEnableCondition): DemEnableConditionId=77, DemEnableConditionStatus=true
      DID_0x1d01_VCU_AccelerationPedal (DemDataClass): DemDataElementDataSize=1, DemDataElementDataType=UINT8, DemDataElementUsePort=USE_DATA_CLIENT_SERVER_PORT, DemDataElementStoreNonVolatile=true
      5 x DemEnableCondition, all with DemEnableConditionStatus=true:
        do: DemEnableConditionId=107
        Charging_001: DemEnableConditionId=13
        negative: DemEnableConditionId=128
        any: DemEnableConditionId=90
        recovers: DemEnableConditionId=144
      Gear (DemDidClass): DemDidIdentifier=61863, DemDidDataClassRef=DID_0xf1a7_Gear
      EnableConditionGroup_a88e97b7 (DemEnableConditionGroup):
        DemEnableConditionRef = Disable
        DemEnableConditionRef = If
        DemEnableConditionRef = No
        DemEnableConditionRef = Note
        DemEnableConditionRef = The
        DemEnableConditionRef = V
        DemEnableConditionRef = V
        DemEnableConditionRef = VCU_RequestedModeTCU
        DemEnableConditionRef = When
        DemEnableConditionRef = abnormal
        DemEnableConditionRef = active
        DemEnableConditionRef = after
        DemEnableConditionRef = again
        DemEnableConditionRef = all
        DemEnableConditionRef = any
        DemEnableConditionRef = are
        DemEnableConditionRef = battery
        DemEnableConditionRef = be
        DemEnableConditionRef = being
        DemEnableConditionRef = completed
        DemEnableConditionRef = conditions
        DemEnableConditionRef = conditions
        DemEnableConditionRef = conditions
        DemEnableConditionRef = confirmation
        DemEnableConditionRef = diagnosis
        DemEnableConditionRef = diagnosis
        DemEnableConditionRef = during
        DemEnableConditionRef = enable
        DemEnableConditionRef = fault
        DemEnableConditionRef = fault
        DemEnableConditionRef = fault
        DemEnableConditionRef = for
        DemEnableConditionRef = from
        DemEnableConditionRef = is
        DemEnableConditionRef = is
        DemEnableConditionRef = is
        DemEnableConditionRef = met
        DemEnableConditionRef = met
        DemEnableConditionRef = ms
        DemEnableConditionRef = ms
        DemEnableConditionRef = normal
        DemEnableConditionRef = not
        DemEnableConditionRef = of
        DemEnableConditionRef = or
        DemEnableConditionRef = or
        DemEnableConditionRef = performed
        DemEnableConditionRef = process
        DemEnableConditionRef = recovers
        DemEnableConditionRef = service
        DemEnableConditionRef = shall
        DemEnableConditionRef = the_001
        DemEnableConditionRef = the_001
        DemEnableConditionRef = the_001
        DemEnableConditionRef = the_001
        DemEnableConditionRef = the_001
        DemEnableConditionRef = the_001
        DemEnableConditionRef = to
        DemEnableConditionRef = trigger
        DemEnableConditionRef = up
        DemEnableConditionRef = voltage
        DemEnableConditionRef = voltage
        DemEnableConditionRef = waked
        DemEnableConditionRef = x2
      condition (DemEnableCondition): DemEnableConditionId=100, DemEnableConditionStatus=true
      EnableConditionGroup_71a7c053 (DemEnableConditionGroup):
        DemEnableConditionRef = All_001
        DemEnableConditionRef = Busoff
        DemEnableConditionRef = Conditions_001
        DemEnableConditionRef = Conditions_001
        DemEnableConditionRef = Confirmed
        DemEnableConditionRef = Confirmed
        DemEnableConditionRef = DTC
        DemEnableConditionRef = DTC
        DemEnableConditionRef = Enable_001
        DemEnableConditionRef = Enable_001
        DemEnableConditionRef = If
        DemEnableConditionRef = In_001
        DemEnableConditionRef = Lan
        DemEnableConditionRef = No
        DemEnableConditionRef = No
        DemEnableConditionRef = Note
        DemEnableConditionRef = PNC0
        DemEnableConditionRef = PNC03
        DemEnableConditionRef = PNC04
        DemEnableConditionRef = PNC{13..15}
        DemEnableConditionRef = PNC15
        DemEnableConditionRef = PNC16
        DemEnableConditionRef = PNC18
        DemEnableConditionRef = Reset_001
        DemEnableConditionRef = T_Delay
        DemEnableConditionRef = T_Delay
        DemEnableConditionRef = T_Delay
        DemEnableConditionRef = The
        DemEnableConditionRef = The
        DemEnableConditionRef = V
        DemEnableConditionRef = V
        DemEnableConditionRef = abnormal
        DemEnableConditionRef = active
        DemEnableConditionRef = again
        DemEnableConditionRef = again
        DemEnableConditionRef = and
        DemEnableConditionRef = and
        DemEnableConditionRef = and
        DemEnableConditionRef = any
        DemEnableConditionRef = any
        DemEnableConditionRef = are
        DemEnableConditionRef = battery
        DemEnableConditionRef = condition
        DemEnableConditionRef = conditions
        DemEnableConditionRef = criteria
        DemEnableConditionRef = criteria
        DemEnableConditionRef = do
        DemEnableConditionRef = does
        DemEnableConditionRef = fault
        DemEnableConditionRef = following
        DemEnableConditionRef = for
        DemEnableConditionRef = from
        DemEnableConditionRef = if_001
        DemEnableConditionRef = in
        DemEnableConditionRef = in
        DemEnableConditionRef = is
        DemEnableConditionRef = is
        DemEnableConditionRef = last
        DemEnableConditionRef = meet
        DemEnableConditionRef = meet
        DemEnableConditionRef = met
        DemEnableConditionRef = ms
        DemEnableConditionRef = normal
        DemEnableConditionRef = not
        DemEnableConditionRef = not
        DemEnableConditionRef = of
        DemEnableConditionRef = of
        DemEnableConditionRef = or
        DemEnableConditionRef = or
        DemEnableConditionRef = process
        DemEnableConditionRef = recovered
        DemEnableConditionRef = recovers
        DemEnableConditionRef = requirements
        DemEnableConditionRef = requirements
        DemEnableConditionRef = reset
        DemEnableConditionRef = service
        DemEnableConditionRef = simultaneously
        DemEnableConditionRef = start
        DemEnableConditionRef = start
        DemEnableConditionRef = status
        DemEnableConditionRef = the_001
        DemEnableConditionRef = the_001
        DemEnableConditionRef = the_001
        DemEnableConditionRef = the_001
        DemEnableConditionRef = the_001
        DemEnableConditionRef = the_001
        DemEnableConditionRef = the_001
        DemEnableConditionRef = the_001
        DemEnableConditionRef = timer
        DemEnableConditionRef = timing
        DemEnableConditionRef = timing
        DemEnableConditionRef = to
        DemEnableConditionRef = to
        DemEnableConditionRef = to
        DemEnableConditionRef = voltage
        DemEnableConditionRef = voltage
      4 x DemEnableCondition, all with DemEnableConditionStatus=true:
        Confirmed: DemEnableConditionId=16
        When: DemEnableConditionId=82
        up: DemEnableConditionId=167
        met: DemEnableConditionId=126
      DID_0x1d05_POD_OBC_OutputDCChargeVoltage (DemDataClass):
        DemDataElementDataSize = 2
        DemDataElementDataType = UINT16
        DemDataElementEndianness = BIG_ENDIAN
        DemDataElementUsePort = USE_DATA_CLIENT_SERVER_PORT
        DemDataElementStoreNonVolatile = true
      and (DemEnableCondition): DemEnableConditionId=89, DemEnableConditionStatus=true
      SOC (DemDidClass): DemDidIdentifier=61862, DemDidDataClassRef=DID_0xf1a6_SOC
      timing (DemEnableCondition): DemEnableConditionId=164, DemEnableConditionStatus=true
      EnableConditionGroup_c98c13ed (DemEnableConditionGroup):
        DemEnableConditionRef = AC
        DemEnableConditionRef = BMS
        DemEnableConditionRef = DC
        DemEnableConditionRef = Detected
        DemEnableConditionRef = Detected
        DemEnableConditionRef = If
        DemEnableConditionRef = No
        DemEnableConditionRef = Note
        DemEnableConditionRef = Open
        DemEnableConditionRef = Plug
        DemEnableConditionRef = Plug
        DemEnableConditionRef = The
        DemEnableConditionRef = V
        DemEnableConditionRef = V
        DemEnableConditionRef = VCU
        DemEnableConditionRef = VCU_BMS_Control_of_NegRelay
        DemEnableConditionRef = VCU_ChargeStatus
        DemEnableConditionRef = When
        DemEnableConditionRef = abnormal
        DemEnableConditionRef = active
        DemEnableConditionRef = again
        DemEnableConditionRef = all
        DemEnableConditionRef = any
        DemEnableConditionRef = are
        DemEnableConditionRef = battery
        DemEnableConditionRef = be
        DemEnableConditionRef = completed
        DemEnableConditionRef = conditions
        DemEnableConditionRef = conditions
        DemEnableConditionRef = conditions
        DemEnableConditionRef = confirmation
        DemEnableConditionRef = diagnosis
        DemEnableConditionRef = diagnosis
        DemEnableConditionRef = disconnect
        DemEnableConditionRef = during
        DemEnableConditionRef = enable
        DemEnableConditionRef = fault
        DemEnableConditionRef = fault
        DemEnableConditionRef = fault
        DemEnableConditionRef = for
        DemEnableConditionRef = from
        DemEnableConditionRef = is
        DemEnableConditionRef = is
        DemEnableConditionRef = is
        DemEnableConditionRef = main
        DemEnableConditionRef = met
        DemEnableConditionRef = met
        DemEnableConditionRef = ms
        DemEnableConditionRef = negative
        DemEnableConditionRef = normal
        DemEnableConditionRef = not
        DemEnableConditionRef = of
        DemEnableConditionRef = or
        DemEnableConditionRef = or
        DemEnableConditionRef = performed
        DemEnableConditionRef = process
        DemEnableConditionRef = recovers
        DemEnableConditionRef = relay
        DemEnableConditionRef = requests
        DemEnableConditionRef = service
        DemEnableConditionRef = shall
        DemEnableConditionRef = the_001
        DemEnableConditionRef = the_001
        DemEnableConditionRef = the_001
        DemEnableConditionRef = the_001
        DemEnableConditionRef = the_001
        DemEnableConditionRef = the_001
        DemEnableConditionRef = the_001
        DemEnableConditionRef = the_001
        DemEnableConditionRef = to
        DemEnableConditionRef = to
        DemEnableConditionRef = trigger
        DemEnableConditionRef = voltage
        DemEnableConditionRef = voltage
        DemEnableConditionRef = x{1..3}
      EnableConditionGroup_d1c785ea (DemEnableConditionGroup):
        DemEnableConditionRef = All_001
        DemEnableConditionRef = Being_001
        DemEnableConditionRef = Conditions_001
        DemEnableConditionRef = Conditions_001
        DemEnableConditionRef = Confirmed
        DemEnableConditionRef = Confirmed
        DemEnableConditionRef = DTC
        DemEnableConditionRef = DTC
        DemEnableConditionRef = Enable_001
        DemEnableConditionRef = Enable_001
        DemEnableConditionRef = If
        DemEnableConditionRef = In_001
        DemEnableConditionRef = No
        DemEnableConditionRef = Note
        DemEnableConditionRef = Reset_001
        DemEnableConditionRef = T_Delay
        DemEnableConditionRef = T_Delay
        DemEnableConditionRef = T_Delay
        DemEnableConditionRef = The
        DemEnableConditionRef = V
        DemEnableConditionRef = V
        DemEnableConditionRef = abnormal
        DemEnableConditionRef = active
        DemEnableConditionRef = again
        DemEnableConditionRef = again
        DemEnableConditionRef = and
        DemEnableConditionRef = and
        DemEnableConditionRef = and
        DemEnableConditionRef = any
        DemEnableConditionRef = any
        DemEnableConditionRef = are
        DemEnableConditionRef = battery
        DemEnableConditionRef = condition
        DemEnableConditionRef = conditions
        DemEnableConditionRef = criteria
        DemEnableConditionRef = criteria
        DemEnableConditionRef = do
        DemEnableConditionRef = does
        DemEnableConditionRef = fault
        DemEnableConditionRef = following
        DemEnableConditionRef = for
        DemEnableConditionRef = from
        DemEnableConditionRef = if_001
        DemEnableConditionRef = in
        DemEnableConditionRef = in
        DemEnableConditionRef = is
        DemEnableConditionRef = last
        DemEnableConditionRef = meet
        DemEnableConditionRef = meet
        DemEnableConditionRef = met
        DemEnableConditionRef = ms
        DemEnableConditionRef = normal
        DemEnableConditionRef = not
        DemEnableConditionRef = not
        DemEnableConditionRef = of
        DemEnableConditionRef = of
        DemEnableConditionRef = or
        DemEnableConditionRef = or
        DemEnableConditionRef = process
        DemEnableConditionRef = recovered
        DemEnableConditionRef = recovers
        DemEnableConditionRef = requirements
        DemEnableConditionRef = requirements
        DemEnableConditionRef = reset
        DemEnableConditionRef = service
        DemEnableConditionRef = simultaneously
        DemEnableConditionRef = start
        DemEnableConditionRef = start
        DemEnableConditionRef = the_001
        DemEnableConditionRef = the_001
        DemEnableConditionRef = the_001
        DemEnableConditionRef = the_001
        DemEnableConditionRef = the_001
        DemEnableConditionRef = the_001
        DemEnableConditionRef = the_001
        DemEnableConditionRef = the_001
        DemEnableConditionRef = timer
        DemEnableConditionRef = timing
        DemEnableConditionRef = timing
        DemEnableConditionRef = to
        DemEnableConditionRef = to
        DemEnableConditionRef = to
        DemEnableConditionRef = up
        DemEnableConditionRef = voltage
        DemEnableConditionRef = voltage
        DemEnableConditionRef = waked
      Disable (DemEnableCondition): DemEnableConditionId=21, DemEnableConditionStatus=true
      VCU_HVStatus (DemDidClass): DemDidIdentifier=61861, DemDidDataClassRef=DID_0xf1a5_VCU_HVStatus
      x0 (DemEnableCondition): DemEnableConditionId=171, DemEnableConditionStatus=true
      x1 (DemEnableCondition): DemEnableConditionId=172, DemEnableConditionStatus=true
      ExtendedData_Fault_Ocurrence_Counter (DemDataClass): DemDataElementDataSize=1, DemDataElementDataType=UINT8, DemDataElementUsePort=USE_DATA_CLIENT_SERVER_PORT, DemDataElementStoreNonVolatile=true
      WarningIndicator (DemIndicator): DemIndicatorID=0
      3 x DemEnableCondition, all with DemEnableConditionStatus=true:
        reset: DemEnableConditionId=149
        ModeRequestDCDC: DemEnableConditionId=36
        BMS_status: DemEnableConditionId=7
      EnableConditionGroup_fc6b8fc4 (DemEnableConditionGroup):
        DemEnableConditionRef = HVActive
        DemEnableConditionRef = If
        DemEnableConditionRef = No
        DemEnableConditionRef = Note
        DemEnableConditionRef = The
        DemEnableConditionRef = V
        DemEnableConditionRef = V
        DemEnableConditionRef = VCU_RequestedModeBMS
        DemEnableConditionRef = When
        DemEnableConditionRef = abnormal
        DemEnableConditionRef = active
        DemEnableConditionRef = after
        DemEnableConditionRef = again
        DemEnableConditionRef = all
        DemEnableConditionRef = any
        DemEnableConditionRef = are
        DemEnableConditionRef = battery
        DemEnableConditionRef = be
        DemEnableConditionRef = being
        DemEnableConditionRef = completed
        DemEnableConditionRef = conditions
        DemEnableConditionRef = conditions
        DemEnableConditionRef = conditions
        DemEnableConditionRef = confirmation
        DemEnableConditionRef = diagnosis
        DemEnableConditionRef = diagnosis
        DemEnableConditionRef = during
        DemEnableConditionRef = enable
        DemEnableConditionRef = fault
        DemEnableConditionRef = fault
        DemEnableConditionRef = fault
        DemEnableConditionRef = for
        DemEnableConditionRef = from
        DemEnableConditionRef = is
        DemEnableConditionRef = is
        DemEnableConditionRef = is
        DemEnableConditionRef = met
        DemEnableConditionRef = met
        DemEnableConditionRef = ms
        DemEnableConditionRef = ms
        DemEnableConditionRef = normal
        DemEnableConditionRef = not
        DemEnableConditionRef = of
        DemEnableConditionRef = or
        DemEnableConditionRef = or
        DemEnableConditionRef = performed
        DemEnableConditionRef = process
        DemEnableConditionRef = recovers
        DemEnableConditionRef = service
        DemEnableConditionRef = shall
        DemEnableConditionRef = the_001
        DemEnableConditionRef = the_001
        DemEnableConditionRef = the_001
        DemEnableConditionRef = the_001
        DemEnableConditionRef = the_001
        DemEnableConditionRef = the_001
        DemEnableConditionRef = to
        DemEnableConditionRef = trigger
        DemEnableConditionRef = up
        DemEnableConditionRef = voltage
        DemEnableConditionRef = voltage
        DemEnableConditionRef = waked
        DemEnableConditionRef = x1
      active (DemEnableCondition): DemEnableConditionId=85, DemEnableConditionStatus=true
      requirements (DemEnableCondition): DemEnableConditionId=148, DemEnableConditionStatus=true
      S2_status (DemDidClass): DemDidIdentifier=7433, DemDidDataClassRef=DID_0x1d09_New_Bit_Field
      pedal (DemEnableCondition): DemEnableConditionId=135, DemEnableConditionStatus=true
      EnableConditionGroup_54eb9fcb (DemEnableConditionGroup):
        DemEnableConditionRef = If
        DemEnableConditionRef = MCU_VCUWorkMode
        DemEnableConditionRef = No
        DemEnableConditionRef = Note
        DemEnableConditionRef = Ready
        DemEnableConditionRef = Standby
        DemEnableConditionRef = The
        DemEnableConditionRef = V
        DemEnableConditionRef = V
        DemEnableConditionRef = VCU_MCURequestedState
        DemEnableConditionRef = When
        DemEnableConditionRef = abnormal
        DemEnableConditionRef = active
        DemEnableConditionRef = after
        DemEnableConditionRef = again
        DemEnableConditionRef = all
        DemEnableConditionRef = any
        DemEnableConditionRef = are
        DemEnableConditionRef = battery
        DemEnableConditionRef = be
        DemEnableConditionRef = being
        DemEnableConditionRef = completed
        DemEnableConditionRef = conditions
        DemEnableConditionRef = conditions
        DemEnableConditionRef = conditions
        DemEnableConditionRef = confirmation
        DemEnableConditionRef = diagnosis
        DemEnableConditionRef = diagnosis
        DemEnableConditionRef = during
        DemEnableConditionRef = enable
        DemEnableConditionRef = fault
        DemEnableConditionRef = fault
        DemEnableConditionRef = fault
        DemEnableConditionRef = for
        DemEnableConditionRef = from
        DemEnableConditionRef = is
        DemEnableConditionRef = is
        DemEnableConditionRef = is
        DemEnableConditionRef = met
        DemEnableConditionRef = met
        DemEnableConditionRef = ms
        DemEnableConditionRef = ms
        DemEnableConditionRef = normal
        DemEnableConditionRef = not
        DemEnableConditionRef = of
        DemEnableConditionRef = or
        DemEnableConditionRef = or
        DemEnableConditionRef = performed
        DemEnableConditionRef = process
        DemEnableConditionRef = recovers
        DemEnableConditionRef = service
        DemEnableConditionRef = shall
        DemEnableConditionRef = the_001
        DemEnableConditionRef = the_001
        DemEnableConditionRef = the_001
        DemEnableConditionRef = the_001
        DemEnableConditionRef = the_001
        DemEnableConditionRef = the_001
        DemEnableConditionRef = to
        DemEnableConditionRef = trigger
        DemEnableConditionRef = up
        DemEnableConditionRef = voltage
        DemEnableConditionRef = voltage
        DemEnableConditionRef = waked
        DemEnableConditionRef = x0
        DemEnableConditionRef = x1
      5 x DemEnableCondition, all with DemEnableConditionStatus=true:
        x4: DemEnableConditionId=175
        Standby: DemEnableConditionId=64
        x5: DemEnableConditionId=176
        x2: DemEnableConditionId=173
        x3: DemEnableConditionId=174
      FreezeFrameClass_d96350db (DemFreezeFrameClass):
        DemDidClassRef = Ignition_Switch_Signal
        DemDidClassRef = Battery_Voltage
        DemDidClassRef = Total_Odometer
        DemDidClassRef = Vehicle_speed
        DemDidClassRef = Date_And_Time
        DemDidClassRef = VCU_HVStatus
        DemDidClassRef = SOC
        DemDidClassRef = Gear
        DemDidClassRef = AC_charging_parameter
      3 x DemEnableCondition, all with DemEnableConditionStatus=true:
        timer: DemEnableConditionId=162
        criteria: DemEnableConditionId=103
        times: DemEnableConditionId=163
      FreezeFrameClass_5f5b5001 (DemFreezeFrameClass):
        DemDidClassRef = Ignition_Switch_Signal
        DemDidClassRef = Battery_Voltage
        DemDidClassRef = Total_Odometer
        DemDidClassRef = Vehicle_speed
        DemDidClassRef = Date_And_Time
        DemDidClassRef = VCU_HVStatus
        DemDidClassRef = SOC
        DemDidClassRef = Gear
      DID_0x1d08_VCU_HVIL (DemDataClass): DemDataElementDataSize=1, DemDataElementDataType=UINT8, DemDataElementUsePort=USE_DATA_CLIENT_SERVER_PORT, DemDataElementStoreNonVolatile=true
      EnableConditionGroup_be914dc6 (DemEnableConditionGroup):
        DemEnableConditionRef = All_001
        DemEnableConditionRef = Busoff
        DemEnableConditionRef = Conditions_001
        DemEnableConditionRef = Conditions_001
        DemEnableConditionRef = Confirmed
        DemEnableConditionRef = Confirmed
        DemEnableConditionRef = DTC
        DemEnableConditionRef = DTC
        DemEnableConditionRef = Enable_001
        DemEnableConditionRef = Enable_001
        DemEnableConditionRef = If
        DemEnableConditionRef = In_001
        DemEnableConditionRef = KL15E_001
        DemEnableConditionRef = No
        DemEnableConditionRef = No
        DemEnableConditionRef = Note
        DemEnableConditionRef = ON_001
        DemEnableConditionRef = Reset_001
        DemEnableConditionRef = T_Delay
        DemEnableConditionRef = T_Delay
        DemEnableConditionRef = T_Delay
        DemEnableConditionRef = The
        DemEnableConditionRef = V
        DemEnableConditionRef = V
        DemEnableConditionRef = abnormal
        DemEnableConditionRef = active
        DemEnableConditionRef = again
        DemEnableConditionRef = again
        DemEnableConditionRef = and
        DemEnableConditionRef = and
        DemEnableConditionRef = and
        DemEnableConditionRef = any
        DemEnableConditionRef = any
        DemEnableConditionRef = are
        DemEnableConditionRef = battery
        DemEnableConditionRef = condition
        DemEnableConditionRef = conditions
        DemEnableConditionRef = criteria
        DemEnableConditionRef = criteria
        DemEnableConditionRef = do
        DemEnableConditionRef = does
        DemEnableConditionRef = fault
        DemEnableConditionRef = following
        DemEnableConditionRef = for
        DemEnableConditionRef = from
        DemEnableConditionRef = if_001
        DemEnableConditionRef = in
        DemEnableConditionRef = in
        DemEnableConditionRef = is
        DemEnableConditionRef = is
        DemEnableConditionRef = last
        DemEnableConditionRef = meet
        DemEnableConditionRef = meet
        DemEnableConditionRef = met
        DemEnableConditionRef = ms
        DemEnableConditionRef = normal
        DemEnableConditionRef = not
        DemEnableConditionRef = not
        DemEnableConditionRef = of
        DemEnableConditionRef = of
        DemEnableConditionRef = or
        DemEnableConditionRef = or
        DemEnableConditionRef = process
        DemEnableConditionRef = recovered
        DemEnableConditionRef = recovers
        DemEnableConditionRef = requirements
        DemEnableConditionRef = requirements
        DemEnableConditionRef = reset
        DemEnableConditionRef = service
        DemEnableConditionRef = simultaneously
        DemEnableConditionRef = start
        DemEnableConditionRef = start
        DemEnableConditionRef = status
        DemEnableConditionRef = status
        DemEnableConditionRef = the_001
        DemEnableConditionRef = the_001
        DemEnableConditionRef = the_001
        DemEnableConditionRef = the_001
        DemEnableConditionRef = the_001
        DemEnableConditionRef = the_001
        DemEnableConditionRef = the_001
        DemEnableConditionRef = the_001
        DemEnableConditionRef = timer
        DemEnableConditionRef = timing
        DemEnableConditionRef = timing
        DemEnableConditionRef = to
        DemEnableConditionRef = to
        DemEnableConditionRef = to
        DemEnableConditionRef = voltage
        DemEnableConditionRef = voltage
      DID_0xf1a4_Date_And_Time_Year (DemDataClass): DemDataElementDataSize=1, DemDataElementDataType=UINT8, DemDataElementUsePort=USE_DATA_CLIENT_SERVER_PORT, DemDataElementStoreNonVolatile=true
      Non (DemEnableCondition): DemEnableConditionId=38, DemEnableConditionStatus=true
      EnableConditionGroup_81b679fb (DemEnableConditionGroup):
        DemEnableConditionRef = If
        DemEnableConditionRef = No
        DemEnableConditionRef = Note
        DemEnableConditionRef = The
        DemEnableConditionRef = TrqCtrl
        DemEnableConditionRef = V
        DemEnableConditionRef = V
        DemEnableConditionRef = VCU_MCURequestedState
        DemEnableConditionRef = When
        DemEnableConditionRef = abnormal
        DemEnableConditionRef = active
        DemEnableConditionRef = after
        DemEnableConditionRef = again
        DemEnableConditionRef = all
        DemEnableConditionRef = any
        DemEnableConditionRef = are
        DemEnableConditionRef = battery
        DemEnableConditionRef = be
        DemEnableConditionRef = being
        DemEnableConditionRef = completed
        DemEnableConditionRef = conditions
        DemEnableConditionRef = conditions
        DemEnableConditionRef = conditions
        DemEnableConditionRef = confirmation
        DemEnableConditionRef = diagnosis
        DemEnableConditionRef = diagnosis
        DemEnableConditionRef = during
        DemEnableConditionRef = enable
        DemEnableConditionRef = fault
        DemEnableConditionRef = fault
        DemEnableConditionRef = fault
        DemEnableConditionRef = for
        DemEnableConditionRef = from
        DemEnableConditionRef = is
        DemEnableConditionRef = is
        DemEnableConditionRef = is
        DemEnableConditionRef = met
        DemEnableConditionRef = met
        DemEnableConditionRef = ms
        DemEnableConditionRef = ms
        DemEnableConditionRef = normal
        DemEnableConditionRef = not
        DemEnableConditionRef = of
        DemEnableConditionRef = or
        DemEnableConditionRef = or
        DemEnableConditionRef = performed
        DemEnableConditionRef = process
        DemEnableConditionRef = recovers
        DemEnableConditionRef = service
        DemEnableConditionRef = shall
        DemEnableConditionRef = the_001
        DemEnableConditionRef = the_001
        DemEnableConditionRef = the_001
        DemEnableConditionRef = the_001
        DemEnableConditionRef = the_001
        DemEnableConditionRef = the_001
        DemEnableConditionRef = to
        DemEnableConditionRef = trigger
        DemEnableConditionRef = up
        DemEnableConditionRef = voltage
        DemEnableConditionRef = voltage
        DemEnableConditionRef = waked
        DemEnableConditionRef = x1
      confirmation (DemEnableCondition): DemEnableConditionId=102, DemEnableConditionStatus=true
      AC_charging_parameter (DemDidClass):
        DemDidIdentifier = 7429
        DemDidDataClassRef = DID_0x1d05_POD_OBC_InputACVoltage
        DemDidDataClassRef = DID_0x1d05_VCU_OBC_ChargeCurrentCommand
        DemDidDataClassRef = DID_0x1d05_POD_OBC_OutputDCChargeCurrent
        DemDidDataClassRef = DID_0x1d05_POD_OBC_OutputDCChargeVoltage
      4 x DemEnableCondition, all with DemEnableConditionStatus=true:
        trigger: DemEnableConditionId=166
        simultaneously: DemEnableConditionId=157
        InActive: DemEnableConditionId=27
        battery: DemEnableConditionId=92
      DID_0xf1a4_Date_And_Time_Month (DemDataClass): DemDataElementDataSize=1, DemDataElementDataType=UINT8, DemDataElementUsePort=USE_DATA_CLIENT_SERVER_PORT, DemDataElementStoreNonVolatile=true
      FreezeFrameClass_c715a583 (DemFreezeFrameClass):
        DemDidClassRef = Ignition_Switch_Signal
        DemDidClassRef = Battery_Voltage
        DemDidClassRef = Total_Odometer
        DemDidClassRef = Vehicle_speed
        DemDidClassRef = Date_And_Time
        DemDidClassRef = VCU_HVStatus
        DemDidClassRef = SOC
        DemDidClassRef = Gear
        DemDidClassRef = VCU_control_main_relay
      DID_0xf1a4_Date_And_Time_Second (DemDataClass): DemDataElementDataSize=1, DemDataElementDataType=UINT8, DemDataElementUsePort=USE_DATA_CLIENT_SERVER_PORT, DemDataElementStoreNonVolatile=true
      EnableConditionGroup_93df7d19 (DemEnableConditionGroup):
        DemEnableConditionRef = If
        DemEnableConditionRef = No
        DemEnableConditionRef = Note
        DemEnableConditionRef = When
        DemEnableConditionRef = active
        DemEnableConditionRef = after
        DemEnableConditionRef = again
        DemEnableConditionRef = all
        DemEnableConditionRef = any
        DemEnableConditionRef = are
        DemEnableConditionRef = be
        DemEnableConditionRef = being
        DemEnableConditionRef = completed
        DemEnableConditionRef = conditions
        DemEnableConditionRef = conditions
        DemEnableConditionRef = conditions
        DemEnableConditionRef = confirmation
        DemEnableConditionRef = diagnosis
        DemEnableConditionRef = diagnosis
        DemEnableConditionRef = during
        DemEnableConditionRef = enable
        DemEnableConditionRef = fault
        DemEnableConditionRef = fault
        DemEnableConditionRef = fault
        DemEnableConditionRef = is
        DemEnableConditionRef = is
        DemEnableConditionRef = met
        DemEnableConditionRef = met
        DemEnableConditionRef = ms
        DemEnableConditionRef = not
        DemEnableConditionRef = of
        DemEnableConditionRef = or
        DemEnableConditionRef = performed
        DemEnableConditionRef = process
        DemEnableConditionRef = service
        DemEnableConditionRef = shall
        DemEnableConditionRef = the_001
        DemEnableConditionRef = the_001
        DemEnableConditionRef = the_001
        DemEnableConditionRef = the_001
        DemEnableConditionRef = the_001
        DemEnableConditionRef = trigger
        DemEnableConditionRef = up
        DemEnableConditionRef = waked
      6 x DemEnableCondition, all with DemEnableConditionStatus=true:
        main: DemEnableConditionId=123
        from: DemEnableConditionId=115
        Plug: DemEnableConditionId=58
        waked: DemEnableConditionId=170
        charge: DemEnableConditionId=95
        process: DemEnableConditionId=142
      EnableConditionGroup_d57a23d8 (DemEnableConditionGroup):
        DemEnableConditionRef = If
        DemEnableConditionRef = No
        DemEnableConditionRef = Note
        DemEnableConditionRef = The
        DemEnableConditionRef = V
        DemEnableConditionRef = V
        DemEnableConditionRef = When
        DemEnableConditionRef = abnormal
        DemEnableConditionRef = active
        DemEnableConditionRef = after
        DemEnableConditionRef = again
        DemEnableConditionRef = all
        DemEnableConditionRef = any
        DemEnableConditionRef = are
        DemEnableConditionRef = battery
        DemEnableConditionRef = be
        DemEnableConditionRef = being
        DemEnableConditionRef = completed
        DemEnableConditionRef = conditions
        DemEnableConditionRef = conditions
        DemEnableConditionRef = conditions
        DemEnableConditionRef = confirmation
        DemEnableConditionRef = diagnosis
        DemEnableConditionRef = diagnosis
        DemEnableConditionRef = during
        DemEnableConditionRef = enable
        DemEnableConditionRef = fault
        DemEnableConditionRef = fault
        DemEnableConditionRef = fault
        DemEnableConditionRef = for
        DemEnableConditionRef = from
        DemEnableConditionRef = is
        DemEnableConditionRef = is
        DemEnableConditionRef = is
        DemEnableConditionRef = met
        DemEnableConditionRef = met
        DemEnableConditionRef = ms
        DemEnableConditionRef = ms
        DemEnableConditionRef = normal
        DemEnableConditionRef = not
        DemEnableConditionRef = of
        DemEnableConditionRef = or
        DemEnableConditionRef = or
        DemEnableConditionRef = performed
        DemEnableConditionRef = process
        DemEnableConditionRef = recovers
        DemEnableConditionRef = service
        DemEnableConditionRef = shall
        DemEnableConditionRef = the_001
        DemEnableConditionRef = the_001
        DemEnableConditionRef = the_001
        DemEnableConditionRef = the_001
        DemEnableConditionRef = the_001
        DemEnableConditionRef = the_001
        DemEnableConditionRef = to
        DemEnableConditionRef = trigger
        DemEnableConditionRef = up
        DemEnableConditionRef = voltage
        DemEnableConditionRef = voltage
        DemEnableConditionRef = waked
      7 x DemEnableCondition, all with DemEnableConditionStatus=true:
        Chargestatus: DemEnableConditionId=12
        during: DemEnableConditionId=109
        KL15e: DemEnableConditionId=31
        only: DemEnableConditionId=132
        MCU_VCUWorkMode: DemEnableConditionId=35
        High: DemEnableConditionId=25
        Torque: DemEnableConditionId=67
      EnableConditionGroup_b2ccc4ca (DemEnableConditionGroup):
        DemEnableConditionRef = AC
        DemEnableConditionRef = BMS
        DemEnableConditionRef = Close
        DemEnableConditionRef = Close
        DemEnableConditionRef = DC
        DemEnableConditionRef = Detected
        DemEnableConditionRef = Detected
        DemEnableConditionRef = If
        DemEnableConditionRef = No
        DemEnableConditionRef = Note
        DemEnableConditionRef = Plug
        DemEnableConditionRef = Plug
        DemEnableConditionRef = The
        DemEnableConditionRef = V
        DemEnableConditionRef = V
        DemEnableConditionRef = VCU
        DemEnableConditionRef = VCU_BMS_Control_of_NegRelay
        DemEnableConditionRef = VCU_ChargeStatus
        DemEnableConditionRef = When
        DemEnableConditionRef = abnormal
        DemEnableConditionRef = active
        DemEnableConditionRef = again
        DemEnableConditionRef = all
        DemEnableConditionRef = any
        DemEnableConditionRef = are
        DemEnableConditionRef = battery
        DemEnableConditionRef = be
        DemEnableConditionRef = completed
        DemEnableConditionRef = conditions
        DemEnableConditionRef = conditions
        DemEnableConditionRef = conditions
        DemEnableConditionRef = confirmation
        DemEnableConditionRef = diagnosis
        DemEnableConditionRef = diagnosis
        DemEnableConditionRef = during
        DemEnableConditionRef = enable
        DemEnableConditionRef = fault
        DemEnableConditionRef = fault
        DemEnableConditionRef = fault
        DemEnableConditionRef = for
        DemEnableConditionRef = from
        DemEnableConditionRef = is
        DemEnableConditionRef = is
        DemEnableConditionRef = is
        DemEnableConditionRef = main
        DemEnableConditionRef = met
        DemEnableConditionRef = met
        DemEnableConditionRef = ms
        DemEnableConditionRef = normal
        DemEnableConditionRef = not
        DemEnableConditionRef = of
        DemEnableConditionRef = or
        DemEnableConditionRef = or
        DemEnableConditionRef = performed
        DemEnableConditionRef = positive
        DemEnableConditionRef = process
        DemEnableConditionRef = recovers
        DemEnableConditionRef = relay
        DemEnableConditionRef = requests
        DemEnableConditionRef = service
        DemEnableConditionRef = shall
        DemEnableConditionRef = the_001
        DemEnableConditionRef = the_001
        DemEnableConditionRef = the_001
        DemEnableConditionRef = the_001
        DemEnableConditionRef = the_001
        DemEnableConditionRef = the_001
        DemEnableConditionRef = the_001
        DemEnableConditionRef = the_001
        DemEnableConditionRef = to
        DemEnableConditionRef = to
        DemEnableConditionRef = trigger
        DemEnableConditionRef = voltage
        DemEnableConditionRef = voltage
        DemEnableConditionRef = x2
        DemEnableConditionRef = x2
        DemEnableConditionRef = x3
      PowerCycle (DemOperationCycle): DemOperationCycleType=DEM_OPCYC_POWER, DemOperationCycleAutomaticEnd=false, DemOperationCycleAutostart=false
      V (DemEnableCondition): DemEnableConditionId=69, DemEnableConditionStatus=true
      DID_0x1d11_Mainrelay2 (DemDataClass): DemDataElementDataSize=1, DemDataElementDataType=UINT8, DemDataElementUsePort=USE_DATA_CLIENT_SERVER_PORT, DemDataElementStoreNonVolatile=true
      3 x DemEnableCondition, all with DemEnableConditionStatus=true:
        serviceNote: DemEnableConditionId=154
        VCU_BMS_Control_of_NegRelay: DemEnableConditionId=72
        sends: DemEnableConditionId=152
      EnableConditionGroup_9ac8c945 (DemEnableConditionGroup):
        DemEnableConditionRef = All_001
        DemEnableConditionRef = Busoff
        DemEnableConditionRef = Conditions_001
        DemEnableConditionRef = Conditions_001
        DemEnableConditionRef = Confirmed
        DemEnableConditionRef = Confirmed
        DemEnableConditionRef = DTC
        DemEnableConditionRef = DTC
        DemEnableConditionRef = Enable_001
        DemEnableConditionRef = Enable_001
        DemEnableConditionRef = If
        DemEnableConditionRef = In_001
        DemEnableConditionRef = Lan
        DemEnableConditionRef = No
        DemEnableConditionRef = No
        DemEnableConditionRef = Note
        DemEnableConditionRef = PNC0
        DemEnableConditionRef = Reset_001
        DemEnableConditionRef = T_Delay
        DemEnableConditionRef = T_Delay
        DemEnableConditionRef = T_Delay
        DemEnableConditionRef = The
        DemEnableConditionRef = The
        DemEnableConditionRef = V
        DemEnableConditionRef = V
        DemEnableConditionRef = abnormal
        DemEnableConditionRef = active
        DemEnableConditionRef = again
        DemEnableConditionRef = again
        DemEnableConditionRef = and
        DemEnableConditionRef = and
        DemEnableConditionRef = and
        DemEnableConditionRef = any
        DemEnableConditionRef = any
        DemEnableConditionRef = are
        DemEnableConditionRef = battery
        DemEnableConditionRef = condition
        DemEnableConditionRef = conditions
        DemEnableConditionRef = criteria
        DemEnableConditionRef = criteria
        DemEnableConditionRef = do
        DemEnableConditionRef = does
        DemEnableConditionRef = fault
        DemEnableConditionRef = following
        DemEnableConditionRef = for
        DemEnableConditionRef = from
        DemEnableConditionRef = if_001
        DemEnableConditionRef = in
        DemEnableConditionRef = in
        DemEnableConditionRef = is
        DemEnableConditionRef = is
        DemEnableConditionRef = last
        DemEnableConditionRef = meet
        DemEnableConditionRef = meet
        DemEnableConditionRef = met
        DemEnableConditionRef = ms
        DemEnableConditionRef = normal
        DemEnableConditionRef = not
        DemEnableConditionRef = not
        DemEnableConditionRef = of
        DemEnableConditionRef = of
        DemEnableConditionRef = or
        DemEnableConditionRef = or
        DemEnableConditionRef = process
        DemEnableConditionRef = recovered
        DemEnableConditionRef = recovers
        DemEnableConditionRef = requirements
        DemEnableConditionRef = requirements
        DemEnableConditionRef = reset
        DemEnableConditionRef = service
        DemEnableConditionRef = simultaneously
        DemEnableConditionRef = start
        DemEnableConditionRef = start
        DemEnableConditionRef = status
        DemEnableConditionRef = the_001
        DemEnableConditionRef = the_001
        DemEnableConditionRef = the_001
        DemEnableConditionRef = the_001
        DemEnableConditionRef = the_001
        DemEnableConditionRef = the_001
        DemEnableConditionRef = the_001
        DemEnableConditionRef = the_001
        DemEnableConditionRef = timer
        DemEnableConditionRef = timing
        DemEnableConditionRef = timing
        DemEnableConditionRef = to
        DemEnableConditionRef = to
        DemEnableConditionRef = to
        DemEnableConditionRef = voltage
        DemEnableConditionRef = voltage
      ExtendedData_Fault_Aged_Counter (DemDataClass): DemDataElementDataSize=1, DemDataElementDataType=UINT8, DemDataElementUsePort=USE_DATA_CLIENT_SERVER_PORT, DemDataElementStoreNonVolatile=true
      opening (DemEnableCondition): DemEnableConditionId=133, DemEnableConditionStatus=true
      LAN_001 (DemEnableCondition): DemEnableConditionId=33, DemEnableConditionStatus=true
      EnableConditionGroup_c828305f (DemEnableConditionGroup):
        DemEnableConditionRef = BHM
        DemEnableConditionRef = BMS
        DemEnableConditionRef = BMS_status
        DemEnableConditionRef = Chargestatus
        DemEnableConditionRef = DC
        DemEnableConditionRef = DC
        DemEnableConditionRef = DC
        DemEnableConditionRef = DC
        DemEnableConditionRef = Detected
        DemEnableConditionRef = High
        DemEnableConditionRef = If
        DemEnableConditionRef = No
        DemEnableConditionRef = Note
        DemEnableConditionRef = On
        DemEnableConditionRef = Plug
        DemEnableConditionRef = Plug
        DemEnableConditionRef = Power
        DemEnableConditionRef = The
        DemEnableConditionRef = V
        DemEnableConditionRef = V
        DemEnableConditionRef = VCU
        DemEnableConditionRef = VCU
        DemEnableConditionRef = When
        DemEnableConditionRef = abnormal
        DemEnableConditionRef = active
        DemEnableConditionRef = again
        DemEnableConditionRef = all
        DemEnableConditionRef = any
        DemEnableConditionRef = are
        DemEnableConditionRef = battery
        DemEnableConditionRef = be
        DemEnableConditionRef = charge
        DemEnableConditionRef = charge
        DemEnableConditionRef = completed
        DemEnableConditionRef = completed
        DemEnableConditionRef = conditions
        DemEnableConditionRef = conditions
        DemEnableConditionRef = conditions
        DemEnableConditionRef = confirmation
        DemEnableConditionRef = detected_001
        DemEnableConditionRef = diagnosis
        DemEnableConditionRef = diagnosis
        DemEnableConditionRef = during
        DemEnableConditionRef = enable
        DemEnableConditionRef = fault
        DemEnableConditionRef = fault
        DemEnableConditionRef = fault
        DemEnableConditionRef = for
        DemEnableConditionRef = for
        DemEnableConditionRef = from
        DemEnableConditionRef = is
        DemEnableConditionRef = is
        DemEnableConditionRef = is
        DemEnableConditionRef = is
        DemEnableConditionRef = is
        DemEnableConditionRef = message
        DemEnableConditionRef = met
        DemEnableConditionRef = met
        DemEnableConditionRef = ms
        DemEnableConditionRef = normal
        DemEnableConditionRef = not
        DemEnableConditionRef = of
        DemEnableConditionRef = or
        DemEnableConditionRef = or
        DemEnableConditionRef = performed
        DemEnableConditionRef = process
        DemEnableConditionRef = recovers
        DemEnableConditionRef = sends
        DemEnableConditionRef = service
        DemEnableConditionRef = shall
        DemEnableConditionRef = the_001
        DemEnableConditionRef = the_001
        DemEnableConditionRef = the_001
        DemEnableConditionRef = the_001
        DemEnableConditionRef = the_001
        DemEnableConditionRef = the_001
        DemEnableConditionRef = to
        DemEnableConditionRef = trigger
        DemEnableConditionRef = voltage
        DemEnableConditionRef = voltage
        DemEnableConditionRef = voltage
        DemEnableConditionRef = x3
        DemEnableConditionRef = x3
      3 x DemEnableCondition, all with DemEnableConditionStatus=true:
        in: DemEnableConditionId=119
        Ready: DemEnableConditionId=60
        Buck: DemEnableConditionId=10
      DID_0x1d05_VCU_OBC_ChargeCurrentCommand (DemDataClass):
        DemDataElementDataSize = 2
        DemDataElementDataType = UINT16
        DemDataElementEndianness = BIG_ENDIAN
        DemDataElementUsePort = USE_DATA_CLIENT_SERVER_PORT
        DemDataElementStoreNonVolatile = true
      are (DemEnableCondition): DemEnableConditionId=91, DemEnableConditionStatus=true
      DID_0xf1a6_SOC (DemDataClass):
        DemDataElementDataSize = 2
        DemDataElementDataType = UINT16
        DemDataElementEndianness = BIG_ENDIAN
        DemDataElementUsePort = USE_DATA_CLIENT_SERVER_PORT
        DemDataElementStoreNonVolatile = true
      is (DemEnableCondition): DemEnableConditionId=120, DemEnableConditionStatus=true
      The (DemEnableCondition): DemEnableConditionId=66, DemEnableConditionStatus=true
      EnableConditionGroup_fd6c7f9e (DemEnableConditionGroup):
        DemEnableConditionRef = If
        DemEnableConditionRef = InActive
        DemEnableConditionRef = No
        DemEnableConditionRef = Note
        DemEnableConditionRef = The
        DemEnableConditionRef = V
        DemEnableConditionRef = V
        DemEnableConditionRef = VCU_RequestedModeBMS
        DemEnableConditionRef = When
        DemEnableConditionRef = abnormal
        DemEnableConditionRef = active
        DemEnableConditionRef = after
        DemEnableConditionRef = again
        DemEnableConditionRef = all
        DemEnableConditionRef = any
        DemEnableConditionRef = are
        DemEnableConditionRef = battery
        DemEnableConditionRef = be
        DemEnableConditionRef = being
        DemEnableConditionRef = completed
        DemEnableConditionRef = conditions
        DemEnableConditionRef = conditions
        DemEnableConditionRef = conditions
        DemEnableConditionRef = confirmation
        DemEnableConditionRef = diagnosis
        DemEnableConditionRef = diagnosis
        DemEnableConditionRef = during
        DemEnableConditionRef = enable
        DemEnableConditionRef = fault
        DemEnableConditionRef = fault
        DemEnableConditionRef = fault
        DemEnableConditionRef = for
        DemEnableConditionRef = from
        DemEnableConditionRef = is
        DemEnableConditionRef = is
        DemEnableConditionRef = is
        DemEnableConditionRef = met
        DemEnableConditionRef = met
        DemEnableConditionRef = ms
        DemEnableConditionRef = ms
        DemEnableConditionRef = normal
        DemEnableConditionRef = not
        DemEnableConditionRef = of
        DemEnableConditionRef = or
        DemEnableConditionRef = or
        DemEnableConditionRef = performed
        DemEnableConditionRef = process
        DemEnableConditionRef = recovers
        DemEnableConditionRef = service
        DemEnableConditionRef = shall
        DemEnableConditionRef = the_001
        DemEnableConditionRef = the_001
        DemEnableConditionRef = the_001
        DemEnableConditionRef = the_001
        DemEnableConditionRef = the_001
        DemEnableConditionRef = the_001
        DemEnableConditionRef = to
        DemEnableConditionRef = trigger
        DemEnableConditionRef = up
        DemEnableConditionRef = voltage
        DemEnableConditionRef = voltage
        DemEnableConditionRef = waked
        DemEnableConditionRef = x0
      s (DemEnableCondition): DemEnableConditionId=151, DemEnableConditionStatus=true
      EnableConditionGroup_9200803a (DemEnableConditionGroup):
        DemEnableConditionRef = AC
        DemEnableConditionRef = BMS_ChargeStatus
        DemEnableConditionRef = Charging_001
        DemEnableConditionRef = Enable_001
        DemEnableConditionRef = Enable_001
        DemEnableConditionRef = Heat
        DemEnableConditionRef = If
        DemEnableConditionRef = No
        DemEnableConditionRef = Note
        DemEnableConditionRef = OBC
        DemEnableConditionRef = Ohm
        DemEnableConditionRef = Ohm
        DemEnableConditionRef = Ohm
        DemEnableConditionRef = Ohm
        DemEnableConditionRef = POD_OBC_CCStatus
        DemEnableConditionRef = The
        DemEnableConditionRef = V
        DemEnableConditionRef = V
        DemEnableConditionRef = VCU
        DemEnableConditionRef = VCU_EnableOBC
        DemEnableConditionRef = When
        DemEnableConditionRef = abnormal
        DemEnableConditionRef = active
        DemEnableConditionRef = active
        DemEnableConditionRef = again
        DemEnableConditionRef = all
        DemEnableConditionRef = any
        DemEnableConditionRef = are
        DemEnableConditionRef = battery
        DemEnableConditionRef = be
        DemEnableConditionRef = charge
        DemEnableConditionRef = completed
        DemEnableConditionRef = conditions
        DemEnableConditionRef = conditions
        DemEnableConditionRef = conditions
        DemEnableConditionRef = confirmation
        DemEnableConditionRef = diagnosis
        DemEnableConditionRef = diagnosis
        DemEnableConditionRef = during
        DemEnableConditionRef = enable
        DemEnableConditionRef = fault
        DemEnableConditionRef = fault
        DemEnableConditionRef = fault
        DemEnableConditionRef = for
        DemEnableConditionRef = from
        DemEnableConditionRef = function
        DemEnableConditionRef = guns
        DemEnableConditionRef = is
        DemEnableConditionRef = is
        DemEnableConditionRef = is
        DemEnableConditionRef = is
        DemEnableConditionRef = met
        DemEnableConditionRef = met
        DemEnableConditionRef = ms
        DemEnableConditionRef = normal
        DemEnableConditionRef = not
        DemEnableConditionRef = of
        DemEnableConditionRef = only
        DemEnableConditionRef = or
        DemEnableConditionRef = or
        DemEnableConditionRef = performed
        DemEnableConditionRef = preheating
        DemEnableConditionRef = process
        DemEnableConditionRef = recovers
        DemEnableConditionRef = requests
        DemEnableConditionRef = service
        DemEnableConditionRef = shall
        DemEnableConditionRef = status
        DemEnableConditionRef = the_001
        DemEnableConditionRef = the_001
        DemEnableConditionRef = the_001
        DemEnableConditionRef = the_001
        DemEnableConditionRef = the_001
        DemEnableConditionRef = the_001
        DemEnableConditionRef = the_001
        DemEnableConditionRef = the_001
        DemEnableConditionRef = to
        DemEnableConditionRef = to
        DemEnableConditionRef = trigger
        DemEnableConditionRef = voltage
        DemEnableConditionRef = voltage
        DemEnableConditionRef = x1
        DemEnableConditionRef = x2
        DemEnableConditionRef = x{2..5}
      If (DemEnableCondition): DemEnableConditionId=26, DemEnableConditionStatus=true
      restored (DemEnableCondition): DemEnableConditionId=150, DemEnableConditionStatus=true
      EnableConditionGroup_ce1c6ac5 (DemEnableConditionGroup):
        DemEnableConditionRef = AC
        DemEnableConditionRef = BMS_ChargeStatus
        DemEnableConditionRef = Enable_001
        DemEnableConditionRef = Enable_001
        DemEnableConditionRef = Heat
        DemEnableConditionRef = If
        DemEnableConditionRef = No
        DemEnableConditionRef = Non
        DemEnableConditionRef = Note
        DemEnableConditionRef = OBC
        DemEnableConditionRef = Ohm
        DemEnableConditionRef = Ohm
        DemEnableConditionRef = Ohm
        DemEnableConditionRef = Ohm
        DemEnableConditionRef = POD_OBC_CCStatus
        DemEnableConditionRef = The
        DemEnableConditionRef = V
        DemEnableConditionRef = V
        DemEnableConditionRef = VCU
        DemEnableConditionRef = VCU_EnableOBC
        DemEnableConditionRef = When
        DemEnableConditionRef = abnormal
        DemEnableConditionRef = active
        DemEnableConditionRef = active
        DemEnableConditionRef = again
        DemEnableConditionRef = all
        DemEnableConditionRef = any
        DemEnableConditionRef = are
        DemEnableConditionRef = battery
        DemEnableConditionRef = be
        DemEnableConditionRef = charge
        DemEnableConditionRef = charging
        DemEnableConditionRef = completed
        DemEnableConditionRef = conditions
        DemEnableConditionRef = conditions
        DemEnableConditionRef = conditions
        DemEnableConditionRef = confirmation
        DemEnableConditionRef = diagnosis
        DemEnableConditionRef = diagnosis
        DemEnableConditionRef = during
        DemEnableConditionRef = enable
        DemEnableConditionRef = fault
        DemEnableConditionRef = fault
        DemEnableConditionRef = fault
        DemEnableConditionRef = for
        DemEnableConditionRef = from
        DemEnableConditionRef = function
        DemEnableConditionRef = guns
        DemEnableConditionRef = is
        DemEnableConditionRef = is
        DemEnableConditionRef = is
        DemEnableConditionRef = is
        DemEnableConditionRef = met
        DemEnableConditionRef = met
        DemEnableConditionRef = ms
        DemEnableConditionRef = normal
        DemEnableConditionRef = not
        DemEnableConditionRef = of
        DemEnableConditionRef = only
        DemEnableConditionRef = or
        DemEnableConditionRef = or
        DemEnableConditionRef = performed
        DemEnableConditionRef = preheating
        DemEnableConditionRef = process
        DemEnableConditionRef = recovers
        DemEnableConditionRef = requests
        DemEnableConditionRef = service
        DemEnableConditionRef = shall
        DemEnableConditionRef = status
        DemEnableConditionRef = the_001
        DemEnableConditionRef = the_001
        DemEnableConditionRef = the_001
        DemEnableConditionRef = the_001
        DemEnableConditionRef = the_001
        DemEnableConditionRef = the_001
        DemEnableConditionRef = the_001
        DemEnableConditionRef = the_001
        DemEnableConditionRef = to
        DemEnableConditionRef = to
        DemEnableConditionRef = trigger
        DemEnableConditionRef = voltage
        DemEnableConditionRef = voltage
        DemEnableConditionRef = x1
        DemEnableConditionRef = x2
        DemEnableConditionRef = x{2..5}
