AUTOSAR XML (schema 00048)
package /ActiveEcuC
  module config CanSM: implementation-config-variant=VARIANT-PRE-COMPILE, module-description=CanSM_Impl
    CanSMConfiguration: CanSMModeRequestRepetitionMax=10, CanSMModeRequestRepetitionTime=0.1
      CHNL_c5d82a30 (CanSMManagerNetwork):
        CanSMBorCounterL1ToL2 = 5
        CanSMBorTimeL1 = 1
        CanSMBorTimeL2 = 3
        CanSMBorTimeTxEnsured = 5
        CanSMBorTxConfirmationPolling = false
        CanSMComMNetworkHandleRef = CN_KAMA_FP_EPSChassis1_0303_66acf324
        CT_KAMA_FP_EPSChassis1_0303_845426c8 (CanSMController): CanSMControllerId=CT_KAMA_FP_EPSChassis1_0303_8c9dce8f
      CHNL_f95a0907 (CanSMManagerNetwork):
        CanSMBorCounterL1ToL2 = 5
        CanSMBorTimeL1 = 1
        CanSMBorTimeL2 = 3
        CanSMBorTimeTxEnsured = 5
        CanSMBorTxConfirmationPolling = false
        CanSMComMNetworkHandleRef = CN_KAMA_FP_EPT_0303_275b3e6e
        CT_KAMA_FP_EPT_0303_62c0567e (CanSMController): CanSMControllerId=CT_KAMA_FP_EPT_0303_1b7da7f9
    CanSMGeneral:
      CanSMDevErrorDetect = true
      CanSMMainFunctionTimePeriod = 0.01
      CanSMVersionInfoApi = false
      CanSMBorCheckLevel = false
      CanSMSafeBswChecks = false
      CanSMSetBaudrateApi = false
      CanSMGeneration: CanSMOutOfBoundsWriteSanitizer=false, CanSMOutOfBoundsReadSanitizer=false
