AUTOSAR XML (schema 00048)
package /ActiveEcuC
  module config ComM: implementation-config-variant=VARIANT-PRE-COMPILE, module-description=ComM_Impl
    ComMGeneral:
      ComMPncIdCounting = COMM_PNC_ID_COUNT_FROM_NM_MESSAGE
      ComMPncSupport = false
      ComMDevErrorDetect = true
      ComMEcuGroupClassification = 3
      ComMModeLimitationEnabled = false
      ComMSynchronousWakeUp = true
      ComMTMinFullComModeDuration = 5
      ComMVersionInfoApi = false
      ComMWakeupInhibitionEnabled = false
      ComMSafeBswChecks = false
      ComMGeneration: ComMOutOfBoundsWriteSanitizer=false, ComMOutOfBoundsReadSanitizer=false
    ComMConfigSet: ComMPncEnabled=false
      CN_KAMA_FP_EPSChassis1_0303_79bdd047 (ComMUser): ComMUserIdentifier=0, ComMUserModeNotification=false
      CN_KAMA_FP_EPSChassis1_0303_66acf324 (ComMChannel):
        ComMBusType = COMM_BUS_TYPE_CAN
        ComMChannelId = 0
        ComMFullCommRequestNotificationEnabled = false
        ComMMainFunctionPeriod = 0.02
        ComMNoCom = false
        ComMNoWakeup = false
        ComMNetworkManagement: ComMNmVariant=NONE, ComMPncNmRequest=false
        CN_KAMA_FP_EPSChassis1_0303_0e55dff3 (ComMUserPerChannel): ComMUserChannel=CN_KAMA_FP_EPSChassis1_0303_79bdd047
      CN_KAMA_FP_EPT_0303_275b3e6e (ComMChannel):
        ComMBusType = COMM_BUS_TYPE_CAN
        ComMChannelId = 1
        ComMFullCommRequestNotificationEnabled = false
        ComMMainFunctionPeriod = 0.02
        ComMNoCom = false
        ComMNoWakeup = false
        ComMNetworkManagement: ComMNmVariant=NONE, ComMPncNmRequest=false
        CN_KAMA_FP_EPT_0303_a7b96f1e (ComMUserPerChannel): ComMUserChannel=CN_KAMA_FP_EPT_0303_b67fd6a6
      CN_KAMA_FP_EPT_0303_b67fd6a6 (ComMUser): ComMUserIdentifier=1, ComMUserModeNotification=false
