AUTOSAR XML (schema 00048)
package /ActiveEcuC
  module config CanTp: implementation-config-variant=VARIANT-PRE-COMPILE, module-description=CanTp_Impl
    CanTpGeneral:
      CanTpChangeParameterApi = false
      CanTpDevErrorDetect = true
      CanTpPaddingByte = 204
      CanTpReadParameterApi = false
      CanTpVersionInfoApi = false
      CanTpPaddingActive = true
      CanTpHavePaddingByte = false
      CanTpNumRxChannels = 0
      CanTpNumTxChannels = 0
      CanTpEnableSplitMainFunction = false
      CanTpSupportStandardAddressing = true
      CanTpSupportExtendedAddressing = true
      CanTpSupportMixed11Addressing = true
      CanTpSupportMixed29Addressing = true
      CanTpSupportNormalFixedAddressing = true
      CanTpSupportCustomAddressing = false
      CanTpOnlyNotifyInformedAppl = true
      CanTpRc = false
      CanTpTc = false
      CanTpSafeBswChecks = false
      CanTpEnableConstantBS = true
      CanTpEnableTransmitQueue = false
      CanTpUseOnlyFirstFc = true
    CanTpConfig: CanTpMainFunctionPeriod=0.005
      5 x CanTpChannel, all with CanTpChannelMode=CANTP_MODE_FULL_DUPLEX:
        TPCH_2f97687b
          CanTpRxNSdu_51910c8d (CanTpRxNSdu):
            CanTpRxAddressingFormat = CANTP_STANDARD
            CanTpRxDl = 8
            CanTpRxTaType = CANTP_FUNCTIONAL
            CanTpNbr = 0.1
            CanTpRxNSduId = 0
            CanTpRxPaddingActivation = CANTP_ON
            CanTpRxNSduRef = UDSFunRequest_oKAMA_FP_EPT_0303_50124e24_Rx
            CanTpRxNPdu_fd3695fb (CanTpRxNPdu): CanTpRxNPduId=4, CanTpRxNPduRef=UDSFunRequest_Tp_oKAMA_FP_EPT_0303_2c00e7ab_Rx
        TPCH_efbe3b9a
          CanTpTxNSdu_7b97b5ad (CanTpTxNSdu):
            CanTpTxAddressingFormat = CANTP_STANDARD
            CanTpTxDl = 8
            CanTpTxTaType = CANTP_PHYSICAL
            CanTpNas = 0.1
            CanTpNcs = 0.2
            CanTpTc = false
            CanTpTxNSduId = 1
            CanTpTxPaddingActivation = CANTP_ON
            CanTpTxNSduRef = OBDResponse_oKAMA_FP_EPT_0303_1894c698_Tx
            CanTpTxNPdu_4e78364a (CanTpTxNPdu): CanTpTxNPduConfirmationPduId=0, CanTpTxNPduRef=OBDResponse_Tp_oKAMA_FP_EPT_0303_17c5d4c1_Tx
            CanTpRxFcNPdu_4e78364a (CanTpRxFcNPdu): CanTpRxFcNPduId=0, CanTpRxFcNPduRef=OBDRequest_Tp_oKAMA_FP_EPT_0303_a9730677_Rx
          CanTpRxNSdu_7b97b5ad (CanTpRxNSdu):
            CanTpRxAddressingFormat = CANTP_STANDARD
            CanTpRxDl = 8
            CanTpRxTaType = CANTP_PHYSICAL
            CanTpNbr = 0.1
            CanTpRxNSduId = 3
            CanTpRxPaddingActivation = CANTP_ON
            CanTpRxNSduRef = OBDRequest_oKAMA_FP_EPT_0303_26f78dd4_Rx
            CanTpTxFcNPdu_6c82e2b8 (CanTpTxFcNPdu): CanTpTxFcNPduConfirmationPduId=0, CanTpTxFcNPduRef=OBDResponse_Tp_oKAMA_FP_EPT_0303_17c5d4c1_Tx
            CanTpRxNPdu_6c82e2b8 (CanTpRxNPdu): CanTpRxNPduId=0, CanTpRxNPduRef=OBDRequest_Tp_oKAMA_FP_EPT_0303_a9730677_Rx
        TPCH_fa5e9113
          CanTpRxNSdu_6dcf7ed2 (CanTpRxNSdu):
            CanTpRxAddressingFormat = CANTP_STANDARD
            CanTpRxDl = 8
            CanTpRxTaType = CANTP_FUNCTIONAL
            CanTpNbr = 0.1
            CanTpRxNSduId = 4
            CanTpRxPaddingActivation = CANTP_ON
            CanTpRxNSduRef = OBDFunRequest_oKAMA_FP_EPT_0303_1b11138c_Rx
            CanTpRxNPdu_7b196fc1 (CanTpRxNPdu): CanTpRxNPduId=3, CanTpRxNPduRef=OBDFunRequest_Tp_oKAMA_FP_EPT_0303_6d77999b_Rx
        TPCH_e15aad01
          CanTpRxNSdu_a6cead3d (CanTpRxNSdu):
            CanTpRxAddressingFormat = CANTP_STANDARD
            CanTpRxDl = 8
            CanTpRxTaType = CANTP_PHYSICAL
            CanTpNbr = 0.1
            CanTpRxNSduId = 2
            CanTpRxPaddingActivation = CANTP_ON
            CanTpRxNSduRef = UDSRequest_oKAMA_FP_EPT_0303_03048258_Rx
            CanTpRxNPdu_7d7c0bed (CanTpRxNPdu): CanTpRxNPduId=1, CanTpRxNPduRef=UDSRequest_Tp_oKAMA_FP_EPT_0303_e2705bdf_Rx
            CanTpTxFcNPdu_7d7c0bed (CanTpTxFcNPdu): CanTpTxFcNPduConfirmationPduId=1, CanTpTxFcNPduRef=UDSResponse_Tp_oKAMA_FP_EPT_0303_cf83fc46_Tx
          CanTpTxNSdu_a6cead3d (CanTpTxNSdu):
            CanTpTxAddressingFormat = CANTP_STANDARD
            CanTpTxDl = 8
            CanTpTxTaType = CANTP_PHYSICAL
            CanTpNas = 0.1
            CanTpNcs = 0.2
            CanTpTc = false
            CanTpTxNSduId = 0
            CanTpTxPaddingActivation = CANTP_ON
            CanTpTxNSduRef = UDSResponse_oKAMA_FP_EPT_0303_fcbffa9c_Tx
            CanTpTxNPdu_5f86df1f (CanTpTxNPdu): CanTpTxNPduConfirmationPduId=1, CanTpTxNPduRef=UDSResponse_Tp_oKAMA_FP_EPT_0303_cf83fc46_Tx
            CanTpRxFcNPdu_5f86df1f (CanTpRxFcNPdu): CanTpRxFcNPduId=1, CanTpRxFcNPduRef=UDSRequest_Tp_oKAMA_FP_EPT_0303_e2705bdf_Rx
        TPCH_d9e643b3
          CanTpRxNSdu_2c9561b7 (CanTpRxNSdu):
            CanTpRxAddressingFormat = CANTP_STANDARD
            CanTpRxDl = 8
            CanTpRxTaType = CANTP_FUNCTIONAL
            CanTpNbr = 0.1
            CanTpRxNSduId = 1
            CanTpRxPaddingActivation = CANTP_ON
            CanTpRxNSduRef = AllFunctionRequest_oKAMA_FP_EPT_0303_783e25af_Rx
            CanTpRxNPdu_19b84de0 (CanTpRxNPdu): CanTpRxNPduId=2, CanTpRxNPduRef=AllFunctionRequest_Tp_oKAMA_FP_EPT_0303_75b1cd6d_Rx
