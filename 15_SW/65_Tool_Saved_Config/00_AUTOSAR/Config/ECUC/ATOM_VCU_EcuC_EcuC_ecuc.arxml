AUTOSAR XML (schema 00048)
package /ActiveEcuC
  module config EcuC: implementation-config-variant=VARIANT-PRE-COMPILE, module-description=EcuC_Impl
    EcucPduCollection: PduIdTypeEnum=UINT8, PduLengthTypeEnum=UINT8
      197 x Pdu, all with J1939Requestable=false:
        BMS_VersionInfor_oKAMA_FP_EPT_0303_ee97b4a4_Rx: DynamicLength=false, PduLength=8, SysTPduToFrameMappingRef=BMS_VersionInfor
        BMS_Temp_oKAMA_FP_EPT_0303_acd24b10_Rx: DynamicLength=false, PduLength=8, SysTPduToFrameMappingRef=BMS_Temp
        REPS_DM1_oKAMA_FP_EPSChassis1_0303_940d8c44_Rx: DynamicLength=false, PduLength=8
        OBDRequest_oKAMA_FP_EPT_0303_e2d185cc_Rx: DynamicLength=true, PduLength=8
        VCU_AccPedal_oKAMA_FP_EPSChassis1_0303_d4e5cf20_Tx: DynamicLength=false, PduLength=8
        VCU_OdometerInfo_oKAMA_FP_EPSChassis1_0303_60fc5853_Tx: DynamicLength=false, PduLength=3
        BMS_Insulation_oKAMA_FP_EPT_0303_66d8098f_Rx: DynamicLength=false, PduLength=8, SysTPduToFrameMappingRef=BMS_Insulation
        YRS_7_oKAMA_FP_EPSChassis1_0303_f5f61b76_Rx: DynamicLength=false, PduLength=8, SysTPduToFrameMappingRef=YRS_7
        BMS_ChargeEnergy_oKAMA_FP_EPT_0303_3ac5a6c0_Rx: DynamicLength=false, PduLength=8, SysTPduToFrameMappingRef=BMS_ChargeEnergy
        BMS_Batcode_oKAMA_FP_EPT_0303_2af9015e_Rx: DynamicLength=false, PduLength=8
        BMS_BatInfor2_oKAMA_FP_EPT_0303_8ac956d0_Rx: DynamicLength=false, PduLength=8, SysTPduToFrameMappingRef=BMS_BatInfor2
        IBS_Status1_oKAMA_FP_EPSChassis1_0303_293b2077_Rx: DynamicLength=false, PduLength=8, SysTPduToFrameMappingRef=IBS_Status1
        AllFunctionRequest_Tp_oKAMA_FP_EPT_0303_75b1cd6d_Rx: DynamicLength=false, PduLength=8, SysTPduToFrameMappingRef=AllFunctionRequest_Tp
        BMS_status_oKAMA_FP_EPT_0303_1bdce01b_Rx: DynamicLength=false, PduLength=8, SysTPduToFrameMappingRef=BMS_status
        BMS_ErrorInfo1_oKAMA_FP_EPT_0303_ebb790f1_Rx: DynamicLength=false, PduLength=8
        OBC_Error_STATUS_oKAMA_FP_EPT_0303_52154d12_Rx: DynamicLength=false, PduLength=8, SysTPduToFrameMappingRef=OBC_Error_STATUS
        APTC_TCU_oKAMA_FP_EPT_0303_d0971361_Rx: DynamicLength=false, PduLength=8, SysTPduToFrameMappingRef=APTC_TCU
        EPS_FEEDBACK_oKAMA_FP_EPSChassis1_0303_b7e2a70b_Rx: DynamicLength=false, PduLength=8
        VCU_MCU01_oKAMA_FP_EPT_0303_46a91c2b_Tx: DynamicLength=false, PduLength=8
        VCU_MCU02_oKAMA_FP_EPT_0303_e5ff9a82_Tx: DynamicLength=false, PduLength=8
        BMS_ChargeStop_oKAMA_FP_EPT_0303_5018d2ae_Rx: DynamicLength=false, PduLength=8, SysTPduToFrameMappingRef=BMS_ChargeStop
        IBS1_acceleration_oKAMA_FP_EPSChassis1_0303_2a04e229_Rx: DynamicLength=false, PduLength=8, SysTPduToFrameMappingRef=IBS1_acceleration
        VCU_TCU_oKAMA_FP_EPT_0303_67d6755c_Tx: DynamicLength=false, PduLength=8, SysTPduToFrameMappingRef=VCU_TCU
        IBS_VCUVLC_oKAMA_FP_EPSChassis1_0303_ba73f862_Rx: DynamicLength=false, PduLength=8
        DonorCar_PEPS_Message_Sts_oKAMA_FP_EPSChassis1_0303_1785e56a_Rx: DynamicLength=false, PduLength=8
        REPS_DM3_oKAMA_FP_EPSChassis1_0303_1b450c81_Rx: DynamicLength=false, PduLength=8, SysTPduToFrameMappingRef=REPS_DM3
        BMS_PRO_oKAMA_FP_EPT_0303_a99bebfe_Rx: DynamicLength=false, PduLength=8
        VCU_PwrtrainHVbattStatus2_oKAMA_FP_EPSChassis1_0303_f8d9f820_Tx: DynamicLength=false, PduLength=8, SysTPduToFrameMappingRef=VCU_PwrtrainHVbattStatus2
        UDSFunRequest_oKAMA_FP_EPT_0303_807c682b_Rx: DynamicLength=true, PduLength=7
        MCU_Temperature1_oKAMA_FP_EPT_0303_5a37b923_Rx: DynamicLength=false, PduLength=8, SysTPduToFrameMappingRef=MCU_Temperature1
        OBDResponse_Tp_oKAMA_FP_EPT_0303_17c5d4c1_Tx: DynamicLength=false, PduLength=8, SysTPduToFrameMappingRef=OBDResponse_Tp
        ADAS_APA_oKAMA_FP_EPSChassis1_0303_4a70cc95_Rx: DynamicLength=false, PduLength=8, SysTPduToFrameMappingRef=ADAS_APA
        VCU_chassis_oKAMA_FP_EPSChassis1_0303_66946541_Tx: DynamicLength=false, PduLength=8, SysTPduToFrameMappingRef=VCU_chassis
        ADAS_AEB_oKAMA_FP_EPSChassis1_0303_cc20b539_Rx: DynamicLength=false, PduLength=8
        POD_VCU_Status_01_oKAMA_FP_EPT_0303_d96a2947_Rx: DynamicLength=false, PduLength=8, SysTPduToFrameMappingRef=POD_VCU_Status_01
        BMS_PRO_oKAMA_FP_EPT_0303_04956e69_Rx: DynamicLength=false, PduLength=8, SysTPduToFrameMappingRef=BMS_PRO
        IBS_WheelSpeed_oKAMA_FP_EPSChassis1_0303_11b9484c_Rx: DynamicLength=false, PduLength=8
        MCU_VCU_1_oKAMA_FP_EPT_0303_4d7e305c_Rx: DynamicLength=false, PduLength=8
        VCU_DCDC_oKAMA_FP_EPT_0303_5a1aa2b0_Tx: DynamicLength=false, PduLength=8, SysTPduToFrameMappingRef=VCU_DCDC
        DonorCar_MMI_AC_Command_oKAMA_FP_EPT_0303_2af1d020_Rx: DynamicLength=false, PduLength=8
        GW_TCU_AmbientTemp_oKAMA_FP_EPSChassis1_0303_3f0a1e15_Rx: DynamicLength=false, PduLength=8, SysTPduToFrameMappingRef=GW_TCU_AmbientTemp
        IBS_Torque_oKAMA_FP_EPSChassis1_0303_98aca4f8_Rx: DynamicLength=false, PduLength=8
        POD_VCU_Status_02_oKAMA_FP_EPT_0303_e6a157d2_Rx: DynamicLength=false, PduLength=8, SysTPduToFrameMappingRef=POD_VCU_Status_02
        ADAS_ACC_oKAMA_FP_EPSChassis1_0303_a710a036_Rx: DynamicLength=false, PduLength=8
        EPS_FEEDBACK_oKAMA_FP_EPSChassis1_0303_c3c7eb04_Rx: DynamicLength=false, PduLength=8, SysTPduToFrameMappingRef=EPS_FEEDBACK
        TCU_Cmd_oKAMA_FP_EPT_0303_4f820fd2_Rx: DynamicLength=false, PduLength=8, SysTPduToFrameMappingRef=TCU_Cmd
        YRS_7_oKAMA_FP_EPSChassis1_0303_d72e0b69_Rx: DynamicLength=false, PduLength=8
        BMS_BatInfor1_oKAMA_FP_EPT_0303_b5022845_Rx: DynamicLength=false, PduLength=8, SysTPduToFrameMappingRef=BMS_BatInfor1
        VCU_POD_oKAMA_FP_EPT_0303_79abac5b_Tx: DynamicLength=false, PduLength=8
        DCDC_VCU_02_oKAMA_FP_EPT_0303_a764b53d_Rx: DynamicLength=false, PduLength=8, SysTPduToFrameMappingRef=DCDC_VCU_02
        IBS_Torque_oKAMA_FP_EPSChassis1_0303_7caf766a_Rx: DynamicLength=false, PduLength=8, SysTPduToFrameMappingRef=IBS_Torque
        YRS_2_oKAMA_FP_EPSChassis1_0303_d8e37b6d_Rx: DynamicLength=false, PduLength=8
        VCU_AccPedal_oKAMA_FP_EPSChassis1_0303_6cab291a_Tx: DynamicLength=false, PduLength=8, SysTPduToFrameMappingRef=VCU_AccPedal
        UDSResponse_Tp_oKAMA_FP_EPT_0303_cf83fc46_Tx: DynamicLength=false, PduLength=8, SysTPduToFrameMappingRef=UDSResponse_Tp
        YRS_1_oKAMA_FP_EPSChassis1_0303_6b7756ae_Rx: DynamicLength=false, PduLength=8
        VCU_MCU_7A_oKAMA_FP_EPSChassis1_0303_8ee5ed3e_Tx: DynamicLength=false, PduLength=8, SysTPduToFrameMappingRef=VCU_MCU_7A
        TCU_AmbientTemp_oKAMA_FP_EPT_0303_b02dde55_Rx: DynamicLength=false, PduLength=8, SysTPduToFrameMappingRef=TCU_AmbientTemp
        DonorCar_GSM_oKAMA_FP_EPSChassis1_0303_7cec353b_Rx: DynamicLength=false, PduLength=8, SysTPduToFrameMappingRef=DonorCar_GSM
        BMS_DisChargeEnergy_oKAMA_FP_EPT_0303_96fcbd4c_Rx: DynamicLength=false, PduLength=8, SysTPduToFrameMappingRef=BMS_DisChargeEnergy
        VCU_PlugInChrgInfo1_oKAMA_FP_EPSChassis1_0303_8c12c5e9_Tx: DynamicLength=false, PduLength=8, SysTPduToFrameMappingRef=VCU_PlugInChrgInfo1
        BMS_CellVoltage1_oKAMA_FP_EPT_0303_fc77b879_Rx: DynamicLength=false, PduLength=8
        BMS_BatInfor2_oKAMA_FP_EPT_0303_e514bb91_Rx: DynamicLength=false, PduLength=8
        DonorCar_BCM_LDoorWindowState_oKAMA_FP_EPSChassis1_0303_25e710b8_Rx: DynamicLength=false, PduLength=8, SysTPduToFrameMappingRef=DonorCar_BCM_LDoorWindowState
        BMS_status_oKAMA_FP_EPT_0303_43eba5da_Rx: DynamicLength=false, PduLength=8
        VCU_DCDC_oKAMA_FP_EPT_0303_cea088c8_Tx: DynamicLength=false, PduLength=8
        VCU_TCU_oKAMA_FP_EPT_0303_7cc42e59_Tx: DynamicLength=false, PduLength=8
        ADAS_CCU1_Ctrl_oKAMA_FP_EPSChassis1_0303_f573a88f_Rx: DynamicLength=false, PduLength=8
        DonorCar_PEPS_Message_Sts_oKAMA_FP_EPSChassis1_0303_6824d552_Rx: DynamicLength=false, PduLength=8, SysTPduToFrameMappingRef=DonorCar_PEPS_Message_Sts
        VCU_HMIsignals_oKAMA_FP_EPSChassis1_0303_e417f061_Tx: DynamicLength=false, PduLength=8, SysTPduToFrameMappingRef=VCU_HMIsignals
        AllFunctionRequest_oKAMA_FP_EPT_0303_783e25af_Rx: DynamicLength=true, PduLength=7
        DonorCar_GSM_oKAMA_FP_EPSChassis1_0303_fcfe1306_Rx: DynamicLength=false, PduLength=8
        VCU_OdometerInfo_oKAMA_FP_EPSChassis1_0303_1b1e7931_Tx: DynamicLength=false, PduLength=3, SysTPduToFrameMappingRef=VCU_OdometerInfo
        MCU_Temperature2_oKAMA_FP_EPT_0303_65fcc7b6_Rx: DynamicLength=false, PduLength=8, SysTPduToFrameMappingRef=MCU_Temperature2
        REPS_DM2_oKAMA_FP_EPSChassis1_0303_668841be_Rx: DynamicLength=false, PduLength=8, SysTPduToFrameMappingRef=REPS_DM2
        VCU_PwrtrainRequests_oKAMA_FP_EPSChassis1_0303_51346ff9_Tx: DynamicLength=false, PduLength=8
        BMS_CurrentLimit_oKAMA_FP_EPT_0303_4d8e4c2e_Rx: DynamicLength=false, PduLength=8
        VCU_HVbattStatus1_oKAMA_FP_EPSChassis1_0303_5305e357_Tx: DynamicLength=false, PduLength=8
        YRS_1_oKAMA_FP_EPSChassis1_0303_2228b3b5_Rx: DynamicLength=false, PduLength=8, SysTPduToFrameMappingRef=YRS_1
        EVCOM_State_oKAMA_FP_EPT_0303_d94c86f8_Rx: DynamicLength=false, PduLength=8, SysTPduToFrameMappingRef=EVCOM_State
        UDSResponse_oKAMA_FP_EPT_0303_fcbffa9c_Tx: DynamicLength=true, PduLength=8
        BMS_Charge1_oKAMA_FP_EPT_0303_0f6fc3b3_Rx: DynamicLength=false, PduLength=8
        MCU_SoftwareNumber_oKAMA_FP_EPT_0303_560144a5_Rx: DynamicLength=false, PduLength=8
        MCU_Temperature1_oKAMA_FP_EPT_0303_a297e928_Rx: DynamicLength=false, PduLength=8
        MCU_Temperature2_oKAMA_FP_EPT_0303_01c16f81_Rx: DynamicLength=false, PduLength=8
        DCDC_VCU_02_oKAMA_FP_EPT_0303_0576f9fb_Rx: DynamicLength=false, PduLength=8
        UDSFunRequest_Tp_oKAMA_FP_EPT_0303_2c00e7ab_Rx: DynamicLength=false, PduLength=8, SysTPduToFrameMappingRef=UDSFunRequest_Tp
        MCU_Status_oKAMA_FP_EPT_0303_7c8eb231_Rx: DynamicLength=false, PduLength=8, SysTPduToFrameMappingRef=MCU_Status
        MCU_Status_oKAMA_FP_EPT_0303_f59e16e7_Rx: DynamicLength=false, PduLength=8
        OBC_VCU_STATUS1_oKAMA_FP_EPT_0303_ee6e515c_Rx: DynamicLength=false, PduLength=8, SysTPduToFrameMappingRef=OBC_VCU_STATUS1
        OBDResponse_oKAMA_FP_EPT_0303_0e230f69_Tx: DynamicLength=true, PduLength=8
        DonorCar_BCM_LDoorWindowState_oKAMA_FP_EPSChassis1_0303_2e82203e_Rx: DynamicLength=false, PduLength=8
        OBC_VCU_STATUS2_oKAMA_FP_EPT_0303_d1a52fc9_Rx: DynamicLength=false, PduLength=8, SysTPduToFrameMappingRef=OBC_VCU_STATUS2
        TCU_ACStatusInfo_oKAMA_FP_EPT_0303_5e6e4459_Rx: DynamicLength=false, PduLength=8, SysTPduToFrameMappingRef=TCU_ACStatusInfo
        MCU_FailureCode_oKAMA_FP_EPT_0303_23e6845d_Rx: DynamicLength=false, PduLength=8, SysTPduToFrameMappingRef=MCU_FailureCode
        UDSRequest_oKAMA_FP_EPT_0303_03048258_Rx: DynamicLength=true, PduLength=8
        TCU_Status_oKAMA_FP_EPT_0303_e2dbd2c2_Rx: DynamicLength=false, PduLength=8
        TCU_Status_oKAMA_FP_EPT_0303_6a5ccd57_Rx: DynamicLength=false, PduLength=8, SysTPduToFrameMappingRef=TCU_Status
        TCU_ACStatusInfo_oKAMA_FP_EPT_0303_1e9c334e_Rx: DynamicLength=false, PduLength=8
        VCU_Fault_01_oKAMA_FP_EPT_0303_43d9780b_Tx: DynamicLength=false, PduLength=8
        DonorCar_ACM_Status_oKAMA_FP_EPSChassis1_0303_b1c292e5_Rx: DynamicLength=false, PduLength=8, SysTPduToFrameMappingRef=DonorCar_ACM_Status
        VCU_HVbattStatus1_oKAMA_FP_EPSChassis1_0303_2775eb4c_Tx: DynamicLength=false, PduLength=8, SysTPduToFrameMappingRef=VCU_HVbattStatus1
        Uds_EPT_Boot_Response_oKAMA_FP_EPT_0303_52f0f748_Tx: DynamicLength=false, PduLength=8
        REPS_DM1_oKAMA_FP_EPSChassis1_0303_e0df96ff_Rx: DynamicLength=false, PduLength=8, SysTPduToFrameMappingRef=REPS_DM1
        IBS_Status2_oKAMA_FP_EPSChassis1_0303_af6cf736_Rx: DynamicLength=false, PduLength=8, SysTPduToFrameMappingRef=IBS_Status2
        Uds_EPT_Boot_Request_oKAMA_FP_EPT_0303_8243a077_Rx: DynamicLength=false, PduLength=8
        BMS_VersionInfor_oKAMA_FP_EPT_0303_0f4b45f4_Rx: DynamicLength=false, PduLength=8
        EVCOM_State_oKAMA_FP_EPT_0303_b23a01c5_Rx: DynamicLength=false, PduLength=8
        MCU_SoftwareNumber_oKAMA_FP_EPT_0303_701182ec_Rx: DynamicLength=false, PduLength=8, SysTPduToFrameMappingRef=MCU_SoftwareNumber
        TCU_Cmd_oKAMA_FP_EPT_0303_2f814a9a_Rx: DynamicLength=false, PduLength=8
        UDSResponse_oKAMA_FP_EPT_0303_6925161b_Tx: DynamicLength=true, PduLength=8
        DonorCar_ACM_Status_oKAMA_FP_EPSChassis1_0303_ae435576_Rx: DynamicLength=false, PduLength=8
        OBC_VCU_STATUS2_oKAMA_FP_EPT_0303_36a159a3_Rx: DynamicLength=false, PduLength=8
        BMS_DIRelayState_oKAMA_FP_EPT_0303_081a63f8_Rx: DynamicLength=false, PduLength=8
        IBS_Status3_oKAMA_FP_EPSChassis1_0303_66e23593_Rx: DynamicLength=false, PduLength=8
        POD_VCU_Status_02_oKAMA_FP_EPT_0303_90198af4_Rx: DynamicLength=false, PduLength=8
        BMS_BatInfor1_oKAMA_FP_EPT_0303_46423d38_Rx: DynamicLength=false, PduLength=8
        OBDFunRequest_Tp_oKAMA_FP_EPT_0303_6d77999b_Rx: DynamicLength=false, PduLength=8, SysTPduToFrameMappingRef=OBDFunRequest_Tp
        BMS_CellVoltage1_oKAMA_FP_EPT_0303_e96b50f3_Rx: DynamicLength=false, PduLength=8, SysTPduToFrameMappingRef=BMS_CellVoltage1
        UDSRequest_Tp_oKAMA_FP_EPT_0303_e2705bdf_Rx: DynamicLength=false, PduLength=8, SysTPduToFrameMappingRef=UDSRequest_Tp
        MCU_VCU_1_oKAMA_FP_EPT_0303_ea4e79f6_Rx: DynamicLength=false, PduLength=8, SysTPduToFrameMappingRef=MCU_VCU_1
        OBC_VCU_CHRGSTATION_ST_oKAMA_FP_EPT_0303_04b5873f_Rx: DynamicLength=false, PduLength=8
        UDSFunRequest_oKAMA_FP_EPT_0303_50124e24_Rx: DynamicLength=true, PduLength=7
        VCU_chassis_oKAMA_FP_EPSChassis1_0303_187d50df_Tx: DynamicLength=false, PduLength=8
        IBS_WheelPulse_oKAMA_FP_EPSChassis1_0303_0327ced1_Rx: DynamicLength=false, PduLength=8, SysTPduToFrameMappingRef=IBS_WheelPulse
        IBS_Status1_oKAMA_FP_EPSChassis1_0303_bbfa0311_Rx: DynamicLength=false, PduLength=8
        OBDFunRequest_oKAMA_FP_EPT_0303_f91ebc99_Rx: DynamicLength=true, PduLength=7
        OBDResponse_oKAMA_FP_EPT_0303_1894c698_Tx: DynamicLength=true, PduLength=8
        MCU_HardwareNumber_oKAMA_FP_EPT_0303_4cd13962_Rx: DynamicLength=false, PduLength=8, SysTPduToFrameMappingRef=MCU_HardwareNumber
        ADAS_ACC_oKAMA_FP_EPSChassis1_0303_0ad656f5_Rx: DynamicLength=false, PduLength=8, SysTPduToFrameMappingRef=ADAS_ACC
        MCU_FailureCode_oKAMA_FP_EPT_0303_0ebb7936_Rx: DynamicLength=false, PduLength=8
        ADAS_AEB_oKAMA_FP_EPSChassis1_0303_75a15668_Rx: DynamicLength=false, PduLength=8, SysTPduToFrameMappingRef=ADAS_AEB
        OBC_VCU_CHRGSTATION_ST_oKAMA_FP_EPT_0303_a723cdbe_Rx: DynamicLength=false, PduLength=8, SysTPduToFrameMappingRef=OBC_VCU_CHRGSTATION_ST
        VCU_PwrtrainRequests_oKAMA_FP_EPSChassis1_0303_ba8adde5_Tx: DynamicLength=false, PduLength=8, SysTPduToFrameMappingRef=VCU_PwrtrainRequests
        OBC_VCU_STATUS1_oKAMA_FP_EPT_0303_95f7df0a_Rx: DynamicLength=false, PduLength=8
        VCU_BMS_oKAMA_FP_EPT_0303_45397907_Tx: DynamicLength=false, PduLength=8
        BMS_CurrentLimit_oKAMA_FP_EPT_0303_70231bec_Rx: DynamicLength=false, PduLength=8, SysTPduToFrameMappingRef=BMS_CurrentLimit
        BMS_Insulation_oKAMA_FP_EPT_0303_6e3c9b8a_Rx: DynamicLength=false, PduLength=8
        AllFunctionRequest_oKAMA_FP_EPT_0303_a4f59624_Rx: DynamicLength=true, PduLength=7
        BMS_ChargeStop_oKAMA_FP_EPT_0303_aeea1185_Rx: DynamicLength=false, PduLength=8
        APTC_TCU_oKAMA_FP_EPT_0303_356cfb4a_Rx: DynamicLength=false, PduLength=8
        IBS_Status2_oKAMA_FP_EPSChassis1_0303_086e2ed2_Rx: DynamicLength=false, PduLength=8
        GW_BCM_oKAMA_FP_EPT_0303_144b8b19_Rx: DynamicLength=false, PduLength=8
        ADAS_CCU1_Ctrl_oKAMA_FP_EPSChassis1_0303_5fa8e2ee_Rx: DynamicLength=false, PduLength=8, SysTPduToFrameMappingRef=ADAS_CCU1_Ctrl
        DCDC_VCU_01_oKAMA_FP_EPT_0303_a6207f52_Rx: DynamicLength=false, PduLength=8
        VCU_OBC_oKAMA_FP_EPT_0303_8235bc7f_Tx: DynamicLength=false, PduLength=8
        ADAS_APA_oKAMA_FP_EPSChassis1_0303_63894043_Rx: DynamicLength=false, PduLength=8
        DonorCar_MMI_Status_Infor_oKAMA_FP_EPSChassis1_0303_e08f1a5b_Rx: DynamicLength=false, PduLength=8, SysTPduToFrameMappingRef=DonorCar_MMI_Status_Infor
        TCU_AmbientTemp_oKAMA_FP_EPT_0303_16fc04eb_Rx: DynamicLength=false, PduLength=8
        POD_VCU_Status_01_oKAMA_FP_EPT_0303_334f0c5d_Rx: DynamicLength=false, PduLength=8
        BMS_DisChargeEnergy_oKAMA_FP_EPT_0303_715042cb_Rx: DynamicLength=false, PduLength=8
        VCU_PlugInChrgInfo1_oKAMA_FP_EPSChassis1_0303_f0a9ba25_Tx: DynamicLength=false, PduLength=8
        MCU_DeratingStatus_oKAMA_FP_EPT_0303_31c5eddc_Rx: DynamicLength=false, PduLength=8, SysTPduToFrameMappingRef=MCU_DeratingStatus
        OBC_Error_STATUS_oKAMA_FP_EPT_0303_fe50628e_Rx: DynamicLength=false, PduLength=8
        OBDFunRequest_oKAMA_FP_EPT_0303_1b11138c_Rx: DynamicLength=true, PduLength=7
        REPS_DM2_oKAMA_FP_EPSChassis1_0303_2799a187_Rx: DynamicLength=false, PduLength=8
        REPS_DM3_oKAMA_FP_EPSChassis1_0303_4915bac6_Rx: DynamicLength=false, PduLength=8
        GW_BCM_oKAMA_FP_EPT_0303_49041fc8_Rx: DynamicLength=false, PduLength=8, SysTPduToFrameMappingRef=GW_BCM
        Uds_EPT_Boot_Response_oKAMA_FP_EPT_0303_ea2424f2_Tx: DynamicLength=false, PduLength=8, SysTPduToFrameMappingRef=Uds_EPT_Boot_Response
        BMS_Charge1_oKAMA_FP_EPT_0303_a3af9591_Rx: DynamicLength=false, PduLength=8, SysTPduToFrameMappingRef=BMS_Charge1
        MCU_DeratingStatus_oKAMA_FP_EPT_0303_9e0fe5b3_Rx: DynamicLength=false, PduLength=8
        VCU_MCU02_oKAMA_FP_EPT_0303_d8c95ab1_Tx: DynamicLength=false, PduLength=8, SysTPduToFrameMappingRef=VCU_MCU02
        VCU_HMIsignals_oKAMA_FP_EPSChassis1_0303_a83a481c_Tx: DynamicLength=false, PduLength=8
        BMS_ChargeEnergy_oKAMA_FP_EPT_0303_67f5cf8b_Rx: DynamicLength=false, PduLength=8
        BMS_Batcode_oKAMA_FP_EPT_0303_bf81843e_Rx: DynamicLength=false, PduLength=8, SysTPduToFrameMappingRef=BMS_Batcode
        VCU_MCU_7A_oKAMA_FP_EPSChassis1_0303_0bce5bfc_Tx: DynamicLength=false, PduLength=8
        UDSRequest_oKAMA_FP_EPT_0303_39823b57_Rx: DynamicLength=true, PduLength=8
        VCU_BMS_oKAMA_FP_EPT_0303_0668934d_Tx: DynamicLength=false, PduLength=8, SysTPduToFrameMappingRef=VCU_BMS
        IBS_VCUVLC_oKAMA_FP_EPSChassis1_0303_65a003e7_Rx: DynamicLength=false, PduLength=8, SysTPduToFrameMappingRef=IBS_VCUVLC
        IBS_WheelSpeed_oKAMA_FP_EPSChassis1_0303_fab7be15_Rx: DynamicLength=false, PduLength=8, SysTPduToFrameMappingRef=IBS_WheelSpeed
        BMS_PackVoltage_oKAMA_FP_EPT_0303_dde3d337_Rx: DynamicLength=false, PduLength=8
        OBDRequest_Tp_oKAMA_FP_EPT_0303_a9730677_Rx: DynamicLength=false, PduLength=8, SysTPduToFrameMappingRef=OBDRequest_Tp
        VCU_Mileage_oKAMA_FP_EPT_0303_cc59f83c_Tx: DynamicLength=false, PduLength=8, SysTPduToFrameMappingRef=VCU_Mileage
        IBS_Status3_oKAMA_FP_EPSChassis1_0303_d2a1ba09_Rx: DynamicLength=false, PduLength=8, SysTPduToFrameMappingRef=IBS_Status3
        DCDC_VCU_01_oKAMA_FP_EPT_0303_98afcba8_Rx: DynamicLength=false, PduLength=8, SysTPduToFrameMappingRef=DCDC_VCU_01
        BMS_Temp_oKAMA_FP_EPT_0303_0559f438_Rx: DynamicLength=false, PduLength=8
        BMS_TCU_oKAMA_FP_EPT_0303_2de3da2b_Rx: DynamicLength=false, PduLength=8, SysTPduToFrameMappingRef=BMS_TCU
        Uds_EPT_Boot_Request_oKAMA_FP_EPT_0303_f415a987_Rx: DynamicLength=false, PduLength=8, SysTPduToFrameMappingRef=Uds_EPT_Boot_Request
        BMS_TCU_oKAMA_FP_EPT_0303_50945f58_Rx: DynamicLength=false, PduLength=8
        GW_TCU_AmbientTemp_oKAMA_FP_EPSChassis1_0303_013ab96f_Rx: DynamicLength=false, PduLength=8
        BMS_DIRelayState_oKAMA_FP_EPT_0303_e4f455bd_Rx: DynamicLength=false, PduLength=8, SysTPduToFrameMappingRef=BMS_DIRelayState
        IBS_WheelPulse_oKAMA_FP_EPSChassis1_0303_72c6c64e_Rx: DynamicLength=false, PduLength=8
        VCU_PlugInChrgInfo2_oKAMA_FP_EPSChassis1_0303_433d97e6_Tx: DynamicLength=false, PduLength=8
        VCU_Fault_01_oKAMA_FP_EPT_0303_a4273bfe_Tx: DynamicLength=false, PduLength=8, SysTPduToFrameMappingRef=VCU_Fault_01
        IBS1_acceleration_oKAMA_FP_EPSChassis1_0303_92cce59a_Rx: DynamicLength=false, PduLength=8
        DonorCar_MMI_AC_Command_oKAMA_FP_EPT_0303_0dbdd94d_Rx: DynamicLength=false, PduLength=8, SysTPduToFrameMappingRef=DonorCar_MMI_AC_Command
        BMS_ErrorInfo1_oKAMA_FP_EPT_0303_6e0c791e_Rx: DynamicLength=false, PduLength=8, SysTPduToFrameMappingRef=BMS_ErrorInfo1
        VCU_MCU01_oKAMA_FP_EPT_0303_e7022424_Tx: DynamicLength=false, PduLength=8, SysTPduToFrameMappingRef=VCU_MCU01
        BMS_PackVoltage_oKAMA_FP_EPT_0303_97e1c558_Rx: DynamicLength=false, PduLength=8, SysTPduToFrameMappingRef=BMS_PackVoltage
        VCU_PlugInChrgInfo2_oKAMA_FP_EPSChassis1_0303_0a4512a8_Tx: DynamicLength=false, PduLength=8, SysTPduToFrameMappingRef=VCU_PlugInChrgInfo2
        VCU_PwrtrainHVbattStatus2_oKAMA_FP_EPSChassis1_0303_3c31462e_Tx: DynamicLength=false, PduLength=8
        DonorCar_MMI_Status_Infor_oKAMA_FP_EPSChassis1_0303_cfdfa99c_Rx: DynamicLength=false, PduLength=8
        MCU_HardwareNumber_oKAMA_FP_EPT_0303_379b1fee_Rx: DynamicLength=false, PduLength=8
        VCU_OBC_oKAMA_FP_EPT_0303_39c153bb_Tx: DynamicLength=false, PduLength=8, SysTPduToFrameMappingRef=VCU_OBC
        VCU_POD_oKAMA_FP_EPT_0303_efe06d9c_Tx: DynamicLength=false, PduLength=8, SysTPduToFrameMappingRef=VCU_POD
        YRS_2_oKAMA_FP_EPSChassis1_0303_a47f64f4_Rx: DynamicLength=false, PduLength=8, SysTPduToFrameMappingRef=YRS_2
        OBDRequest_oKAMA_FP_EPT_0303_26f78dd4_Rx: DynamicLength=true, PduLength=8
        VCU_Mileage_oKAMA_FP_EPT_0303_701fd8da_Tx: DynamicLength=false, PduLength=8
    EcucGeneral:
      CPUType = CPU32Bit
      SizeOfInt = Size32Bit
      ByteOrder = LITTLE_ENDIAN
      BitOrder = LSB_to_MSB
      AtomicBitAccessInBitfield = false
      AtomicVariableAccess = Atomic32BitAccess
      SizeOfEnum = Size32Bit
      SizeOfROMPointer = Size32Bit
      SizeOfRAMPointer = Size32Bit
      BitFieldDataType = INT
      StructAlignment = Auto
      ArrayAlignment = Align8Bit
      StructInArrayAlignment = Auto
      DummyFunction = false
      DummyStatement = true
      DummyStatementKind = None
      ConditionalGenerating = true
      EcucBswImplementationCodeType = EcuCSourceCode
      EcuCUseStdReturnTypeForRte = false
      PostbuildLoadable: AlignmentFillPattern=255, PBROMStartAddress=0, PBRAMStartAddress=0, PBROMEndAddress=0, PBRAMEndAddress=0
      BswInitialization
        34 x InitFunction:
          BswM_Init: Header=BswM.h, InitPhase=NO_INIT, ConfigType=BswM_ConfigType, ConfigPtrName=BswM_Config_Ptr, ConfigPtrClass=BSWM_INIT_DATA, ModuleRef=BswM  # /ActiveEcuC/BswM PLAIN_TEXT Init function description of BswM in UnfilteredViewInInvariantProject (UnfilteredInvariantProjectModelView) .
          BswM_PreInit: Header=BswM.h, InitPhase=INIT_ONE, ConfigType=BswM_ConfigType, ConfigPtrName=BswM_Config_Ptr, ConfigPtrClass=BSWM_INIT_DATA, ModuleRef=BswM  # /ActiveEcuC/BswM PLAIN_TEXT PreInit function description of BswM in UnfilteredViewInInvariantProject (UnfilteredInvariantProjectModelView) .
          BswM_InitMemory: Header=BswM.h, InitPhase=INIT_MEMORY, ModuleRef=BswM  # /ActiveEcuC/BswM PLAIN_TEXT InitMemory function description of BswM in UnfilteredViewInInvariantProject (UnfilteredInvariantProjectModelView) .
          CanIf_InitMemory: Header=CanIf.h, InitPhase=INIT_MEMORY, ModuleRef=CanIf  # /ActiveEcuC/CanIf PLAIN_TEXT InitMemory function description of CanIf in UnfilteredViewInInvariantProject (UnfilteredInvariantProjectModelView) .
          CanIf_Init: Header=CanIf.h, InitPhase=INIT_TWO_IF, ConfigType=CanIf_ConfigType, ConfigPtrName=CanIf_Config_Ptr, ConfigPtrClass=CANIF_INIT_DATA, ModuleRef=CanIf  # /ActiveEcuC/CanIf PLAIN_TEXT Init function description of CanIf in UnfilteredViewInInvariantProject (UnfilteredInvariantProjectModelView) .
          CanSM_Init: Header=CanSM_EcuM.h, InitPhase=INIT_TWO_SM, ConfigType=CanSM_ConfigType, ConfigPtrName=CanSM_Config_Ptr, ConfigPtrClass=CANSM_INIT_DATA, ModuleRef=CanSM  # /ActiveEcuC/CanSM PLAIN_TEXT Init function description of CanSM in UnfilteredViewInInvariantProject (UnfilteredInvariantProjectModelView) .
          CanSM_InitMemory: Header=CanSM_EcuM.h, InitPhase=INIT_MEMORY, ModuleRef=CanSM  # /ActiveEcuC/CanSM PLAIN_TEXT InitMemory function description of CanSM in UnfilteredViewInInvariantProject (UnfilteredInvariantProjectModelView) .
          Can_Init: Header=Can.h, InitPhase=INIT_TWO_DRV, ConfigType=Can_ConfigType, ConfigPtrName=Can_Config_Ptr, ConfigPtrClass=CAN_INIT_DATA, ModuleRef=Can  # /ActiveEcuC/Can PLAIN_TEXT Init function description of Can in UnfilteredViewInInvariantProject (UnfilteredInvariantProjectModelView) .
          Can_InitMemory: Header=Can.h, InitPhase=INIT_MEMORY, ModuleRef=Can  # /ActiveEcuC/Can PLAIN_TEXT InitMemory function description of Can in UnfilteredViewInInvariantProject (UnfilteredInvariantProjectModelView) .
          ComM_InitMemory: Header=ComM.h, InitPhase=INIT_MEMORY, ModuleRef=ComM  # /ActiveEcuC/ComM PLAIN_TEXT InitMemory function description of ComM in UnfilteredViewInInvariantProject (UnfilteredInvariantProjectModelView) .
          ComM_Init: Header=ComM.h, InitPhase=INIT_TWO_POST_NVMREADALL, ConfigType=ComM_ConfigType, ConfigPtrName=ComM_Config_Ptr, ConfigPtrClass=COMM_INIT_DATA, ModuleRef=ComM  # /ActiveEcuC/ComM PLAIN_TEXT Init function description of ComM in UnfilteredViewInInvariantProject (UnfilteredInvariantProjectModelView) .
          ComM_PostInit: Header=ComM.h, InitPhase=INIT_THREE, ModuleRef=ComM  # /ActiveEcuC/ComM PLAIN_TEXT Post-Initialization of the ComM and its internal state machine
          ComM_PreInit: Header=ComM.h, InitPhase=INIT_ONE, ConfigType=ComM_ConfigType, ConfigPtrName=ComM_Config_Ptr, ConfigPtrClass=COMM_INIT_DATA, ModuleRef=ComM  # /ActiveEcuC/ComM PLAIN_TEXT PreInit function description of ComM in UnfilteredViewInInvariantProject (UnfilteredInvariantProjectModelView) .
          Com_InitMemory: Header=Com.h, InitPhase=INIT_MEMORY, ModuleRef=Com  # /ActiveEcuC/Com PLAIN_TEXT InitMemory function description of Com in UnfilteredViewInInvariantProject (UnfilteredInvariantProjectModelView) .
          Com_Init: Header=Com.h, InitPhase=INIT_TWO_COM, ConfigType=Com_ConfigType, ConfigPtrName=Com_Config_Ptr, ConfigPtrClass=COM_INIT_DATA, ModuleRef=Com  # /ActiveEcuC/Com PLAIN_TEXT Init function description of Com in UnfilteredViewInInvariantProject (UnfilteredInvariantProjectModelView) .
          Det_InitMemory: Header=Det.h, InitPhase=INIT_MEMORY, ModuleRef=Det  # /ActiveEcuC/Det PLAIN_TEXT InitMemory function description of Det in UnfilteredViewInInvariantProject (UnfilteredInvariantProjectModelView) .
          Det_Init: Header=Det.h, InitPhase=INIT_ZERO, ConfigType=Det_ConfigType, ConfigPtrName=Det_Config_Ptr, ConfigPtrClass=DET_INIT_DATA, ModuleRef=Det  # /ActiveEcuC/Det PLAIN_TEXT Init function description of Det in UnfilteredViewInInvariantProject (UnfilteredInvariantProjectModelView) .
          EcuM_Init: Header=EcuM.h, InitPhase=NO_INIT, ConfigType=EcuM_PbConfigType, ConfigPtrName=EcuM_Config_Ptr, ConfigPtrClass=ECUM_INIT_DATA, ModuleRef=EcuM  # /ActiveEcuC/EcuM PLAIN_TEXT Init function description of EcuM in UnfilteredViewInInvariantProject (UnfilteredInvariantProjectModelView) .
          PduR_Init: Header=PduR.h, InitPhase=INIT_TWO_COM, ConfigType=PduR_PBConfigType, ConfigPtrName=PduR_Config_Ptr, ConfigPtrClass=PDUR_INIT_DATA, ModuleRef=PduR  # /ActiveEcuC/PduR PLAIN_TEXT Init function description of PduR in UnfilteredViewInInvariantProject (UnfilteredInvariantProjectModelView) .
          PduR_PreInit: Header=PduR.h, InitPhase=INIT_ONE, ConfigType=PduR_PBConfigType, ConfigPtrName=PduR_Config_Ptr, ConfigPtrClass=PDUR_INIT_DATA, ModuleRef=PduR  # /ActiveEcuC/PduR PLAIN_TEXT PreInit function description of PduR in UnfilteredViewInInvariantProject (UnfilteredInvariantProjectModelView) .
          PduR_InitMemory: Header=PduR.h, InitPhase=INIT_MEMORY, ModuleRef=PduR  # /ActiveEcuC/PduR PLAIN_TEXT InitMemory function description of PduR in UnfilteredViewInInvariantProject (UnfilteredInvariantProjectModelView) .
          SchM_Init: Header=Rte_Main.h, InitPhase=NO_INIT, ModuleRef=Rte  # /ActiveEcuC/Rte PLAIN_TEXT Automatically generated by EcuCBswInitFctConfigurationService.
          Rte_InitMemory: Header=Rte_Main.h, InitPhase=INIT_MEMORY, ModuleRef=Rte  # /ActiveEcuC/Rte PLAIN_TEXT Automatically generated by EcuCBswInitFctConfigurationService.
          SchM_Start: Header=Rte_Main.h, InitPhase=NO_INIT, ModuleRef=Rte  # /ActiveEcuC/Rte PLAIN_TEXT Automatically generated by EcuCBswInitFctConfigurationService.
          Rte_StartTiming: Header=Rte_Main.h, InitPhase=NO_INIT, ModuleRef=Rte  # /ActiveEcuC/Rte PLAIN_TEXT Automatically generated by EcuCBswInitFctConfigurationService.
          SchM_StartTiming: Header=Rte_Main.h, InitPhase=NO_INIT, ModuleRef=Rte  # /ActiveEcuC/Rte PLAIN_TEXT Automatically generated by EcuCBswInitFctConfigurationService.
          Rte_Start: Header=Rte_Main.h, InitPhase=INIT_THREE, ModuleRef=Rte  # /ActiveEcuC/Rte PLAIN_TEXT Automatically generated by EcuCBswInitFctConfigurationService.
          CanTp_InitMemory: Header=CanTp.h, InitPhase=INIT_MEMORY, ModuleRef=CanTp  # /ActiveEcuC/CanTp PLAIN_TEXT InitMemory function description of CanTp in UnfilteredViewInInvariantProject (UnfilteredInvariantProjectModelView) .
          CanTp_Init: Header=CanTp.h, InitPhase=INIT_TWO_TP, ConfigType=CanTp_ConfigType, ConfigPtrName=CanTp_Config_Ptr, ConfigPtrClass=CANTP_INIT_DATA, ModuleRef=CanTp  # /ActiveEcuC/CanTp PLAIN_TEXT Init function description of CanTp in UnfilteredViewInInvariantProject (UnfilteredInvariantProjectModelView) .
          Dcm_Init: Header=Dcm.h, InitPhase=INIT_TWO_POST_NVMREADALL, ConfigType=Dcm_ConfigType, ConfigPtrName=NULL_PTR, ConfigPtrClass=DCM_CONST, ModuleRef=Dcm  # /ActiveEcuC/Dcm PLAIN_TEXT Dcm_Init function description
          Dcm_InitMemory: Header=Dcm.h, InitPhase=INIT_MEMORY, ModuleRef=Dcm  # /ActiveEcuC/Dcm PLAIN_TEXT Dcm_InitMemory function description
          Dem_Init: Header=Dem.h, InitPhase=INIT_TWO_POST_NVMREADALL, ConfigType=Dem_ConfigType, ConfigPtrName=Dem_Config_Ptr, ConfigPtrClass=DEM_INIT_DATA, ModuleRef=Dem  # /ActiveEcuC/Dem PLAIN_TEXT Init function description of Dem in UnfilteredViewInInvariantProject (UnfilteredInvariantProjectModelView) .
          Dem_PreInit: Header=Dem.h, InitPhase=INIT_ZERO, ConfigType=Dem_ConfigType, ConfigPtrName=Dem_Config_Ptr, ConfigPtrClass=DEM_INIT_DATA, ModuleRef=Dem  # /ActiveEcuC/Dem PLAIN_TEXT PreInit function description of Dem in UnfilteredViewInInvariantProject (UnfilteredInvariantProjectModelView) .
          Dem_InitMemory: Header=Dem.h, InitPhase=INIT_MEMORY, ModuleRef=Dem  # /ActiveEcuC/Dem PLAIN_TEXT InitMemory function description of Dem in UnfilteredViewInInvariantProject (UnfilteredInvariantProjectModelView) .
