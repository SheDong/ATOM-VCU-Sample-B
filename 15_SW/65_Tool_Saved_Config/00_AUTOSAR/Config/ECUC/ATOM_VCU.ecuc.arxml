AUTOSAR XML (schema 00048)
package /ActiveEcuC
  ecuc value collection ActiveEcuC: ecu-extract=SYSTEM, ecuc-values=[BswM, EcuM, CanIf, PduR, Rte, vSet, Can, Os, Det, Com, ComM, EcuC, CanSM, MemMap, Dcm, Dem, CanTp]
